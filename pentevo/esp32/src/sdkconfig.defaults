## pentevo/esp32/src/sdkconfig.defaults
```kconfig
CONFIG_IDF_TARGET="esp32s3"
CONFIG_BOOTLOADER_LOG_COLORS=y
CONFIG_BOOTLOADER_REGION_PROTECTION_ENABLE=n
CONFIG_BOOTLOADER_WDT_ENABLE=n
CONFIG_BOOTLOADER_SKIP_VALIDATE_ALWAYS=y
CONFIG_APP_RETRIEVE_LEN_ELF_SHA=16
CONFIG_ESPTOOLPY_FLASHMODE_QIO=y
CONFIG_ESPTOOLPY_FLASHSIZE_16MB=y
CONFIG_ESPTOOLPY_HEADER_FLASHSIZE_UPDATE=y
CONFIG_PARTITION_TABLE_CUSTOM=y
CONFIG_COMPILER_OPTIMIZATION_PERF=y
CONFIG_COMPILER_OPTIMIZATION_ASSERTIONS_DISABLE=y
CONFIG_CONSOLE_SORTED_HELP=y
CONFIG_GPIO_CTRL_FUNC_IN_IRAM=y
CONFIG_GPTIMER_CTRL_FUNC_IN_IRAM=y
CONFIG_SPI_SLAVE_IN_IRAM=y
CONFIG_UART_ISR_IN_IRAM=y
CONFIG_ETH_USE_SPI_ETHERNET=n
CONFIG_HTTPD_MAX_REQ_HDR_LEN=512
CONFIG_ESP_PHY_REDUCE_TX_POWER=y
CONFIG_SPIRAM=y
CONFIG_SPIRAM_MODE_OCT=y
#CONFIG_SPIRAM_XIP_FROM_PSRAM=y
CONFIG_SPIRAM_SPEED_80M=y
CONFIG_SPIRAM_MEMTEST=n
CONFIG_SPIRAM_MALLOC_ALWAYSINTERNAL=2048
CONFIG_SPIRAM_TRY_ALLOCATE_WIFI_LWIP=y
CONFIG_SPIRAM_MALLOC_RESERVE_INTERNAL=0
CONFIG_SPIRAM_ALLOW_BSS_SEG_EXTERNAL_MEMORY=y
CONFIG_ESP_DEFAULT_CPU_FREQ_MHZ_240=y
CONFIG_ESP32S3_DATA_CACHE_64KB=y
CONFIG_ESP_SYSTEM_MEMPROT=n
CONFIG_ESP_INT_WDT=n
CONFIG_ESP_TASK_WDT_EN=n
CONFIG_ESP_WIFI_STATIC_RX_BUFFER_NUM=10
CONFIG_ESP_WIFI_RX_BA_WIN=6
CONFIG_ESP_WIFI_GMAC_SUPPORT=n
CONFIG_ESP_WIFI_SOFTAP_SUPPORT=n
CONFIG_FATFS_VOLUME_COUNT=1
CONFIG_FATFS_CODEPAGE_866=y
CONFIG_FREERTOS_VTASKLIST_INCLUDE_COREID=y
CONFIG_FREERTOS_GENERATE_RUN_TIME_STATS=y
CONFIG_FREERTOS_ISR_STACKSIZE=2096
CONFIG_LOG_VERSION_2=y
CONFIG_LOG_COLORS=y
CONFIG_LWIP_TCPIP_RECVMBOX_SIZE=1024
CONFIG_LWIP_TCP_WND_DEFAULT=65535
CONFIG_LWIP_TCP_RECVMBOX_SIZE=1024
CONFIG_LWIP_TCP_ACCEPTMBOX_SIZE=255
CONFIG_LWIP_TCP_SACK_OUT=y
CONFIG_LWIP_WND_SCALE=y
CONFIG_LWIP_TCP_RCV_SCALE=14
CONFIG_LWIP_UDP_RECVMBOX_SIZE=16
CONFIG_LWIP_TCPIP_TASK_AFFINITY_CPU0=y
CONFIG_MBEDTLS_EXTERNAL_MEM_ALLOC=y
CONFIG_SPI_FLASH_AUTO_SUSPEND=y
CONFIG_IDF_EXPERIMENTAL_FEATURES=y
```
