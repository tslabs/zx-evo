;---------------------------------------
PREDMA  LD A,H,C,PG0
        CP #80:JR NC,$+6:LD BC,(PGO)
        AND %00111111
        LD D,A,A,C

        LD BC,STS:INF:JP M,$-2
        RET
;-------
POSDMA  LD DE,512:ADD HL,DE
        LD A,H
        CP #40:JR C,TSDL
        CP #80:JR NC,TSDL
        AND %00111111:LD H,A
        LD A,(PGO):INC A
        LD (PGO),A
TSDL    INF:JP M,$-2
        RET
;---------------------------------------
STS     EQU #27AF

DMASL   EQU #1AAF
DMASH   EQU #1BAF
DMASX   EQU #1CAF
DMADL   EQU #1DAF
DMADH   EQU #1EAF
DMADX   EQU #1FAF

DMA_T   EQU #28AF;0=1, 255=256
DMA_N   EQU #26AF;255=512
DMA_C   EQU #27AF;RW 1 - - - 0 0 1
;---------------------------------------
