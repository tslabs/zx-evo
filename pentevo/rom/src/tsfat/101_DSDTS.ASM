P_CONF  EQU #77
P_DATA  EQU #57

CMD_12  EQU #4C
CMD_18  EQU #52
CMD_25  EQU #59
CMD_55  EQU #77
CMD_58  EQU #7A
CMD_59  EQU #7B
ACMD_41 EQU #69
;---------------------------------------
;---------------------------------------
INIsd   JP SD__OFF
;=======================================
RDDSEsd LD DE,(BLKNUM)
        LD BC,(BLKNUM+2)
        EXA
        LD A,CMD_18:CALL SECM200
        EXA
RD1     EXA
        CALL IN_OUT:CP #FE:JR NZ,$-5
        CALL READSsd
        EXA
        DEC A:JR NZ,RD1

        LD A,CMD_12
        CALL OUT_COM
        CALL IN_OUT:INC A:JR NZ,$-4
        JP CS_HIGH

SDDSEsd LD DE,(BLKNUM)
        LD BC,(BLKNUM+2)
        EXA
        XOR A:IN A,(P_CONF)
        AND 2:RET NZ
        LD A,B:OR C,D,E
        LD A,3:RET Z

        LD A,CMD_25:CALL SECM200
        CALL IN_OUT:INC A:JR NZ,$-4
        EXA
SD1     EXA
        LD A,#FC:CALL SAVDSsd
        CALL IN_OUT:INC A:JR NZ,$-4
        EXA
        DEC A:JR NZ,SD1

        LD C,P_DATA,A,#FD:OUT A
        CALL IN_OUT:INC A:JR NZ,$-4
        JP CS_HIGH
;---------------------------------------
READSsd PUSH BC,DE

        CALL PREDMA

        LD B,DMADX[:OUT A
        DEC B:OUT D
        DEC B:OUT L

        LD B,DMA_T[:XOR A:OUT A
        LD B,DMA_N[:DEC A:OUT A
        LD B,DMA_C[,A,%00000010:OUT A

        CALL POSDMA

        LD BC,P_DATA
.2      IN A
        POP DE,BC
        RET

;---------------------------------------
SAVDSsd PUSH BC,DE
        LD BC,P_DATA:OUT A

        CALL PREDMA

        LD B,DMASX[:OUT A
        DEC B:OUT D
        DEC B:OUT L

        LD B,DMA_T[:XOR A:OUT A
        LD B,DMA_N[:DEC A:OUT A
        LD B,DMA_C[,A,%10000010:OUT A

        CALL POSDMA

        LD BC,P_DATA,A,#FF
        OUT A:NOP
        OUT A
        POP DE,BC
        RET

;---------------------------------------
CMD00   DB #40:DS 4:DB #95
CMD08   DB #48,0,0,1,#AA,#87
CMD16   DB #50,0,0,2,0,#FF
;---------------------------------------
SELsd   ;i:A - N of Dev
        OR A:RET NZ
DRDET   CALL SD_INIT
        LD DE,2:OR A:RET NZ
        LD DE,0
        RET
;---------------------------------------
SD_INIT CALL CS_HIGH
        LD BC,P_DATA,DE,#10FF
        OUT E:DEC D:JR NZ,$-3
        XOR A:EXA
ZAW001  LD HL,CMD00:CALL OUTCOM,IN_OUT
        EXA:DEC A:JR Z,ZAW003
        EXA:DEC A:JR NZ,ZAW001
        LD HL,CMD08:CALL OUTCOM,IN_OUT
.3      IN H:NOP
        IN H
        LD HL,0:BIT 2,A
        JR NZ,ZAW006:LD H,#40
ZAW006  LD A,CMD_55:CALL OUT_COM,IN_OUT
        LD A,ACMD_41:OUT A:NOP
        OUT H:NOP
        OUT L:NOP
        OUT L:NOP
        OUT L
        LD A,#FF:OUT A
        CALL IN_OUT:AND A:JR NZ,ZAW006
ZAW004  LD A,CMD_59:CALL OUT_COM,IN_OUT
        AND A:JR NZ,ZAW004
ZAW005  LD HL,CMD16:CALL OUTCOM,IN_OUT
        AND A:JR NZ,ZAW005

CS_HIGH PUSH DE,BC
        LD E,3,BC,P_CONF
        OUT E:LD E,0,C,P_DATA
        OUT E
        POP BC,DE
        RET

ZAW003  CALL SD__OFF
        LD A,1
        RET

SD__OFF XOR A
        OUT (P_CONF),A
        OUT (P_DATA),A
        RET

CS__LOW PUSH DE,BC
        LD BC,P_CONF,E,1:OUT E
        POP BC,DE
        RET

OUTCOM  CALL CS__LOW
        PUSH BC
        LD BC,P_DATA
.6      OUTI:NOP
        POP BC
        RET

OUT_COM PUSH BC
        CALL CS__LOW
        LD BC,P_DATA
        OUT A:XOR A
.3      OUT A:NOP
        OUT A:DEC A
        OUT A
        POP BC
        RET

SECM200 PUSH HL,DE,BC,AF,BC
        LD BC,P_DATA,A,CMD_58
        CALL OUT_COM,IN_OUT
        IN A:NOP
        IN H:NOP
        IN H:NOP
        IN H:BIT 6,A:POP HL
        JR NZ,SECN200
        EX DE,HL:ADD HL,HL:EX DE,HL
        ADC HL,HL
        LD H,L,L,D,D,E,E,0
SECN200 POP AF
        LD BC,P_DATA:OUT A
        NOP:OUT H
        NOP:OUT L
        NOP:OUT D
        NOP:OUT E
        LD A,#FF:OUT A
        POP BC,DE,HL
        RET

IN_OUT  PUSH BC,DE
        LD DE,#10FF
        LD BC,P_DATA
IN_WAIT IN A
        CP E:JR NZ,IN_EXIT
IN_NEXT DEC D:JR NZ,IN_WAIT
IN_EXIT POP DE,BC
        RET
;---------------------------------------
