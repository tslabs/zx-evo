;---------------------------------------
COMAH   LD BC,#F0:OUT A:RET
COMM    LD BC,#F0:OUT A:RET
LOLL    LD BC,#F0:IN A:RET
;---------------------------------------
REREG   PUSH HL,DE
        LD HL,(BLKNUM)
        LD DE,(BLKNUM+2)
        LD A,H,H,D,D,E,E,A

        LD A,H:AND %00001111:LD H,A
        LD A,(DRVRE)
        OR H
        LD BC,#FFD0:OUT A
        LD C,#70:OUT L
        LD C,#B0:OUT D
        LD C,#90:OUT E
        POP DE,HL
        RET

;---------------------------------------
RPOZ    LD BC,#FFD0:IN A:AND #0F
        LD H,A,C,#70:IN L
        LD C,#B0:IN D
        LD C,#90:IN E
        RET

;---------------------------------------
;i:HL - Address
;   A - Sectors

RDDSEhd EXA:CALL DRDY
        EXA
        LD BC,#50:OUT A
        EXA
        CALL REREG
        LD A,#20:CALL COMAH,READY
        EXA
RDH1    EXA
        CALL WAITDRQ
        CALL READShd
        CALL READY
        EXA:DEC A:JR NZ,RDH1
        RET

;---------------------------------------
SDDSEhd EXA:CALL DRDY
        EXA
        LD BC,#50:OUT A
        EXA
        CALL REREG
        LD A,#30:CALL COMAH,READY
        EXA
SDH1    EXA
        CALL WAITDRQ
        CALL SAVDShd
        CALL READY
        EXA:DEC A:JR NZ,SDH1
        RET

;---------------------------------------
READY   CALL LOLL:RLCA:RET NC:JR READY
WAITDRQ CALL LOLL:AND 8:RET NZ
        JR WAITDRQ
DRDY    CALL LOLL
        AND %11000000
        CP %01000000:RET Z
        JR DRDY

ERROR_7 CALL LOLL:RRCA:RET

SEL_SLA LD A,#B0
        LD (DRVRE),A
        LD BC,#D0:OUT A:CALL LOLL
        RLCA
        RET
SEL_MAS LD A,#E0
        JR SEL_SLA+2

;---------------------------------------
DV2     CALL SEL_SLA:JR DRDEThd
;-------
SELide  ;i:A - N of dev
        CP 2:RET NC
        DEC A:JR Z,DV2
        CALL SEL_MAS
DRDEThd LD A,#08:CALL COMM
        LD L,32
YDET    CALL LOLL:RLCA:JR NC,RRR
        CALL ERROR_7:JR C,RRR
        LD B,1:CALL DIHALT
        DEC L:JR NZ,YDET

        LD DE,500
        JR RUhd

RRR     LD DE,0
        LD H,D,L,E
        CALL XPOZI,REREG
        LD BC,#F0,A,#EC:OUT A;ECCO
        LD B,4:CALL DIHALT
        CALL RPOZ:LD A,D:OR E:JR Z,KRU
;LD HL,#EB14
;OR A:SBC HL,DE:RET Z;ATAPI
RUhd    LD A,1:OR A
        RET
;-------
KRU     LD HL,LOBU:CALL READShd
        LD DE,0
        XOR A
        RET

;---------------------------------------
;READ 512b from IDE Device BUFFER
READShd CALL PREDMA

        LD B,DMADX[:OUT A
        DEC B:OUT D
        DEC B:OUT L

        LD B,DMA_T[:XOR A:OUT A
        LD B,DMA_N[:DEC A:OUT A

        LD B,DMA_C[,A,%00000011:OUT A
        JP POSDMA
;---------------------------------------
;SAVE 512b to IDE Device BUFFER
SAVDShd CALL PREDMA

        LD B,DMASX[:OUT A
        DEC B:OUT D
        DEC B:OUT L

        LD B,DMA_T[:XOR A:OUT A
        LD B,DMA_N[:DEC A:OUT A

        LD B,DMA_C[,A,%10000011:OUT A
        JP POSDMA
;---------------------------------------
