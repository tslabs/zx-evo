;---------------------------------------
E_ENF   EQU 1; entry not found
E_NES   EQU 2; not enough space

E_DNF   EQU 8; device not found
E_DNR   EQU 9; device not ready
E_PNF   EQU 10;partition not found

E_WRP   EQU 16;write protection

E_WGS   EQU 24;wrong stream
E_SNR   EQU 25;stream not ready
;---------------------------------------
        DI

        EXX
        LD D,A
        LD BC,SYC,A,DEFREQ:OUT A
        LD B,PW2[:IN A
        LD E,PG0:OUT E
        LD (PGR),A

        LD (SPBU),SP,SP,PWA

        LD HL,FUX,B,0,C,D
.2      ADD HL,BC
        LD A,(HL):INC HL
        LD H,(HL),L,A
        LD BC,RORO:PUSH BC
        PUSH HL
        EXX:EXA
        RET

RORO    LD SP,(SPBU)
        LD BC,PW2,A,(PGR):OUT A
FEX     RET
;-------
DIHALT  PUSH HL
        LD A,I
        PUSH AF
        LD HL,I_N_T,(INTC),HL
        LD A,INTC[,I,A:IM 2

        EI:HALT:DI:DJNZ $-3

        POP AF
        LD I,A:CP 64:JR NC,$+4:IM 1
        POP HL
        RET

I_N_T   EI:RET
;---------------------------------------
FUX     DW LOAD512;0;   READ512
        DW SAVE512;1;   WRITE512
        DW GFILE;  2;   SEEK0
        DW FEX;    3;   SEEK512
        DW LOADNON;4;   SKIP512
.11     DW FEX
;-------
        DW FENTRY; 16;  FENTRY
        DW GDIR;   17;  SETDIR
        DW MKfile; 18;  MKFILE
        DW MKdir;  19;  MKDIR
        DW FNDELFL;20;  DELFILE
        DW GROOT;  21;  SETROOT
.10     DW FEX
;-------
        DW STREAM; 32;  CRTSTREAM
        DW STREAMS;33;  SELSTREAM
        DW STREAMD;34;  DELSTREAM
;---------------------------------------
STREAM  ;i: B - Device
;               (0 - SD, 1/2 - HDD M/S)
;           C - Partition

;        o: C - Stream Number

        PUSH BC:CALL STRMCLR
        POP BC:RET NZ

        LD A,B
TSBC    CP 3:JR NC,EWGS
        OR A:JR Z,BDSD
        DEC A:JR Z,BDSD+2
        DEC A:RET NZ
        CALL DOS_SWP
        LD A,1
        JR BDIS
BDSD    LD A,1:CALL DOS_SWP
        CALL IDE_INI
        XOR A
BDIS    CALL SEL_DEV:JR NZ,EDNF
        CALL HDD:JR NZ,EPNF

        LD HL,0,(CRRR),HL,(CRRR+2),HL

        LD A,1,(STST),A;Stream Ready
        XOR A:LD C,A
        RET
EWGS    LD A,E_WGS:OR A:RET
EDNF    LD A,E_DNF:OR A:RET
EPNF    LD A,E_PNF:OR A:RET

STREAMS RET
STREAMD RET

GROOT   LD HL,0,(CRRR),HL,(CRRR+2),HL
        JR GDIR
;-------
STRMCLR LD HL,VALS,DE,HL:INC DE
        LD (HL),0,BC,STRMED-VALS-1:LDIR

        XOR A
        RET
;---------------------------------------
FENTRY  CALL SRHDRN:JR Z,EENF
        LD (CRRR),HL
        LD (CRRR+2),DE
        EXX
        CALL GFILE
        LD HL,(ENTRY+28)
        LD DE,(ENTRY+30)

        XOR A
        RET
EENF    LD A,E_ENF:OR A:RET
;-------
GFILE   LD HL,CRRR:JP GIPAG
GDIR    LD HL,CRRR:JP GLSTCAT

MKfile  CALL CRTM
        CALL MKFILE:JR NZ,ENES

        LD (CRRR),HL,(CRRR+2),DE

        PUSH HL,DE:CALL GFILE
        POP DE,HL

        XOR A
        RET
ENES    LD A,E_NES:OR A:RET
;-------
MKdir   CALL CRTM
        CALL MKDIR:JR NZ,ENES
        RET
;-------
CRTM    PUSH HL,DE,BC:CALL TMTOEN
        POP BC,DE,HL
        RET
;-------
FNDELFL ;i:HL - Flag(1),Name(1-12),0

        CALL SRHDRN:JR Z,EENF
        LD (CRRR),HL
        LD (CRRR+2),DE
        LD A,#E5,(BC),A
        CALL STAMP

        LD HL,CRRR:CALL DLSG
        XOR A
        RET
;---------------------------------------
TMTOEN  LD D,0
        LD A,2:CALL SEDT
        LD E,A
.5      SLA E:RL D
        XOR A:CALL SEDT:SRL A
        OR E:LD E,A
        LD A,4:CALL SEDT
.3      SLA A
        OR D:LD D,A
        LD (ENTRY+14),DE
        LD (ENTRY+22),DE

        LD A,9:CALL SEDT:ADD A,20
        LD D,A
        LD A,8:CALL SEDT
.5      SLA A
        RL D:LD E,A
        LD A,7:CALL SEDT
        OR E:LD E,A
        LD (ENTRY+16),DE
        LD (ENTRY+18),DE
        LD (ENTRY+24),DE
        RET

SEDT    LD BC,#DFF7:OUT A
        LD B,#BF:IN A

        LD C,A:AND %00001111:LD B,A
.4      SRL C
        LD A,C
.9      ADD A,C
        ADD A,B
        RET
;---------------------------------------
DOS_SWP ;0 - IDE, 1 - SD

        LD HL,HDRE
        OR A:JR Z,$+5:LD HL,SDRE

        LD DE,IDE_INI,BC,4*3:LDIR
        RET
;-------
SDRE    JP INIsd
        JP SELsd
        JP RDDSEsd
        JP SDDSEsd
;-------
HDRE    RET:RET:RET
        JP SELide
        JP RDDSEhd
        JP SDDSEhd
;---------------------------------------
