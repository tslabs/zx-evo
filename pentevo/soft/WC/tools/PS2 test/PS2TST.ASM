        ORG #6000
;-------
BUFER   EQU #C000
;-------
;CLEARING SCREEN:
        XOR A:OUT (254),A
        LD HL,#4000,DE,#4001,BC,#1800
        LD (HL),L
        LDIR
        LD (HL),%00000111,BC,#0300-1
        LDIR

;OPENING PS/2 PORTS:
        LD BC,#EFF7,A,%10000000:OUT A

;ACTIVATING ACCESS to PS/2:
        LD BC,#DFF7,A,#F0:OUT A
        LD BC,#BFF7,A,2:OUT A

;INITIALIZING INTERRUPTS:
INTA    LD HL,I_N_T
        LD (#5BFF),HL
        DI
        LD A,#5B,I,A
        IM 2

;GENERATING SCREEN TABLE:
        LD HL,BUFER
        LD DE,#4000
        LD B,192
LOOP    LD (HL),E:INC HL
        LD (HL),D:INC HL
        INC D
        LD A,D
        AND 7
        JP NZ,METKA
        LD A,E
        ADD A,32
        LD E,A
        JR C,METKA
        LD A,D
        SUB 8
        LD D,A
METKA   DJNZ LOOP
;---------------------------------------
;MAIN CYCLE:
MAIN    EI:HALT

;READ SCAN CODE:
        CALL PS2CF

;Byte->HEX:
        LD HL,TXT_1+#04
        LD A,(TXT_1+0):CALL NORK
        LD A,(TXT_1+1):CALL NORK
        LD A,(TXT_1+2):CALL NORK

;PRINTING STRING:
        CALL STRPR

        JP MAIN
;---------------------------------------

;-  -  -  -  -  -  -  -  -  -  -  -  -
;INTERRUPT HANDLER:
I_N_T   EI
        RET
;---------------------------------------
;PRINT STRING:
STRPR   LD DE,#50E0;    ADDRES IN SCREEN

        LD BC,TXT_1+4
GAKU    LD A,(BC):INC BC:OR A:RET Z
        PUSH BC

        LD BC,FONT
        LD H,0,L,A
.3      ADD HL,HL
        ADD HL,BC
        LD C,D
.8      LD A,(HL):INC HL:LD (DE),A:INC D
        LD D,C:INC E
        POP BC
        JR GAKU
;---------------------------------------
;GET SCAN CODE+SCROLL SCREEN:
PS2CF   LD BC,#DFF7,A,#F0:OUT A

        LD BC,#BFF7
        IN A
        OR A:RET Z;      BUFFER IS EMPTY

;CLEARING STRING BUFFER:
        LD HL,TXT_1
        LD B,4,(HL),#00:INC HL:DJNZ $-3

;CHECKING FOR OVERFLOW:
        CP #FF:JP Z,OVER;   CLEAR BUFFER
;-------
        LD HL,TXT_1
        LD (HL),A:INC HL

        CP #E0:JR Z,NX;PREFIX
        CP #F0:JR Z,NX;PREFIX

;SCROLLING:
        CALL SCROLL
        RET

NX      HALT
        LD BC,#BFF7
        IN A
        OR A:RET Z
        LD (HL),A:INC HL
        CP #E0:JR Z,NX2
        CP #F0:JR Z,NX2

;SCROLLING:
        CALL SCROLL
        RET

NX2     HALT
        LD BC,#BFF7
        IN A
        OR A:RET Z
        LD (HL),A

;SCROLLING:
        CALL SCROLL
        RET
;-------
TXT_1   DS 10,32:NOP
;---------------------------------------
;SCROLL SCREEN:
SCROLL  LD IX,BUFER
        LD IY,BUFER+16

        LD A,192-8
SUK     LD L,(IY):INC IY
        LD H,(IY):INC IY
        LD E,(IX):INC IX
        LD D,(IX):INC IX
.6      LDI
        DEC A:JP NZ,SUK
        RET
;---------------------------------------
;BYTEtoHEX:
NORK    ;i:HL - String Address
;           A - Value

        INC HL
        LD C,A
        AND %00001111
        CP 10:JR C,$+4:ADD A,7
        ADD A,#30
        LD (HL),A:DEC HL
        LD (HL),C
        XOR A
        RLD
        CP 10:JR C,$+4:ADD A,7
        ADD A,#30
        LD (HL),A
        INC HL,HL
        RET
;---------------------------------------
OVER    LD BC,#DFF7,A,#0C:OUT A
        LD BC,#BFF7,A,#01:OUT A
        LD BC,#DFF7,A,#F0:OUT A

AGU     XOR A
GUI     LD (IX+42),A
        LD A,1:OR A
        RET
;---------------------------------------
FONT    INCB "FONT32L"
;---------------------------------------
