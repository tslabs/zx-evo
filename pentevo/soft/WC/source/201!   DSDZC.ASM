        ORG #3800,$;      SD Card Driver
;-------
DMA_L   EQU #1AAF;X X X X X X X 0
DMA_H   EQU #1BAF;X X X X X X X X
DMA_X   EQU #1CAF;0 0 X X X X X X

DMA_C   EQU #26AF;R/W ZWT 0 0 0 0 V1 V0
DMA_N   EQU #27AF;0=2,1=4,...,255=512
;-------
P_CONF  EQU #77
P_DATA  EQU #57

CMD_12  EQU #4C
CMD_18  EQU #52
CMD_25  EQU #59
CMD_55  EQU #77
CMD_58  EQU #7A
CMD_59  EQU #7B
ACMD_41 EQU #69
;---------------------------------------
        JP IDE_INI
        JP SEL_DEV
        JP REINI

        JP XPOZI
        JP PROZ

        JP RDDSE
        JP SDDSE

        JP RDD256

.16     JP 0
;---------------------------------------
NSDC    NOP ;\ номер сектора в CLUS
EOC     NOP ;/ флаг конца цепочки

ABT     NOP

BZN     DB 4
NR0     DW 4;кол-во грузимых секторов

CAHL    DS 2
CADE    DS 2

LSTSE   DS 4

REZDE   DS 2

PR      DS 4

CLHL    DS 2
CLDE    DS 2

LLHL    DS 4

LTHL    DS 2;LAST
LTDE    DS 2
;------Шаблон элемента каталога:--------
ENTRY   DS 11
EFLG    DB 0,0
        DB #00;ms
        DW #7000:DW #3910;time,date
        DW #3910;acc date
CLSDE   DS 2
        DW #7000:DW #3910;time,date
CLSHL   DS 2
SIZIK   DS 4
        NOP
;---------------------------------------
BREZS   DS 2;+14          FAT PARAMETERS
FSINF   DS 4;[+48(2)]+[ADDTOP]

BFATS   NOP
BFTSZ   DS 4
BSECPC  DS 2;USE 1
BROOTC  DS 4

FSTFRC  DW 2,0

ADDTOP  DS 4

SFAT    DS 2
SDFAT   DS 4

CUHL    DS 2
CUDE    DS 2

NXDE    DS 2
NXHL    DS 2

LDHL    DS 2;аддрес с которого/в который
;            идет запись/чтение
COUNT   NOP
DUHL    DS 2
DUDE    DS 2

DUBA    NOP
UUHL    DS 2
BUHL    DS 2
GARY    DS 2;AAA
CLCNT   DS 2;счетчик
FCTS    DS 4
BUTS    DS 4

LSTCAT  DS 4;активный каталог
RECCAT  DS 4;каталог корзина

BLKNUM  DS 4
;---------------------------------------
;---------------------------------------
;ИНИЦИАЛИЗАЦИЯ SD КАРТЫ:
REINI   RET
IDE_INI ;CP #F1:RET Z
        CALL SD__OFF
        RET
;=======================================
XPOZI   LD (LTHL),HL,(LTDE),DE
PROZ    LD (BLKNUM),HL,(BLKNUM+2),DE
        RET

;HL,in da kudy A,secs
RDDSE   LD DE,(BLKNUM)
        LD BC,(BLKNUM+2)
        EXA
        LD A,CMD_18:CALL SECM200
        EXA
RD1     EXA
        CALL IN_OUT:CP #FE:JR NZ,$-5
        CALL READS
        EXA
        DEC A:JR NZ,RD1

        LD A,CMD_12
        CALL OUT_COM
        CALL IN_OUT:INC A:JR NZ,$-4
        JP CS_HIGH

SDDSE   LD DE,(BLKNUM)
        LD BC,(BLKNUM+2)
        EXA
        XOR A:IN A,(P_CONF)
        AND 2:RET NZ
        LD A,B:OR C,D,E
        LD A,3:RET Z

        LD A,CMD_25:CALL SECM200
        CALL IN_OUT:INC A:JR NZ,$-4
        EXA
SD1     EXA
        LD A,#FC:CALL SAVDS
        CALL IN_OUT:INC A:JR NZ,$-4
        EXA
        DEC A:JR NZ,SD1

        LD C,P_DATA,A,#FD:OUT A
        CALL IN_OUT:INC A:JR NZ,$-4
        JP CS_HIGH
;---------------------------------------
READS   PUSH BC,DE
        LD BC,P_DATA,D,8
RZ1
.64     INI
        DEC D:JP NZ,RZ1

        IN A
        IN A
        POP DE,BC
        RET
;---------------------------------------
;запись очередных 512б данных на HDD
SAVDS   PUSH BC,DE
        LD BC,P_DATA,D,8

        OUT A
SV1
.64     OUTI
        DEC D:JP NZ,SV1

        LD A,#FF
        OUT A:NOP
        OUT A
        POP DE,BC
        RET
;---------------------------------------
RDD256  LD DE,(BLKNUM)
        LD BC,(BLKNUM+2)
        LD A,CMD_18:CALL SECM200
;-------
        CALL IN_OUT:CP #FE:JR NZ,$-5
;-------
        LD BC,P_DATA,D,8
HUD
.32     INI
        DEC D:JP NZ,HUD
        INC H
        LD D,8
HU2
.32     INI
        DEC D:JP NZ,HU2
        INC H

.2      IN A
;-------
        LD A,CMD_12
        CALL OUT_COM
        CALL IN_OUT:INC A:JR NZ,$-4
        JP CS_HIGH
;---------------------------------------
CMD00   DB #40:DS 4:DB #95
CMD08   DB #48,0,0,1,#AA,#87
CMD16   DB #50,0,0,2,0,#FF
;---------------------------------------
;ОПРЕДЕЛЕНИЕ НАЛИЧИЯ КАРТЫ:
SEL_DEV ;i:A - N of Dev
        OR A:RET NZ
DRDET   CALL SD_INIT
        LD DE,2:OR A:RET NZ
        LD DE,0
        RET
;---------------------------------------
SD_INIT CALL CS_HIGH
        LD BC,P_DATA,DE,#10FF
        OUT E:DEC D:JR NZ,$-3
        XOR A:EXA
ZAW001  LD HL,CMD00:CALL OUTCOM,IN_OUT
        EXA:DEC A:JR Z,ZAW003
        EXA:DEC A:JR NZ,ZAW001
        LD HL,CMD08:CALL OUTCOM,IN_OUT
.3      IN H:NOP
        IN H
        LD HL,0:BIT 2,A
        JR NZ,ZAW006:LD H,#40
ZAW006  LD A,CMD_55:CALL OUT_COM,IN_OUT
        LD A,ACMD_41:OUT A:NOP
        OUT H:NOP
        OUT L:NOP
        OUT L:NOP
        OUT L
        LD A,#FF:OUT A
        CALL IN_OUT:AND A:JR NZ,ZAW006
ZAW004  LD A,CMD_59:CALL OUT_COM,IN_OUT
        AND A:JR NZ,ZAW004
ZAW005  LD HL,CMD16:CALL OUTCOM,IN_OUT
        AND A:JR NZ,ZAW005

CS_HIGH PUSH DE,BC
        LD E,3,BC,P_CONF
        OUT E:LD E,0,C,P_DATA
        OUT E
        POP BC,DE
        RET

ZAW003  CALL SD__OFF
        LD A,1
        RET

SD__OFF XOR A
        OUT (P_CONF),A
        OUT (P_DATA),A
        RET

CS__LOW PUSH DE,BC
        LD BC,P_CONF,E,1:OUT E
        POP BC,DE
        RET

OUTCOM  CALL CS__LOW
        PUSH BC
        LD BC,P_DATA
.6      OUTI:NOP
        POP BC
        RET

OUT_COM PUSH BC
        CALL CS__LOW
        LD BC,P_DATA
        OUT A:XOR A
.3      OUT A:NOP
        OUT A:DEC A
        OUT A
        POP BC
        RET

SECM200 PUSH HL,DE,BC,AF,BC
        LD BC,P_DATA,A,CMD_58
        CALL OUT_COM,IN_OUT
        IN A:NOP
        IN H:NOP
        IN H:NOP
        IN H:BIT 6,A:POP HL
        JR NZ,SECN200
        EX DE,HL:ADD HL,HL:EX DE,HL
        ADC HL,HL
        LD H,L,L,D,D,E,E,0
SECN200 POP AF
        LD BC,P_DATA:OUT A
        NOP:OUT H
        NOP:OUT L
        NOP:OUT D
        NOP:OUT E
        LD A,#FF:OUT A
        POP BC,DE,HL
        RET

IN_OUT  PUSH BC,DE
        LD DE,#10FF
        LD BC,P_DATA
IN_WAIT IN A
        CP E:JR NZ,IN_EXIT
IN_NEXT DEC D:JR NZ,IN_WAIT
IN_EXIT POP DE,BC
        RET
;---------------------------------------
