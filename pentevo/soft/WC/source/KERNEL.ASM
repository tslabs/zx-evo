;---------------------------------------
CORE32  ORG #4000,$
;-------
GENBU   EQU #0000
GENBE   EQU #2000
NXTBU   EQU #0000;buffer Start
NXTBM   EQU #1000;buffer MID
NXTBE   EQU #2000;buffer END
NXTBZ   EQU (NXTBE[-NXTBU[)/2

DRVR    EQU #3800
CGFL    EQU DRVR-2;  - used in NXTETY
CGPZ    EQU DRVR-4;  /
CGHL    EQU DRVR-6; /
CGDE    EQU DRVR-8;/
DRV_LN  EQU #0600
VALS    EQU DRVR+24*3

SECBU   EQU #3000;x#200
SECBE   EQU SECBU+512
LOBU    EQU #3200
LOBE    EQU LOBU+512
LOBU2   EQU LOBE
LOBE2   EQU LOBU2+512
;-------
IDE_INI EQU DRVR
SEL_DEV EQU DRVR+3
REINI   EQU DRVR+3*2

XPOZI   EQU DRVR+3*3
PROZ    EQU XPOZI+3

RDDSE   EQU PROZ+3
SDDSE   EQU RDDSE+3

RDD256  EQU SDDSE+3
;---------------------------------------
NSDC    EQU VALS;  \ Sec num in Cluster
EOC     EQU NSDC+1;/ Flag (EndOfChain)

ABT     EQU EOC+1

BZN     EQU ABT+1;Blocks
NR0     EQU BZN+1

CAHL    EQU NR0+2
CADE    EQU CAHL+2

LSTSE   EQU CADE+2

REZDE   EQU LSTSE+4

PR      EQU REZDE+2

CLHL    EQU PR+4
CLDE    EQU CLHL+2

LLHL    EQU CLDE+2

LTHL    EQU LLHL+4;LAST
LTDE    EQU LTHL+2
;-------Entry Pattern:
ENTRY   EQU LTDE+2
EFLG    EQU ENTRY+11
CLSDE   EQU ENTRY+20
CLSHL   EQU ENTRY+26
SIZIK   EQU ENTRY+28
;-------FAT PARAMETERS:
BREZS   EQU ENTRY+33;           [+14(2)]
FSINF   EQU BREZS+2;   [+48(2)]+[ADDTOP]

BFATS   EQU FSINF+4
BFTSZ   EQU BFATS+1
BSECPC  EQU BFTSZ+4
BROOTC  EQU BSECPC+2

FSTFRC  EQU BROOTC+4

ADDTOP  EQU FSTFRC+4

SFAT    EQU ADDTOP+4
SDFAT   EQU SFAT+2

CUHL    EQU SDFAT+4
CUDE    EQU CUHL+2

NXDE    EQU CUDE+2
NXHL    EQU NXDE+2

LDHL    EQU NXHL+2;ADDRESS COPY

COUNT   EQU LDHL+2
DUHL    EQU COUNT+1
DUDE    EQU DUHL+2

DUBA    EQU DUDE+2
UUHL    EQU DUBA+1
BUHL    EQU UUHL+2
CLCNT   EQU BUHL+2; COUNTER USED in MKSG

FCTS    EQU CLCNT+4
BUTS    EQU FCTS+4

LSTCAT  EQU BUTS+4;  Active DIR
RECCAT  EQU LSTCAT+4;RECYCLED BIN DIR

;***************************************
START   JP IDE_INI;             inDriver
        JP SEL_DEV;             inDriver
        JP REINI;               inDriver
        JP HDD

        JP RDD
        JP SDD

        JP GIPAG
        JP LOAD512
        JP SAVE512

        JP DOS_SWP

        JP GLSTCAT
        JP TLSTCAT

        JP SRHFCL
        JP Z0
        JP MKSG
        JP Z0
        JP RFRH

        JP GENTRY
        JP TENTRY

        JP MKFILE
        JP MKDIR

        JP DELFL
        JP RENAME

        JP DLSG
        JP CHTOSE

        JP Z0
        JP SRHDRN

        JP LOAD256
        JP LOADNON

        JP NXTETY
        JP NXTETY2
;---------------------------------------
