C000    EQU #C000

SP1     EQU 1
SP2     EQU 2
SP4     EQU 3
SP3     EQU 4
SL1     EQU 5;line
SPL1    EQU 6
SPL2    EQU 7
SPL3    EQU 8
SL2     EQU 9;line
SPR1    EQU 10
SPR2    EQU 11
SPR3    EQU 12
SPE     EQU SPR3;Last Param line

WNY     EQU 6
WNH     EQU SPE+2
CMX     EQU WNH+1

LN1     EQU SPE+1-SL1
LN2     EQU SPE+1-SL2
;---------------------------------------
F9STP   PUSH IX
        CALL CURVA

        LD IX,F9WND:CALL PRWOW
        PUSH IX:LD IX,F9WN2:CALL PRWOW
        POP IX
        LD HL,STPL,DE,SL1*256:CALL TXTPR
        LD HL,STPR,DE,SL2*256:CALL TXTPR

STPM    EI:HALT
        LD DE,SBL1,A,SP1-1:CALL PRCONF
        LD DE,SBL2,A,SPL1-1:CALL PRCONF
        LD DE,SBL3,A,SPR1-1:CALL PRCONF
        CALL CURSOR

        CALL ESC:JR NZ,STPE
        CALL UPPP,NZ,SCU
        CALL DWWW,NZ,SCD
        CALL ENKE,NZ,SEN:JR Z,STPM

STPE    LD IX,F9WN2:CALL RRESB
        LD IX,F9WND:CALL RRESB
        POP IX
        RET
;-------
SCU     CALL CURSER
        LD A,(IX+12)
        CP SL1+1:JR Z,ScU
        CP SL2+1:JR Z,ScU
        CP CMX:JR Z,Sc2
Scu     CALL CURSOR
        JP CrUP
Sc2     DEC (IX+12)
ScU     DEC (IX+12):JR Scu

SCD     CALL CURSER
        LD A,(IX+12)
        CP SL1-1:JR Z,ScD
        CP SL2-1:JR Z,ScD
        CP SPE:JR Z,Sc3
Scd     CALL CURSOR
        JP CrDN
Sc3     INC (IX+12)
ScD     INC (IX+12):JR Scd

SENE    LD BC,HL
        LD A,(HL):INC HL
        LD E,(HL):INC HL
        LD D,(HL)
        EX DE,HL
        INC A:CP (HL):JR C,$+3:XOR A
        LD (BC),A
        XOR A
        RET

SEN     LD A,(IX+12)
        LD HL,SBL1:CP SP1:JR Z,SENE
        LD HL,SBL1A:CP SP2:JR Z,SENE
        LD HL,SBL1C:CP SP4:JR Z,SENE
        LD HL,SBL1B:CP SP3:JR Z,SENE
        LD HL,SBL2:CP SPL1:JR Z,SENE
        LD HL,SBL2A:CP SPL2:JR Z,SENE
        LD HL,SBL2B:CP SPL3:JR Z,SENE
        LD HL,SBL3:CP SPR1:JR Z,SENE
        LD HL,SBL3A:CP SPR2:JR Z,SENE
        LD HL,SBL3B:CP SPR3:JR Z,SENE

        LD A,(PG0),(FEP),A
        CALL LINI,GINI
        OR A:JR Z,MINI
        DEC A:JR Z,FTLER
        DEC A:JR Z,FNI
        DEC A:JR Z,JI
        DEC A:JR Z,DICI
FTLER   LD HL,SERR
        LD DE,#0113,BC,26:CALL ERR0
        JR Sext
SEXT    PUSH IX:LD IX,F9OK:CALL PRWOW

        CALL USPO
        CALL NUSP
        CALL RRESB
        POP IX

Sext    LD A,(FEP):CALL MNG0

        LD A,1:OR A
        RET
FNI     LD HL,WCDIR+1
        CALL MKdir:JR NZ,SEXT
        LD HL,WCDIR
        CALL FENTRY:JR Z,SEXT
        CALL GDIR

JI      LD HL,INIB,DE,LOBU,BC,#1000:LDIR

        LD HL,SFINI
        CALL MKfile:JR NZ,SEXT
        LD HL,LOBU
        LD A,(SFIS+1):SRL A
        OR A:JR NZ,$+3:INC A
        LD B,A:CALL SAVE512
        JR SEXT
MINI
DICI    LD HL,WCINI
        CALL FNDELFL:JR Z,SEXT
        JR JI

GINI    PUSH AF
        PUSH AF
_LD A,(SBL1):ADD A,#30:LD (CPFRQ),A
_LD A,(SBL1A):ADD A,#30:LD (SPIR),A
_LD A,(SBL1C):ADD A,#30:LD (CURP),A
_LD A,(SBL1B):ADD A,#30:LD (TXTMD),A
_LD A,(SBL2):ADD A,#30:LD (SDRV1),A
_LD A,(SBL2A):ADD A,#30:LD (SNFO1),A
_LD A,(SBL2B):ADD A,#30:LD (SSRT1),A
_LD A,(SBL3):ADD A,#30:LD (SDRV2),A
_LD A,(SBL3A):ADD A,#30:LD (SNFO2),A
_LD A,(SBL3B):ADD A,#30:LD (SSRT2),A

        POP AF:OR A

        LD DE,INIB
        PUSH DE
        LD HL,IDNT3,BC,38:LDIR
        LD A,13
        LD (DE),A:INC DE
        LD (DE),A:INC DE
        LD HL,SPTRN,BC,SPP1-SPTRN:LDIR
        CALL Z,MII
        LD HL,SPTR2,BC,SPP2-SPTR2:LDIR
        POP HL
        EX DE,HL
        OR A:SBC HL,DE
        LD (SFIS),HL
        POP AF
        RET

MII     PUSH DE
        LD DE,INIA,HL,SPP2
        CALL SRHSQ
        POP DE:RET Z

        PUSH HL
        LD HL,SPP2,BC,9:LDIR
        POP HL

MIIM    LD A,D:CP #20:RET NC
        LD A,(HL)
        OR A:RET Z
        CP "[":RET Z
        LD (DE),A:INC HL,DE
        JR MIIM

SRHSQ   LD A,(DE):OR A:RET Z
        CP (HL):INC DE:JR NZ,SRHSQ
        LD BC,HL
SSQM    INC HL:LD A,(HL):INC A:JR Z,SSQ
        LD A,(DE):OR A:RET Z
        CP (HL):INC DE:JR Z,SSQM
        LD HL,BC
        JR SRHSQ
SSQ     EX DE,HL
        LD A,1:OR A
        RET
;-------
PRCONF  LD (YYY),A
PRCON   CALL GENBUF:RET Z
        PUSH DE:LD D,A,E,6:CALL PRSRW
        LD A,%01011100:CALL PRIAT
        POP DE
        JR PRCON

GENBUF  LD A,(DE):INC A:RET Z:DEC A

        EX DE,HL
        INC HL
        LD E,(HL):INC HL
        LD D,(HL):INC HL
        PUSH AF,DE
        LD DE,TXTBU:CALL LDIRT:INC HL
        POP BC,AF

        PUSH HL:LD HL,BC
        INC HL:LD C,(HL):INC HL
        LD B,A:INC B
        XOR A:SUB C:ADD A,C:DJNZ $-1
        PUSH BC:LD C,A:ADD HL,BC
        POP BC
        LDIR
        LD A,32
        LD B,6,(DE),A:INC DE:DJNZ $-2

        POP HL
        EX DE,HL

        LD HL,YYY:INC (HL):LD A,(HL)
        LD HL,TXTBU,BC,24
        OR A
        RET
LDIRT   LD A,(HL):OR A:RET Z
        LD (DE),A:INC HL,DE
        JR LDIRT

;---------------------------------------
;update SETUP parameters
CURVA   LD A,(DFRQ):CP 3:JR C,$+4:LD A,2
        LD (SBL1),A

        LD A,(LFLT),BC,0
        BIT 0,A:JR Z,$+3:INC C
        BIT 1,A:JR Z,$+3:INC B
        LD A,C,(SBL1A),A
        LD A,B,(SBL1C),A

        LD A,(HEI),B,0
        CP 25:LD B,0:JR Z,HEC
        CP 30:LD B,1:JR Z,HEC
        LD B,2
HEC     LD A,B,(SBL1B),A
;-------
        LD A,(WINDOW+29),(SBL2),A
        LD A,(WINDOW+10)
        OR A:JR Z,$+4:LD A,1
        LD (SBL2A),A
        LD A,(WINDOW+35),(SBL2B),A
;-------
        LD A,(WINDO2+29),(SBL3),A
        LD A,(WINDO2+10)
        OR A:JR Z,$+4:LD A,1
        LD (SBL3A),A
        LD A,(WINDO2+35),(SBL3B),A
        RET
;---------------------------------------
PATH    LD A,(LFLT):BIT 0,A:JR NZ,LPATH

        LD IX,WINDOW:CALL DRACT,ORIGA
        LD IX,WINDO2:CALL DRACT,ORIGA
        RET

LPATH   LD IX,WINDOW
        LD HL,RLPNL+C000:CALL SIMUL

        LD IX,WINDO2
        LD HL,RRPNL+C000:CALL SIMUL

        CALL MNGP
        LD A,(RAPNL+#C000)
        CP #42:JR Z,MEL
        CP #41:JR NZ,RRAP
        LD IX,WINDOW:CALL DRACT

MEL     LD A,(LFLT):BIT 1,A:RET Z
        CALL RAP
        LD A,(HL):INC A:LD C,A
        LD A,(IX+5):SUB 2,(IX+10)
        CP C:JP C,WLIT
        DEC HL:LD E,(HL)
        DEC HL:LD D,(HL)
        LD H,0,L,C
        ADD HL,DE

        PUSH DE
        EX DE,HL
        LD L,(IX+18)
        LD H,(IX+19)
        OR A:SBC HL,DE
        POP DE:JP C,WLIT

        LD (IX+12),C
        LD (IX+16),E
        LD (IX+17),D
        JP WLIT

ARAP    CALL RAP
        LD A,(IX+12):DEC A:LD (HL),A
        DEC HL:LD A,(IX+16),(HL),A
        DEC HL:LD A,(IX+17),(HL),A
        RET
RAP     CALL MNGP
        LD L,(IX+30)
        LD A,(IX+31):ADD A,#C0:LD H,A
        DEC HL
        RET

RRAP    CALL RAP
        XOR A
        LD (HL),A:DEC HL
        LD (HL),A:DEC HL
        LD (HL),A
        LD A,#42
        LD (RAPNL+#C000),A
        RET
;-------
SIMUL   CALL MNGP
        LD C,(HL):INC HL
        LD A,(HL):INC HL:CP ":":JP NZ,FI
        LD A,(HL):INC HL:CP "\":JP NZ,FI
        LD A,C:SUB #30:CP 6:JP NC,FI
        LD (IX+29),A,(IX+28),0

        LD (IX+34),1
        PUSH AF
        PUSH HL:CALL DRACT,ORIGA2,PANELI
        POP HL
        POP AF
        LD (IX+34),0
        CP (IX+29):JR NZ,FAIL

SIMZ    CALL MNGP

        LD A,(HL):CP #FF:JR Z,EXCE
        LD B,127,DE,TXTBU+1
SIMC    LD A,(HL):INC HL
        CP "\":JR Z,SIME
        LD (DE),A:INC DE
        DJNZ SIMC:JR FAIL

SIME    XOR A:LD (DE),A
        PUSH HL
        LD HL,TXTBU,(HL),#10
        CALL SRHDRN
        LD (BRRR),HL,(BRRR+2),DE
        POP HL:JR Z,FAIL

        PUSH HL:LD HL,BRRR:CALL GLSTCAT
        POP HL

        PUSH HL
        LD A,(IX+22):CALL MNGC
        LD L,(IX+23)
        LD H,(IX+24)
        LD DE,CURO,BC,0,A,1:CALL Lup
        POP HL
        JP SIMZ

EXCE    LD DE,0-C000:ADD HL,DE
        LD (IX+32),L
        LD (IX+33),H
        JP FOLD
FAIL    LD (IX+28),0
FI      CALL RRAP
        CALL DRACT,ORIGA
        RET
;-------
MPATH   LD A,RPPG:CALL MNG0
        LD L,(IX+30)
        LD H,(IX+31):DEC HL
        XOR A
        LD (HL),A:DEC HL
        LD (HL),A:DEC HL
        LD (HL),A

        EX DE,HL
        LD E,(IX+32)
        LD D,(IX+33)
        LD A,".":CP (HL):JR Z,SPATH
APATH   LD B,255
ApA     LD A,(HL):INC HL
        OR A:JR Z,EDPA
        LD (DE),A:INC DE
        DJNZ ApA
EDPA    LD A,"\",(DE),A:INC DE

EPATH   LD A,#FF,(DE),A
        LD (IX+32),E
        LD (IX+33),D
ZIP     JP FRST
SPATH   INC HL:CP (HL):JR NZ,LNPT
        INC HL:LD A,(HL)
        DEC HL:OR A:JR NZ,LNPT
        LD B,255
        DEC DE
SiP     DEC DE:LD A,(DE)
        CP "\":JR Z,SIP
        CP ":":JR Z,ZIP
        DJNZ SiP
SIP     INC DE
        JR EPATH
LNPT    DEC HL
        JP APATH
;-------
RPATH   LD A,(IX+34):OR A:RET NZ
        LD A,RPPG:CALL MNG0

        LD L,(IX+30)
        LD H,(IX+31)
        LD A,(IX+29)
        ADD A,#30
        LD (HL),A:INC HL
        LD (HL),":":INC HL
        LD (HL),"\":INC HL
        LD (HL),#FF
        LD (IX+32),L
        LD (IX+33),H
        JP FRST
;-------
PPATH   LD A,RPPG:CALL MNG0

        LD L,(IX+30)
        LD H,(IX+31)

        LD DE,HL
        LD B,40
AG      LD A,(DE):INC DE:CP #FF:JR Z,$+4
        DJNZ AG
        LD A,40
        SUB B
        LD C,A
        PUSH BC
        LD B,0,C,A
        LD DE,#0000:CALL PRSRW
        POP BC
        LD E,C
        LD HL,TXTBU
        LD C,B
        LD A,B:OR A:JR Z,PPO
        LD A," ",(HL),A:INC HL:DJNZ $-2
        LD B,0
        LD HL,TXTBU,D,0:CALL PRSRW
PPO     JP FRST
;---------------------------------------
INIA    EQU #0000
INIB    EQU #1000

FINI    CALL VDAC
        CALL LINI:OR A:JR NZ,IERR
;-------
        LD A,1,(INIflg),A
        CALL PARSING
;LD A,(INIflg):OR A:CALL NZ,GEDZ
;-------
        LD HL,ENTRY,B,32:CALL NOPING
        JP USPO;F7F

GEDZ    CALL LINEZ:JP GEDPL

IERR    PUSH AF:CALL GEDZ
        POP AF
        LD HL,IFM1,BC,26:DEC A:JR Z,IERP
        LD HL,IFM2,BC,20:DEC A:JR Z,IERP
        LD HL,IFM3,BC,17:DEC A:JR Z,IERP
        LD HL,IFM4,BC,19:DEC A:JR Z,IERP
IERP    PUSH HL,BC
        LD IX,IMWND:CALL PRWOW
        LD HL,IFM,DE,#000E
        LD BC,15:CALL PRSRW
        LD A,%11110001:CALL PRIAT
        POP BC,HL
        LD DE,#010C:CALL PRSRW
;LD B,16:EI:HALT:DJNZ $-2
        CALL USPO
        CALL NUSP;F7F
        JP RRESB

VDAC    ;LD BC,Vmod,A,%00100000:OUT A
        LD BC,Vmod:IN A:AND %00000111
        LD (CNFv),A

        LD HL,RSQB
        LD (RSQBC),HL
        LD HL,0,(Yoff),HL
        LD HL,%1000001100011110,(HEI),HL

        LD A,#C3,(Fun),A
        LD HL,FUN,(Fun+1),HL

        LD A,5,(PG4),A
        LD A,2,(PG8),A

        XOR A:CALL MNGC
        LD HL,0,(#C000),HL
        LD BC,STS:INF:JP M,$-2

        LD B,DMA_N[,A,255:OUT A
        LD B,DMA_T[,A,18-1:OUT A
        XOR A
        LD B,DMASL[:OUT A
        INC B:OUT A
        INC B:OUT A
        LD B,DMADX[:OUT A
        DEC B:OUT A:INC A,A
        DEC B:OUT A
        LD B,DMA_C[,A,%00000100:OUT A
;-------
        CALL PLGCL

        LD A,MTXPG+1:CALL MNGC
        LD HL,FONT
        LD DE,#C000
        LD BC,#0800
        LDIR
;LD DE,GIG_PAL
;LD BC,512
;LDIR
        LD DE,DEHR1
        LD BC,DEHR1L
        LDIR
        LD DE,MLZ4
        LD BC,MLZ4L
        LDIR

        LD A,TVvPG+1:CALL MNGC
        LD HL,FONT
        LD DE,#C000
        LD BC,#0800
        LDIR
;LD HL,NOre
;LD DE,ENCODET
;LD BC,ENCND-ENCOD
;LDIR
        LD A,PNLPG:CALL MNG0,MNG0I
        RET

LINEZ   LD IX,WND
        LD HL,TXT1,DE,0:CALL TXTPR
        LD HL,TTM,DE,72,BC,8:CALL PRSRW
        LD A,%00011111:CALL PRIAT

        LD HL,TXT2,A,(HEI):DEC A
        LD D,A,E,0:JP TXTPR

EDTPR   PUSH IX
        LD IX,WND
        PUSH AF
        LD A,(HEI):DEC A
        LD D,A,E,26,BC,6:CALL PRSRW
        POP AF
        POP IX
        RET

LINI    LD A,INIPG:CALL MNG0
        LD BC,#DFF7,A,#B2:OUT A
        LD B,#BF:IN A

        CALL TSBC:LD A,1:RET NZ
;-------
_LD HL,WCDIR:CALL SRHDRN:LD A,2:RET Z
        LD (BRRR),HL,(BRRR+2),DE
        LD HL,BRRR:CALL GLSTCAT

_LD HL,WCINI:CALL SRHDRN:LD A,3:RET Z

        LD (BRRR),HL,(BRRR+2),DE
        LD HL,BRRR:CALL GIPAG
;-------
        CALL INILOAD:LD A,4:RET NZ
        XOR A
        RET
;---------------------------------------
INILOAD CALL INXSe

        LD DE,IDNT3,B,38
        CALL RAZ:RET NZ:INC HL

        LD DE,INIA,BC,0
INIF    LD A,D:CP INIB[:JR NC,INILE
        LD A,H:AND 1:OR L
        CALL Z,INXSE:JR Z,INILE
        LD A,(HL)
        CP #0A:JR C,INILE,Z,INiF
        CP #0D:CALL Z,SKIPE
        CP ";":CALL Z,SKIPS

        INC C:DEC C:JR NZ,INiF
        LD (DE),A
        INC DE
INiF    INC HL
        JR INIF

INILE   XOR A:LD (DE),A:RET
;-------
SKIPS   LD C,1:RET
SKIPE   LD C,0:RET
;-------
INXSE   LD A,B:CP #0F:RET Z
        PUSH BC,DE:CALL INXSe
        POP DE,BC:LD B,A
        XOR A:INC A
        RET

INXSe   LD HL,INIB,B,1
        PUSH HL:CALL LOAD512
        POP HL
        RET
;---------------------------------------
PARSING LD HL,INIA
PARS    LD A,(HL)
        CP "[":CALL Z,SUEXE:JR Z,PARS
        CALL SER13D
        LD A,(HL)
        OR A:RET Z
        LD A,H:CP INIB[:RET NC
        JR PARS

SUEXE   LD DE,STARTU:INC HL
SUfnd   LD A,(DE):INC A:RET Z
        CALL SUU:JR Z,SUexe
        JR SUfnd

SUU     PUSH HL:CALL RAZ0:INC DE
        POP HL:RET Z
        XOR A
        EX DE,HL:LD BC,16:CPIR:INC HL,HL
        EX DE,HL
        INC A
        RET

SUexe   LD A,(DE),(SUmod+1),A:INC DE
        LD A,(DE),(SUmod+2),A
SUmod   CALL 0
        XOR A
        RET
;-------
SUPL    PUSH HL
        CALL GEDZ
        LD IX,INIWND:CALL PRWOW
        POP HL

        LD DE,#0101
RSI     CALL SER13D,ICE:RET Z

        PUSH HL
        PUSH DE:CALL SERNLOD
        POP DE
        CALL NZ,PLPRNAM
        POP HL
        JR RSI
;-------
SUPAL   LD A,0:EXA:JR SUPA
SUPAR   LD A,1:EXA

SUPA    CALL SER13D,ICE:RET Z

        LD DE,PANN:CALL SUpa
        JR SUPA

SUpa    LD A,(DE):INC A:RET Z
        CALL SUU:JR Z,SUexe
        JR SUpa

CPCL    LD A,(HL):INC HL
        CP " ":JR Z,CPC
        CP "=":JR Z,CPC
        CP #0E:JR NC,CPCL
        DEC HL
        LD A,"1":JR $+3
CPC     LD A,(HL)

        LD HL,WINDOW
        EXA:OR A:JR Z,$+5:LD HL,WINDO2
        EXA
        RET
;-------
SUPAD   PUSH HL:CALL CPCL
        LD DE,29:ADD HL,DE
        SUB #30:CP 6:JR C,$+4:LD A,1
        LD (HL),A
        POP HL
        RET
SUPAI   PUSH HL:CALL CPCL
        LD DE,10:ADD HL,DE
        SUB #30:AND 1:ADD A,A
        LD (HL),A
        POP HL
        RET
SUPAS   PUSH HL:CALL CPCL
        LD DE,35:ADD HL,DE
        SUB #30:AND 3
        LD (HL),A
        POP HL
        RET

ICE     LD A,(HL)
        OR A:RET Z
        CP #0D:RET Z
        CP "["
        RET
;-------
SUL     CALL SER13D,ICE:RET Z

        LD DE,SETUP:CALL SUpa
        JR SUL
SUL1    PUSH HL:CALL CPCL
        SUB #30:AND %00000011
        LD (DFRQ),A
        POP HL
        RET
SUL2    PUSH HL:CALL CPCL
        SUB #30:AND %00000001
        LD HL,LFLT:OR (HL):LD (HL),A
        POP HL
        RET
SUL3    PUSH HL:CALL CPCL
        SUB #30
        LD HL,%0001111010000011
        JR NZ,$+5
        LD HL,%0001100101000011
        CP 2:JR NZ,$+5
        LD HL,%0010010011000011

        LD A,H,(HEI),A
        LD A,L,(TXTmdCO),A
        POP HL
        RET
SUL4    PUSH HL:CALL CPCL
        SUB #30:AND %00000001:ADD A,A
        LD HL,LFLT:OR (HL):LD (HL),A
        POP HL
        RET
;-------
SERNLOD CALL GENNAM,SRHDRN:RET Z
        LD (BRRR),HL,(BRRR+2),DE
        LD HL,BRRR:CALL GIPAG

        LD A,1:CALL LDPL2
        LD A,1:OR A
        RET
;-------
GENNAM  LD DE,LOBU+1,BC,12:LDIR
        XOR A:LD (DE),A
        LD HL,LOBU,(HL),#00
        RET
;-------
PLPRNAM PUSH DE
        LD IX,INIWND
        LD HL,LOBU+165,BC,32:CALL PRSRW
        LD A,%01110000:CALL PRIAT
        POP DE
        INC D
        RET
;---------------------------------------
SORT    XOR A:LD (SWAP+1),A
        LD A,(IX+19):OR A:JR NZ,SORD
        LD A,(IX+18):CP 2:RET C

SORD    LD A,(IX+35)
        OR A:RET Z
        DEC A:JP Z,BYNM
        DEC A:JR Z,BYEX
        DEC A:JP Z,BYSZ
        RET
;-------
DDNET   CALL CAT3
        CALL CAT1

        LD DE,0
        INC E:LD A,(DE):LD L,A
        INC E:LD A,(DE):LD H,A
.2      DEC E
        LD BC,ELN:ADD HL,BC
        LD A,"."
        CP (HL):RET NZ:INC HL
        CP (HL):RET NZ
        LD E,4
        RET
;-------
IINET   INC E:LD A,(DE),C,A
        INC E:LD A,(DE),D,A,A,C
        ADD A,FLG:JR NC,$+3:INC D:LD E,A

        INC L:LD A,(HL)
        INC L:LD H,(HL)
        ADD A,FLG:JR NC,$+3:INC H:LD L,A
        RET
;-------
BYEX    CALL DDNET
CA9     LD (C_DE),DE
        EX DE,HL

        LD (CYK+1),HL

        LD BC,5:ADD HL,BC
        LD A,(HL)
        INC L:OR (HL):RET Z
.2      DEC L

CYK3    LD DE,(CYK+1)
        LD (C_HL3+1),HL
        INC L:LD A,(HL)
        INC L:OR (HL)
.2      DEC HL
        CALL Z,SWAP:JR Z,CA9


        INC E:LD A,(DE),C,A
        INC E:LD A,(DE),B,A
        INC E:LD A,(DE),(ADDE+1),A
        LD A,C,D,B
        ADD A,FLG:JR NC,$+3:INC D:LD E,A

        INC L:LD C,(HL)
        INC L:LD B,(HL)
        INC L:LD A,(HL),(ADHL+1),A
        LD A,C,H,B
        ADD A,FLG:JR NC,$+3:INC H:LD L,A


        LD A,(DE)
        CP (HL):JP Z,BjK,NC,TZER3,C_HL3
BjK     INC HL,DE:OR A:JR Z,KPUK

        LD (JZ3+1),HL
        LD (JZ4+1),DE

        EX DE,HL
ADDE    LD BC,0:ADD HL,BC

        LD A,"."
        CP (HL):JR Z,EXda
        DEC HL:CP (HL):JR Z,EXda
        DEC HL:CP (HL):JR Z,EXda
        DEC HL:CP (HL):JR NZ,JZ3
EXda    INC HL
        EX DE,HL
ADHL    LD BC,0:ADD HL,BC

        CP (HL):JR Z,EXne
        DEC HL:CP (HL):JR Z,EXne
        DEC HL:CP (HL):JR Z,EXne
        DEC HL:CP (HL):JR NZ,JZ3
EXne    INC HL

        LD B,3
CHaK3   LD A,(DE):OR (HL):JR Z,JZ3
        LD A,(DE)
        CP (HL):JR Z,NXc3,NC,TZER3,C_HL3
NXc3    INC HL,DE:DJNZ CHaK3

JZ3     LD HL,0
JZ4     LD DE,0

KPUK    LD B,255
CHAK3   LD A,(HL),C,A
        CP #5B:JR NC,CKF3
        CP #41:JR C,CKF3:SET 5,C
CKF3    LD A,(DE)
        CP #5B:JR NC,CKS3
        CP #41:JR C,CKS3:SET 5,A
CKS3    CP C:JR Z,NXC3,NC,TZER3
C_HL3   LD HL,0
.3      INC L
        INC HL
        JP CYK3
;-------
NXC3    INC HL,DE:DJNZ CHAK3
        LD HL,(C_HL3+1)
.3      INC L
        INC HL
        JP CYK3
TZER3   LD A,1,(SWAP+1),A
        LD HL,(C_HL3+1)
        LD (CYK+1),HL

.3      INC L
        INC HL
        JP CYK3
;-------
BYSZ    CALL DDNET
CA8     LD (C_DE),DE
        EX DE,HL

        LD (CYK+1),HL

        LD BC,5:ADD HL,BC
        LD A,(HL)
        INC L:OR (HL):RET Z
.2      DEC L

CYK2    LD DE,(CYK+1)
        LD (C_HL2+1),HL
        INC L:LD A,(HL)
        INC L:OR (HL)
.2      DEC HL
        CALL Z,SWAP:JR Z,CA8

        CALL IINET

        LD A,(DE)
        CP (HL):JR Z,BJK,NC,TZER2,C_HL2
BJK     LD BC,0-(FLG-8)
        ADD HL,BC:EX DE,HL
        ADD HL,BC:EX DE,HL
        LD B,4
CHaK2   LD A,(DE)
        CP (HL):JR Z,NXc2,NC,TZER2,C_HL2
NXc2    DEC HL,DE:DJNZ CHaK2

        LD BC,ELN-4
        ADD HL,BC:EX DE,HL
        ADD HL,BC:EX DE,HL

        LD B,255
CHAK2   LD A,(DE)
        CP (HL):JR Z,NXC2,NC,TZER2
C_HL2   LD HL,0
.3      INC L
        INC HL
        JP CYK2
;-------
NXC2    INC HL,DE:DJNZ CHAK2
        LD HL,(C_HL2+1)
.3      INC L
        INC HL
        JP CYK2
TZER2   LD A,1,(SWAP+1),A
        LD HL,(C_HL2+1)
        LD (CYK+1),HL

.3      INC L
        INC HL
        JP CYK2
;-------
BYNM    CALL DDNET
CA7     LD (C_DE),DE
        EX DE,HL

        LD (CYK+1),HL

        LD BC,5:ADD HL,BC
        LD A,(HL)
        INC L:OR (HL):RET Z
.2      DEC L

CYK     LD DE,0
        LD (C_HL),HL

        INC L:LD A,(HL)
        INC L:OR (HL)
.2      DEC HL
        CALL Z,SWAP:JR Z,CA7

        CALL IINET

        LD B,255
        LD A,(DE)
        CP (HL):JR Z,NXC,NC,TZER,KP9K

CHAK    LD A,(HL),C,A
        CP #5B:JR NC,CKF
        CP #41:JR C,CKF:SET 5,C
CKF     LD A,(DE)
        CP #5B:JR NC,CKS
        CP #41:JR C,CKS:SET 5,A
CKS     CP C:JR Z,NXC,NC,TZER
KP9K
C_HL    EQU $+1:LD HL,0
.3      INC L
        INC HL
        JP CYK
;-------
NXC     INC HL,DE:DJNZ CHAK
        LD HL,(C_HL)
.3      INC L
        INC HL
        JP CYK
TZER    LD A,1,(SWAP+1),A
        LD HL,(C_HL)
        LD (CYK+1),HL

.3      INC L
        INC HL
        JP CYK
;-------
SWAP    LD A,0:OR A:JP Z,NSWA
        XOR A:LD (SWAP+1),A

        LD DE,(C_DE)
        LD HL,(CYK+1)

        LD A,(DE),C,(HL)
        LD (HL),A,A,C,(DE),A:INC L,E
        LD A,(DE),C,(HL)
        LD (HL),A,A,C,(DE),A:INC L,E
        LD A,(DE),C,(HL)
        LD (HL),A,A,C,(DE),A:INC L,E
        LD A,(DE),C,(HL)
        LD (HL),A,A,C,(DE),A

NSWA    LD HL,(C_DE)
.3      INC L
        INC HL
        EX DE,HL
        XOR A
        RET
;---------------------------------------
DINT    EI:HALT:DI
        LD HL,INTM+2,(INTM),HL
        RET
;-------
RAZ     LD A,(DE):CP (HL):RET NZ
        INC HL,DE
        DJNZ RAZ
        RET
;-------
RAZ0    LD A,(DE):CP (HL):RET NZ
        INC HL,DE
        LD A,(DE):OR A:RET Z
        JR RAZ0
;-------
;F7F XOR A:IN (#FE)
;AND %00011111:CP %00011111
;JR NZ,F7F
;RET
;---------------------------------------
C_DE    DS 2
YYY     NOP
;---------------------------------------
F9WND   DB 5+128+64,0;%00000111
        DB 23,WNY;   X,Y
        DB 32+2,WNH; W,H
        DB %01011111;PAPER+INK
        DB 0
        DW #0000;    BUFFER
        DB LN2,LN1;  LINES

        DB 1,CMX
        DB %11100100,%01011000

        DW STP
        DW 0
        DW 0

F9WN2   DB 7+128,0
        DB 23,WNY+WNH;X,Y
        DB 32+2,1+2; W,H
        DB %01011111;PAPER+INK
        DB 0
        DW #0000;    BUFFER
        DB 0,0;      LINES

        DW 0
        DW 0
        DW SSAV

F9OK    DB 7+128,0
        DB 18,13;    X,Y
        DB 42+2,1+2; W,H
        DB %01001111;PAPER+INK
        DB 0
        DW #0000;    BUFFER
        DB 0,0;      LINES

        DW 0
        DW 0
        DW SOK

SOK     DB #0E,"INI file SAVED/MERGED "
        DB "SUCCESSFULLY!!!",0

IMWND   DB 3,0
        DB 18,13;    X,Y
        DB 42+2,1+2; W,H
        DB %00011111;PAPER+INK
        DB 0
        DW #0000;    BUFFER
        DB 0,0;      LINES
;-------
INIWND  DB 3,0
        DB 19,6;     X,Y
        DB 40+2,16+2;W,H
        DB %01111111;PAP+INK
        DB 0
        DW #FFFF;    BUFFER
        DB 0,0;      LINES
;---------------------------------------
SFINI   DB #00
SFIS    DW 0,0
        DB "WC.INI",0

SPTRN   DB "[SETUP]",13
        DB "CPU_FREQ=2",13
CPFRQ   EQU $-2
        DB "SPIR=1",13
SPIR    EQU $-2
        DB "CURP=0",13
CURP    EQU $-2
        DB "TXTMD=1",13
TXTMD   EQU $-2
        DB 13
SPP1
SPTR2   DB "[LPANEL]",13
        DB "DRV=1",13
SDRV1   EQU $-2
        DB "INFO=1",13
SNFO1   EQU $-2
        DB "CSORT=1",13
SSRT1   EQU $-2
        DB 13
        DB "[RPANEL]",13
        DB "DRV=1",13
SDRV2   EQU $-2
        DB "INFO=1",13
SNFO2   EQU $-2
        DB "CSORT=1",13
SSRT2   EQU $-2
        DB 0
SPP2    DB "[PLUGINS]",#FF

STP     DB #0E,#09,"INI File Setup",0
STPL    DB #0E,"Left Panel:",0
STPR    DB #0E,"Right Panel:",0
SSAV    DB 4,4,32,#0E,"Save INI file",0
SERR    DB "Device or FAT32 NOT FOUND!"
IFM     DB "INI File ERROR:"
IFM1    EQU SERR
IFM2    DB "WC folder not found!"
IFM3    DB "WC.INI not found!"
IFM4    DB "INI file corrupted!"

SBL1    DB 2:DW SFRQ
        DB "    CPU Speed: ",0
SBL1A   DB 1:DW SDRS
        DB "Remember dirs: ",0
SBL1C   DB 1:DW SDRS
        DB "  Save Cursor: ",0
SBL1B   DB 1:DW STMD
        DB "    TEXT Mode: ",0
        DB #FF
SBL2    DB 1:DW SDRV:DB "   Driver: ",0
SBL2A   DB 1:DW SINF:DB "File Info: ",0
SBL2B   DB 1:DW SSOR:DB "  Sorting: ",0
        DB #FF
SBL3    DB 1:DW SDRV:DB "   Driver: ",0
SBL3A   DB 1:DW SINF:DB "File Info: ",0
SBL3B   DB 1:DW SSOR:DB "  Sorting: ",0
        DB #FF

SFRQ    DB 3,7
        DB "3.5 MHz"
        DB "7 MHz  "
        DB "14 MHz "
SDRS    DB 2,3
        DB "NO "
        DB "YES"
STMD    DB 3,5
        DB "80x25"
        DB "80x30"
        DB "90x36"

SDRV    DB 6,13
        DB "IDEnemoMaster"
        DB "SD(ZC)       "
        DB "SD(NGS)      "
        DB "IDEsmucMaster"
        DB "IDEsmucSlave "
        DB "IDEnemoSlave "
SINF    DB 2,8
        DB "Disabled"
        DB "Enabled "
SSOR    DB 4,7
        DB "off    "
        DB "by name"
        DB "by ext "
        DB "by size"

STARTU  DB "SETUP",0:DW SUL
        DB "PLUGINS",0:DW SUPL
        DB "LPANEL",0:DW SUPAL
        DB "RPANEL",0:DW SUPAR
        DB #FF
PANN    DB "DRV",0:DW SUPAD
        DB "INFO",0:DW SUPAI
        DB "CSORT",0:DW SUPAS
        DB #FF
SETUP   DB "CPU_FREQ",0:DW SUL1
        DB "SPIR",0:DW SUL2
        DB "CURP",0:DW SUL4
        DB "TXTMD",0:DW SUL3
        DB #FF

IDNT    DB "SpectrumProg"
IDNT2   DB "WildCommanderMDL"
IDNT3   DB "Wild Commander "
        DB "configuration file v0.2"

IVD     DB "IDE VideoDAC: "
IVDy    DB "detected"
IVDn    DB "none    "
;---------------------------------------
