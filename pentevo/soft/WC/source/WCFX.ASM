;---------------------------------------
F36     CALL F3:LD A,1:JR NZ,SBN
        CALL F4:LD A,2:JR NZ,SBN
        CALL F6:LD A,3:JR NZ,SBN
        CALL CLAVA:JR Z,F36E
        CP "r":CALL Z,SEXY

F36E    LD A,1:OR A
        RET

SBN     CP (IX+35):JR NZ,$+3:XOR A
        LD (IX+35),A
        CALL SEXY
        JR F36E

;---------------------------------------
Mark    CALL GETEN
        EXA:LD A,H:OR L:RET Z
        EXA:JR NZ,MK
        PUSH DE
        POP HL
        INC HL:LD A,(HL):CP ".":JR NZ,MK
        INC HL:LD A,(HL):CP ".":JR NZ,MK
        INC HL:LD A,(HL):OR A:RET Z
MK      EX DE,HL
        LD DE,0-FLG:ADD HL,DE
        LD A,(HL)
        OR A:LD A,1:JR Z,$+3:XOR A
        LD (HL),A

        LD L,(IX+16)
        LD H,(IX+17)
        PUSH HL
        CALL CRDN
        POP HL
        LD E,(IX+16)
        LD D,(IX+17):OR A:SBC HL,DE
        RET NZ
        CALL CURSER,WLIT
        JP CURSOR

IMrk    ;no mark (one item)
        CALL GETEN:LD A,H:OR L:RET Z
        EX DE,HL
        LD DE,0-FLG:ADD HL,DE
        LD A,(HL):XOR 1:LD (HL),A
        CALL WLIT
        XOR A:LD (MRCT+1),A
        INC A:LD (MRCT),A;  marked count
        RET

MARKSRH LD HL,0:XOR A:LD (ABT),A
        EXX:LD BC,0
RKSRH   EXX
RKSR1   LD (MRRN),HL:CALL Gwe:JR Z,ERK
        LD A,(HL):BIT 0,A
        LD HL,(MRRN):INC HL:JR Z,RKSR1
        EXX
        INC BC
        JP RKSRH

ERK     EXX
        LD HL,0
        LD (MRRN),HL
        LD (MRCT),BC
        LD A,B:OR C
        RET
;---------------------------------------
DEL64
.6      SRL D:RR E,H,L
        RET

DLT4PCH LD BC,(PBSTH+1),A,B:OR C
        LD BC,(PBSTL+1):OR B,C:RET Z

DELIT4P LD IX,0-1
NAZE    OR A
PBSTH   LD BC,0:INC IX
        EX DE,HL:SBC HL,BC:JR C,ND
PBSTL   LD BC,0
        EX DE,HL:SBC HL,BC:JR NC,PBSTH
        DEC DE
        LD A,D:INC A:JR NZ,NAZE
        LD A,E:INC A:JR NZ,NAZE
        INC DE

        ADD HL,BC
        EX DE,HL
        LD BC,(PBSTH+1)
ND      ADD HL,BC
        EX DE,HL
        PUSH IX
        POP BC
        LD A,C:ADD A,#30
        RET

DECZON4 ;i:[DE,HL] - int32
;           EXX DE - String address
;        o:Decimal string(10)

        LD BC,#CA00,(PBSTL+1),BC
        LD BC,#3B9A,(PBSTH+1),BC
        CALL DELIT4P
        EXX:LD (DE),A:INC DE:EXX

        LD BC,#E100,(PBSTL+1),BC
        LD BC,#05F5,(PBSTH+1),BC
        CALL DELIT4P
        EXX:LD (DE),A:INC DE:EXX

        LD BC,#9680,(PBSTL+1),BC
        LD BC,#0098,(PBSTH+1),BC
        CALL DELIT4P
        EXX:LD (DE),A:INC DE:EXX

        LD BC,#4240,(PBSTL+1),BC
        LD BC,#000F,(PBSTH+1),BC
        CALL DELIT4P
        EXX:LD (DE),A:INC DE:EXX

        LD BC,#86A0,(PBSTL+1),BC
        LD BC,#0001,(PBSTH+1),BC
        CALL DELIT4P
        EXX:LD (DE),A:INC DE:EXX
;-------
DECZON2 LD BC,10000,(PBSTL+1),BC
        LD BC,0,(PBSTH+1),BC
        CALL DELIT4P
        PUSH HL
        EXX:LD (DE),A:INC DE
        POP HL
DECZ2   LD BC,1000
        CALL DELIT
        LD (DE),A:INC DE
DECZ1   LD BC,100
        CALL DELIT
        LD (DE),A:INC DE
DECZ    LD C,10
        CALL DELIT
        LD (DE),A:INC DE
        LD C,1
        CALL DELIT
        LD (DE),A:INC DE
        RET
;-------
DELIT   LD A,#FF
        OR A
DLIT    INC A
        SBC HL,BC:JP NC,DLIT
        ADD HL,BC,A,#30
        RET
;---------------------------------------
STATUS  XOR A:LD HL,STUS:CP (HL):RET Z
        LD (HL),A

        LD E,(IX+18)
        LD D,(IX+19)
        CALL PBINIT
        LD L,(IX+16)
        LD H,(IX+17)
        CALL PBPRINT

        CALL ARAP
        LD A,(IX+10):CP 2:RET NZ

        CALL GETEN

        EXA
        LD HL,ENTRY,DE,LOBU,BC,8:LDIR
        LD A," ",(DE),A:INC DE
        LD C,3:LDIR
        LD (DE),A:INC DE
        EXA

        LD HL,SDIR:JR Z,$+5:LD HL,SFIL
        LD C,5:LDIR

        LD A,32
.7      LD (DE),A:INC DE

        EXX
        LD HL,(ARRR),DE,(ARRR+2)
        PUSH IX
        CALL DECZON4
        POP IX

        DEC DE
        LD HL,DE,BC,0-9:ADD HL,BC

        LD B,10,A,#30
DZF     CP (HL):JR NZ,DzF
        LD (HL),32:INC HL
        DJNZ DZF
DzF     LD HL,DE
.3      INC DE
        LD A,32
        LD BC,3:LDDR
        LD (DE),A:DEC DE
        LD C,3:LDDR
        LD (DE),A:DEC DE
        LD C,3:LDDR
        LD (DE),A:DEC DE
        LD A,(HL),(DE),A

        LD A,(IX+5):SUB 2
_LD HL,LOBU,D,A,E,1,BC,38:JP PRSRW
;-------
R2B2    CALL ENKE:JP NZ,EXTZEL
        CALL F3:JP NZ,EXTZEL
        LD A,1:OR A
        RET
;-------
F12     CALL F1:JR NZ,SLM
        CALL F2:JR NZ,SRM
        JR BER
;-------
SLM     LD HL,WINDOW:JR $+5
SRM     LD HL,WINDO2

        CALL SXM:INC B:JR Z,BER
        PUSH IX
        LD IX,(IXHL),(IX+29),A,(IX+28),0
        CALL DRACT,ORIGA
        POP IX
        CALL DRACT

BER     LD A,1:OR A
        RET
;-------
SXM     ;i:HL - SOW, IX - SOW(now)
;        o: A - CurPoz-1

        PUSH IX
        PUSH HL:CALL CURSER:POP HL
        LD (IXHL),HL
        PUSH HL
        POP IY
        LD IX,DSWND

        LD A,(IY+2):ADD A,2:LD (IX+2),A
        LD A,(IY+3):ADD A,2:LD (IX+3),A

        LD A,(IY+29):INC A:LD (IX+12),A
        CALL PRWOW

SMC     EI:HALT:CALL CURSOR
        CALL UPPP,NZ,CrUP
        CALL DWWW,NZ,CrDN

        CALL ESC:LD B,#FF:JR NZ,AMC
        CALL ENKE:JR Z,SMC
        LD B,0
AMC     PUSH BC
        CALL RRESB
        POP BC
        LD A,(IX+12):DEC A
        POP IX
        RET
;---------------------------------------
HELP    PUSH IX
        LD IX,HPWND:CALL PRWOW

        CALL Confa

        CALL USPO
        CALL NUSP

        CALL RRESB
        POP IX
        RET
;-------
Confa   CALL FROZEN
        LD HL,LOBU+16,B,32:CALL NOPING
        LD HL,LOBU,DE,LOBU+16,BC,12:LDIR
        CALL ROZEN

_LD HL,LOBU+16,DE,#0307,BC,28:CALL PRSRW
        LD A,%01110001:CALL PRIAT
        LD HL,IVD,DE,LOBU,BC,14:LDIR
        LD A,(CNFv)
        LD HL,IVDy
        OR A:JR NZ,$+5:LD HL,IVDn
        LD BC,8:LDIR
_LD HL,LOBU,DE,#040B,BC,22:CALL PRSRW
        LD A,%01110000:CALL PRIAT
        RET
;-------
ROZEN   LD A,(HL):AND %00011111
        PUSH HL
        LD L,A,H,0
        CALL DECZ:LD A,".",(DE),A:INC DE
        POP HL

        LD A,(HL):INC HL
        SRL (HL):RRA
.4      SRL A
        PUSH HL:LD L,A,H,0:CALL DECZ
        POP HL
        EX DE,HL
        LD (HL),".":INC HL
        LD (HL),"2":INC HL
        LD (HL),"0":INC HL
        EX DE,HL

        LD A,(HL):AND %00111111
        PUSH HL:LD L,A,H,0:CALL DECZ
        POP HL
        BIT 6,(HL):RET NZ
        INC DE
        LD HL,BETA,BC,4:LDIR
        RET
;-------
FROZEN  LD BC,#DFF7,A,#F0,E,A:OUT A
        LD B,#BF:XOR A:OUT A

        LD HL,LOBU
FRZ     LD B,#BF:INI:INC E:JR Z,FrZ
        LD B,#DF:OUT E
        JR FRZ
FrZ     LD B,#BF,A,2:OUT A
        RET
;---------------------------------------
COPY    CALL CURSER
        CALL MARKSRH,Z,IMrk:RET Z

        CALL CPDI

TERM    CALL SWPPAND
        LD DE,BRRR:CALL TLSTCAT
        CALL PANELI,FOLD
        CALL SWPPAND
        RET
;*******
CPDI    PUSH IX
        LD IX,F5WND:CALL PRWOW
        LD HL,TXT8,DE,#0000:CALL TXTPR

        LD HL,(MRCT)
        LD DE,TXTD7:CALL DECZ2
        LD HL,TXT9,DE,#020A:CALL TXTPR

        LD A,1:CALL YN
CPM     EI:HALT
        XOR A:CALL YN

        CALL ENKE:JR NZ,CPGO
        CALL ESC:JR Z,CPM

CPet    CALL RRESB
        POP IX
        RET
;-------
CPGO    LD A,#FF:CALL YN:JR NZ,CPet
        POP IX

        LD HL,0
LENIN   PUSH HL
        CALL GETen
        EXA:LD A,H:OR L:JR Z,CPgo
        EXA:BIT 0,(HL):LD (HL),0
        CALL NZ,COPYF:JR NZ,CPgo
        POP HL
        INC HL
        JR LENIN

CPgo    POP HL
        PUSH IX
        LD IX,F5WND:CALL RRESB
        POP IX

        JP WLIT
;*******
FLOF    CALL NAMEBG

        XOR A
        LD DE,LOBU+512
        LD BC,#26FF
FLOf    LDI:CP (HL):JR Z,$+4:DJNZ FLOf
        LD A,B:OR A
        EX DE,HL:CALL NZ,NOPING

        PUSH IX
        LD IX,F5WND

        LD HL,(MRRN):INC HL:LD (MRRN),HL
        LD DE,TXT10+2:CALL DECZ2
        LD HL,(MRCT)
        LD DE,TXT10+8+2:CALL DECZ2
        LD HL,TXTBU,B,32
_PUSH HL:CALL NOPING
_POP HL:LD DE,#0201,BC,32:CALL PRSRW
_LD HL,TXT10,DE,#0200:CALL TXTPR

        LD HL,LOBU+512
        LD DE,#0101,BC,#26:CALL PRSRW
        LD A,%01110000:CALL PRIAT
        POP IX

        LD A,(ABT):OR A
        RET

NAMEBG  EX DE,HL
        LD DE,LOBU+4
        LD A,(HL):AND #10
        XOR #10:LD (DE),A
        INC HL,DE
        PUSH HL:LD BC,256:LDIR
        POP HL
        RET
;---------------------------------------
FEEM    CP 1:LD HL,TER2B:RET Z
        CP 2:LD HL,TER2C:RET Z
        CP 3:LD HL,TER2D:RET Z
        CP 4:LD HL,TER2D:RET Z
        CP 8:LD HL,TER2A:RET Z
        CP 16:LD HL,TER2:RET Z
        LD HL,TER2X
        RET
;-------
RER0    CALL FEEM:JP ERR0
;-------
CE1     LD HL,TER2A
        JR CE0
CER0    CALL FEEM
        PUSH HL:CALL SWPPAND
        POP HL
CE0     CALL ERR0
CEX     LD A,1:OR A
        RET
;-------
COPYF   OR A:JR Z,DIRCOPY
        CALL FLOF,NZ,ABME:JR NZ,CEX

COPYFD  LD HL,LOBU+4
        CALL FENTRY:JR Z,CE1
        LD A,(LOBU+4),(LOBU),A
        LD (LOBU+1),HL
        LD (LOBU+3),DE
        CALL GFILE

        CALL SWPPAND

        LD HL,LOBU
        CALL MKfile:JR NZ,CER0

        LD A,BUFPG:CALL MNGC
        CALL PBSHW
SVNG    CALL PBPR

        CALL SWPPAND
        LD HL,#C000
        LD B,32:CALL LOAD512

        CALL SWPPAND
        LD HL,#C000
        LD B,32:CALL SAVE512
        CP #0F:JR NZ,SVNG

        CALL PBHTW

        CALL SWPPAND
        XOR A
        RET

ERALT   CALL LOADCD2
        CALL SWPPAND
        CALL LOADCD
        LD A,1:OR A
        RET

DIRCOPY CALL FLOF,NZ,ABME:JR NZ,CEX

        CALL SAVECD
        CALL SWPPAND,SAVECD2
        CALL SWPPAND

        LD HL,#C000,(DDIRS+1),HL
;!!!
ZANOVOC CALL RECBUF
        LD DE,2
        LD (HL),E:INC L
        LD (HL),D

        LD HL,LOBU+4
        CALL FENTRY:JP Z,ERMAIN
        CALL GDIR

        CALL SWPPAND
        LD HL,LOBU+4
        PUSH HL
        INC HL:CALL MKdir
        POP HL:JR NZ,ERALT
        CALL FENTRY:JR Z,ERALT
        CALL GDIR
        CALL SWPPAND

        CALL CLONEZ
        LD DE,LOBU+1024
        PUSH DE:XOR A:CALL NXTETY2
        POP DE:XOR A:CALL NXTETY2

IDXLOOP CALL RECBUF
        LD HL,(DDIRS+1)
        LD E,(HL):INC L
        LD D,(HL)
        INC DE
        LD (HL),D:DEC L
        LD (HL),E

        CALL CLPG
        LD DE,LOBU+4
        XOR A:CALL NXTETY2,CLONOFF
        JR Z,DCUPP

        LD HL,LOBU+4
        LD A,(HL):AND #10:JR NZ,DCIN
        LD (HL),A
        CALL COPYFD:JR NZ,ERMAIN
        LD A,(ABT)
        OR A:CALL NZ,ABME:JR NZ,ERMAIN
        JR IDXLOOP

DCIN    LD HL,(DDIRS+1):INC HL,HL
        LD (DDIRS+1),HL
        JP ZANOVOC

DCUPP   LD HL,(DDIRS+1)
        LD A,L:OR A:JR NZ,TEKK
        LD A,H:CP #C0:JR Z,CDIREX

TEKK    DEC HL,HL
        LD (DDIRS+1),HL

        LD HL,UPDIR
        CALL FENTRY:JR Z,ERMAIN
        CALL GDIR

        CALL SWPPAND
        LD HL,UPDIR
        CALL FENTRY:JP Z,ERALT
        CALL GDIR
        CALL SWPPAND

        CALL CLONEZ
        CALL RECBUF
        LD HL,(DDIRS+1)
        LD C,(HL):INC L
        LD B,(HL)
LOOPUP  LD DE,LOBU+1024
        PUSH BC
        CALL CLPG
        XOR A:CALL NXTETY2,CLONOFF
        POP BC:JR Z,ERMAIN
        DEC BC:LD A,B:OR C:JP Z,IDXLOOP
        JP LOOPUP
;!!!
CDIREX  CALL LOADCD
        CALL SWPPAND,LOADCD2
        CALL SWPPAND

        XOR A
        RET

ERMAIN  CALL CDIREX:INC A
        RET

RECBUF  LD A,TVBPG:JP MNGC
SWPPAND CALL SWPPAN:JP DRACT
SAVECD2 LD DE,ERRR:JP TLSTCAT
LOADCD2 LD HL,ERRR:JP GLSTCAT
CLONEZ  LD A,(PG0),(FEP2),A
        LD HL,#3000,DE,HL
        LD B,7:CALL PDIT
        LD B,255:CALL PDIN
        JP CLONE
CLONOFF LD A,(FEP2):JP MNG0
;*******
MkDir   CALL CURSER
        PUSH IX
        LD IX,MDWND:CALL PRWOW

        LD HL,TXT6,DE,#0000:CALL TXTPR
        LD HL,TCT0,DE,#0101:CALL TXTPR

        LD DE,#0106:CALL GADRW
        LD (BMKD+1),HL
        LD DE,#2100,A,#FF:CALL ISTR
        LD HL,#0100,A,#FE:CALL ISTR
MKD     EI:HALT
        CALL ESC:JR NZ,EMKD
        CALL ENKE:JR NZ,BMKD

        XOR A:CALL ISTR
        LD A,3:CALL ISTR
        JR MKD
;-------
BMKD    LD HL,0
        LD DE,LOBU,BC,38-5:LDIR
        XOR A:LD (DE),A

        LD HL,LOBU:CALL MKdir:JR Z,DMKD

        LD HL,TER2F:CALL ERR0

DMKD    CALL RRESB
        POP IX

SEXY    LD DE,BRRR:CALL TLSTCAT
        CALL PANELI,FOLD
        XOR A
        RET
;-------
EMKD    CALL RRESB
        POP IX
        RET
;*******
Move    CALL GETEN:LD A,H:OR L:RET Z
        INC DE:LD A,(DE):CP ".":JR NZ,RN
        INC DE:LD A,(DE):CP ".":JR NZ,Rn
        INC DE:LD A,(DE):OR A:RET Z
        DEC DE
Rn      DEC DE
RN      DEC DE

        CALL NAMEBG

        CALL CURSER
        CALL RENAME:RET Z

        LD HL,LOBU+4
        LD DE,LOBU+512
        CALL RENAM,Z,RER0
        JP SEXY
;-------
RENAME  PUSH IX
        PUSH DE
        LD HL,MDWND,DE,WINDC,BC,12:LDIR

        LD E,(IX+2)
        LD D,(IX+3)
        LD A,(IX+12):DEC A

        LD IX,WINDC
        LD (IX+1),0
        LD (IX+2),E
        ADD A,D:LD (IX+3),A

        CALL PRWOW
        LD HL,TXT7,DE,#0000:CALL TXTPR

        CALL MMM
        LD HL,255:EXX
        LD HL,LOBU+512
        LD DE,#0101
        LD BC,#2600
        LD A,#FD:CALL ISTR
        LD HL,#0100,A,#FE:CALL ISTR
REN     EI:HALT
        CALL ESC:JR NZ,REM
        CALL ENKE:JR NZ,TRIGUN

        XOR A:CALL ISTR
        LD A,2:CALL ISTR
        LD A,3:CALL ISTR
        JR REN

MMM     LD HL,LOBU+4+1
        LD DE,LOBU+512
        XOR A
        LD BC,#FFFF
MmM     LDI:CP (HL):JR Z,$+4:DJNZ MmM
        EX DE,HL:LD A," ":JP NOPING+1

TRIGUN  LD A,1:CALL ISTR

        LD DE,LOBU+512+255
        LD B,255
TGN     DEC DE:LD A,(DE)
        CP " ":JR NZ,$+4:DJNZ TGN
        INC DE:XOR A:LD (DE),A

        CALL RRESB
        POP DE
        POP IX
        LD A,1:OR A
        RET

REM     LD A,1:CALL ISTR
        CALL RRESB
        POP DE
        POP IX
        XOR A
        RET
;---------------------------------------
DelFl   CALL CURSER
        CALL MARKSRH,Z,IMrk:RET Z

        CALL DLDI:RET Z

        LD DE,BRRR:CALL TLSTCAT
        CALL PANELI,FOLD
        RET

DELDIR  CALL SAVECD

        LD HL,LOBU+4
        CALL FENTRY:JP Z,DER0
        CALL GDIR

        LD DE,LOBU+1024
        CALL NXTETY:JR Z,NED
        CALL NXTETY:JR Z,NED
        CALL NXTETY:JR NZ,NED

        CALL LOADCD
        LD HL,LOBU+4:CALL FNDELFL
        JP SEXY

NED     LD HL,TER30:CALL ERR0
        CALL LOADCD
        JP SEXY

DLDI    PUSH IX
        LD IX,F5WND:CALL PRWOW
        LD HL,TXTB,DE,#0000:CALL TXTPR

        LD HL,(MRCT)
        LD DE,TXTD7:CALL DECZ2
        LD HL,TXTD,DE,#0200:CALL TXTPR

        LD A,1:CALL YN
DLM     EI:HALT
        XOR A:CALL YN

        CALL ENKE:JR NZ,DLGO
        CALL ESC:JR Z,DLM

DLet    CALL RRESB
        POP IX

        XOR A
        RET
;-------
DLGO    LD A,#FF:CALL YN:JR NZ,DLet
        LD HL,TXTE,DE,#0400:CALL TXTPR
        POP IX

        LD HL,0
LENIN2  PUSH HL
        CALL GETen
        EXA:LD A,H:OR L:JR Z,DLgo
        EXA:BIT 0,(HL):LD (HL),0
        CALL NZ,DELF:JR NZ,DLgo
        POP HL
        INC HL
        JR LENIN2

DLgo    POP HL
        PUSH IX
        LD IX,F5WND:CALL RRESB
        POP IX

DER0    LD A,1:OR A
        RET
;-------
DELF    OR A:JR Z,DIRTREM
        CALL FLOF,NZ,ABME:JR NZ,DER0

        LD HL,LOBU+4
        CALL DELFL:JR Z,DER0

        XOR A
        RET
;-------
DIRTREM ;DIR total remove

        CALL FLOF,NZ,ABME:JR NZ,DER0

        CALL SAVECD
        LD HL,#C000,(DDIRS+1),HL
;!!!
        LD HL,LOBU+4
ZANOVO  CALL FENTRY:JP Z,DTRER0
        CALL GDIR
        CALL CLONEZ

DFILES  CALL CLPG
        LD DE,LOBU+1024
        LD A,1:CALL NXTETY2,CLONOFF
        JR Z,DDIRZ
        LD HL,LOBU+1024
        LD A,(HL):AND #10:LD (HL),A
        CALL DELFL:JR Z,DTRER0
        LD A,(ABT)
        OR A:CALL NZ,ABME:JR NZ,DTRER0
        JR DFILES

DDIRZ   ;CALL GDIR
        CALL RECBUF
DDIRS   LD DE,0

        LD A,2
        PUSH DE:CALL NXTETY2:POP DE
        LD A,2
        PUSH DE:CALL NXTETY2:POP DE

        LD A,2
        PUSH DE:CALL NXTETY2
        POP HL:JR Z,NODIRS
        EX DE,HL
        PUSH HL:OR A:SBC HL,DE
        POP BC:JR C,DTRER0
        LD A,H:OR A:JR NZ,DTRER0
        LD A,L,(BC),A:INC BC
        LD (DDIRS+1),BC

        EX DE,HL
        LD A,(HL):AND #10:LD (HL),A
        JR ZANOVO

NODIRS  LD HL,UPDIR
        CALL FENTRY:JR Z,DTRER0
        CALL GDIR

        LD HL,(DDIRS+1)
        LD A,L:OR A:JR NZ,NDR
        LD A,H:CP #C0:JR Z,DDIREX
NDR     DEC HL
        LD C,(HL),B,0
        OR A:SBC HL,BC
        LD (DDIRS+1),HL

        CALL FNDELFL:JR Z,DTRER0
        JP DDIRS
;!!!
DDIREX  CALL LOADCD
        CALL DELDIR:RET NZ

        XOR A
        RET

DTRER0  CALL LOADCD
        LD A,1:OR A
        RET
;---------------------------------------
ABME    PUSH IX
        LD IX,ABWND:CALL PRWOW

_LD HL,TXTF,DE,#0000:CALL TXTPR
_LD HL,TXTG,DE,#0200:CALL TXTPR

        CALL USPO
MMEN    LD A,1:CALL YN
ABM     EI:HALT:XOR A:CALL YN
        CALL ESC:JR NZ,ESCABM
        CALL ENKE:JR Z,ABM

        CALL RRESB

        LD A,#FF:CALL YN
        LD A,#01:JR Z,$+3
ABMM    XOR A
        POP IX
        LD (ABT),A:OR A
        RET

ESCABM  CALL USPO
        CALL RRESB:JR ABMM
;*******
DLME    PUSH IX
        PUSH HL,DE,BC
        LD IX,ABWND:CALL PRWOW
        POP BC,DE,HL:CALL TXTPR
        JR MMEN
;---------------------------------------
PBSHW   PUSH IX
        LD A,(PGC)
        PUSH AF
        LD IX,PBWND:CALL PRWOW
        LD HL,(ENTRY+28)
        LD DE,(ENTRY+30)
        CALL DEL64
        LD (PBSTL+1),HL
        LD (PBSTH+1),DE
        LD HL,0,(PBNOW),HL,(PBNOW+2),HL
        POP AF
        CALL MNGC
        POP IX
        RET
PBHTW   PUSH IX
        LD IX,PBWND:CALL RRESB
        POP IX
        RET
;-------
PBPR    PUSH IX
        LD A,(PGC)
        PUSH AF
        XOR A:CALL MNGC

        LD HL,(PBNOW)
        LD DE,(PBNOW+2)
        LD BC,16384
        ADD HL,BC:JR NC,$+3:INC DE
        LD (PBNOW),HL
        LD (PBNOW+2),DE

        CALL DLT4PCH

        LD HL,TXTBU
        LD A,C,C,64
        OR A:JR NZ,$+5:LD A,C:JR DoL
        CP C:JR C,$+3:LD A,C
        LD B,A
        LD A,C:SUB B

        LD C,#DB
        LD (HL),C:INC HL:DJNZ $-2

        OR A:JR Z,DOL
DoL     LD B,A,C,#B1
        LD (HL),C:INC HL:DJNZ $-2
DOL
_LD IX,PBWND
_LD HL,TXTBU,DE,#0101,BC,64:CALL PRSRW
        POP AF
        CALL MNGC
        POP IX
        RET
;-------
ERR0    ;i:HL - TEXT Message

        PUSH IX
        PUSH HL:LD IX,ERWND:CALL PRWOW
        POP HL

        LD DE,#0201:CALL TXTPR

        CALL USPO
        CALL NUSP

        CALL RRESB
        POP IX
        RET
;---------------------------------------
F2MENU  LD BC,#1112+1:JR EDT
;---------------------------------------
EDIT    CALL GETEN:RET Z
        LD A,H:OR L:RET Z

        CALL TOBUX

        LD HL,BRRR:CALL GIPAG
        LD BC,#1315+1
;-------
EDT     LD A,PLHPG:CALL MNGC

        LD DE,#C000+197-512
MTK     LD HL,(PHED)
        OR A:SBC HL,DE:RET C

        LD HL,512:ADD HL,DE:EX DE,HL
        LD A,(DE)
        CP B:JR C,MTK
        CP C:JR NC,MTK

        LD A,B:INC A
        LD BC,0-197
        LD (NYAA),A:CALL PLGE
        XOR A:LD (NYAA),A
        RET
;-------
TOBUX   EX DE,HL:INC HL
        LD DE,BUX
        LD BC,256:LDIR
        RET
;---------------------------------------
