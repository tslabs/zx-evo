;SD Card Driver for NGS
;(C) BUDDER/MGN 2015

        ORG #3800,#6000
;---------------------------------------
GSCOM   EQU #BB
GSDAT   EQU #B3
;---------------------------------------
GAFF    JP SELDEV
        JP NGSINI
        JP REINI

        JP XPOZI
        JP PROZ

        JP RDDSE
        JP SDDSE

        JP RDD256

.16     DS 3
;---------------------------------------
NSDC    NOP
EOC     NOP

ABT     NOP

BZN     DB 4
NR0     DW 4

CAHL    DS 2
CADE    DS 2

LSTSE   DS 4

REZDE   DS 2

PR      DS 4

CLHL    DS 2
CLDE    DS 2

LLHL    DS 4

LTHL    DS 2;LAST
LTDE    DS 2
;---------------------------------------
ENTRY   DS 11
EFLG    DB 0,0
        DB #00;ms
        DW #0000:DW #0000;time,date
        DW #0000;acc date
CLSDE   DS 2
        DW #0000:DW #0000;time,date
CLSHL   DS 2
SIZIK   DS 4
        NOP
;---------------------------------------
BREZS   DS 2;+14          FAT PARAMETERS
FSINF   DS 4;[+48(2)]+[ADDTOP]

BFATS   NOP
BFTSZ   DS 4
BSECPC  DS 2;USE 1
BROOTC  DS 4

FSTFRC  DW 2,0

ADDTOP  DS 4

SFAT    DS 2
SDFAT   DS 4

CUHL    DS 2
CUDE    DS 2

NXDE    DS 2
NXHL    DS 2

LDHL    DS 2

COUNT   NOP
DUHL    DS 2
DUDE    DS 2

DUBA    NOP
UUHL    DS 2
BUHL    DS 2
GARY    DS 2;AAA
CLCNT   DS 2
FCTS    DS 4
BUTS    DS 4

LSTCAT  DS 4
RECCAT  DS 4
;---------------------------------------
BLKNUM  DS 4
;---------------------------------------
SENDCOM OUT (GSCOM),A
GSWC    IN A,(GSCOM)
        RRCA:JR C,GSWC
        RET

SENDDAT OUT (GSDAT),A
GSWD    IN A,(GSCOM)
        RLCA:JR C,GSWD
        RET ;       DB #03,#20:DB 0:DS 2
;---------------------------------------
NGSINI
FANK    LD A,#20:OR A:RET NZ

        LD A,#20:CALL SENDCOM
        IN A,(GSDAT)
        OR A
REINI   RET

SELDEV  LD A,#80:OUT (#33),A
        EI
.2      HALT
        LD A,#F3:OUT (GSCOM),A
        CALL DIK:JR Z,WSE

        XOR A:OUT (GSDAT),A
        LD A,#1D:OUT (GSCOM),A

        CALL DIK:JR Z,WSE

        IN A,(GSDAT)
        CP #8B:LD A,1:JR NZ,WSE

        XOR A:OUT (GSDAT),A
        LD A,#14:CALL SENDCOM;LOAD memBL
        LD A,#04:CALL SENDDAT; len #0400

        XOR A:CALL SENDDAT;   to  ADDRES
        LD A,#40:CALL SENDDAT;#4000 inGS

        LD HL,TOGS,BC,#0400
WAV     LD A,(HL):CALL SENDDAT:INC HL
        DEC BC:LD A,B:OR C:JR NZ,WAV

        XOR A:OUT (GSDAT)
        LD A,#13:CALL SENDCOM;JPtoADDRES
        LD A,#40:CALL SENDDAT;#4000 inGS

        XOR A:OUT (GSCOM),A
        DEC A
WSE     INC A
        LD (FANK+1),A
        RET

DIK     LD B,#30
D_K     HALT:HALT
        DEC B:LD A,1:RET Z
        IN A,(GSCOM):RRA:JR C,D_K
        XOR A:INC A
        RET
;---------------------------------------
XPOZI   LD (LTHL),HL,(LTDE),DE
PROZ    LD (BLKNUM),HL,(BLKNUM+2),DE
        RET
;---------------------------------------
SNDPAR  LD DE,(BLKNUM);BC(BLKNUM+2)

        OUT (#B3),A
        PUSH AF
        LD A,B:CALL SENDCOM

        LD A,E:CALL SENDDAT
        LD A,D:CALL SENDDAT
        LD A,(BLKNUM+2):CALL SENDDAT
        LD A,(BLKNUM+3):CALL SENDDAT
        XOR A:OUT (#BB),A,(#B3),A
        LD E,A
        POP AF

        LD D,A
RDD256  RET

RDDSE   LD B,#10:CALL SNDPAR
LAWL    IN A,(#BB):RLCA:JR NC,$-3
        LD B,128
SGI     IN A,(#BB):RLCA:JR NC,$-3
        IN A,(#B3):LD (HL),A:INC HL
        IN A,(#BB):RLCA:JR NC,$-3
        IN A,(#B3):LD (HL),A:INC HL
        IN A,(#BB):RLCA:JR NC,$-3
        IN A,(#B3):LD (HL),A:INC HL
        IN A,(#BB):RLCA:JR NC,$-3
        IN A,(#B3):LD (HL),A:INC HL
        DJNZ SGI
        DEC D:JR NZ,LAWL

        XOR A
        JP SENDCOM

SDDSE   LD B,#12:CALL SNDPAR
LOL     IN A,(#BB):RLCA:JR C,$-3
        LD A,(HL):OUT (#B3),A:INC HL
        IN A,(#BB):RLCA:JR C,$-3
        LD A,(HL):OUT (#B3),A:INC HL
        DEC DE:LD A,E:OR D:JR NZ,LOL
        JP SENDCOM
;-------
UDAFF
;---------------------------------------
;---------------------------------------
SCTRL   EQU #11;sdMASK=#01 BITset=#80
SD_SEND EQU #13
SD_RSTR EQU #14
;---------------------------------------
CMD_1   EQU %01000000+1; init
CMD_12  EQU %01000000+12;Stop Transmiss
CMD_16  EQU %01000000+16;Block Size
CMD_17  EQU %01000000+17;Single Read
CMD_24  EQU %01000000+24;Single Write
ACMD_41 EQU %01000000+41;init (SDC only)
CMD_55  EQU %01000000+55;app CMD
CMD_58  EQU %01000000+58;Read OCR
;---------------------------------------
SEC_BUF EQU #5000
;-------
TOGS    ORG #4000,#6000+UDAFF-GAFF
        DI
        LD SP,#6000
        LD A,%00000000:OUT (#0F),A
;bit0 - 0/1 = ROM+RAM/RAMonly
;bit1 - RO mode for #0000-#7FFF (abs.)
;bit2 - 0/1 = 4/8 chan mode
;bit3 - paging mode (0=orig from GS)
;bit4,5 - Z80 clocs (00=24MHz, 11=10MHz)
;bit6,7 - reserved

CMD_STR IN A,(#05)
CMD_CHK IN A,(#04):RRCA:JR NC,$-3
        IN A,(#01)
        OR A:JR Z,CMD_STR
        CP #10:JR Z,RD_SEC
        CP #12:JP Z,SV_SEC
        CP #20:JR Z,SDINI
        CP #F3:JP Z,0
        CP #F4:JP Z,0
        JR CMD_CHK
;---------------------------------------
SDINI   CALL SD_INIT
        OUT (#03),A
        JR CMD_STR
;-------
RD_SEC  CALL RD_PAR
;DE=(BLKNUM),BC=(BLKNUM+2),L-COUNT
        IN A,(#02)
        LD A,L

RDGS    PUSH AF
        LD HL,SEC_BUF
        PUSH DE,BC
        CALL RDSINGL
        POP BC,DE
        INC DE
        LD A,D:OR E:JR NZ,$+3:INC BC

        LD HL,SEC_BUF
ORIGA   IN A,(#04):RLCA:JR C,$-3
        LD A,(HL):OUT (#03),A:INC L
        IN A,(#04):RLCA:JR C,$-3
        LD A,(HL):OUT (#03),A:INC L
        IN A,(#04):RLCA:JR C,$-3
        LD A,(HL):OUT (#03),A:INC L
        IN A,(#04):RLCA:JR C,$-3
        LD A,(HL):OUT (#03),A:INC L
        IN A,(#04):RLCA:JR C,$-3
        LD A,(HL):OUT (#03),A:INC L
        IN A,(#04):RLCA:JR C,$-3
        LD A,(HL):OUT (#03),A:INC L
        IN A,(#04):RLCA:JR C,$-3
        LD A,(HL):OUT (#03),A:INC L
        IN A,(#04):RLCA:JR C,$-3
        LD A,(HL):OUT (#03),A:INC HL
        LD A,H:CP #52:JR C,ORIGA

        POP AF
        DEC A:JR NZ,RDGS
        JP CMD_STR
;-------
SV_SEC  CALL RD_PAR
        IN A,(#02)
        LD A,L

SVGS    PUSH AF
        LD HL,SEC_BUF
ORIGA2  IN A,(#04):RLCA:JR NC,$-3
        IN A,(#02):LD (HL),A:INC L
        IN A,(#04):RLCA:JR NC,$-3
        IN A,(#02):LD (HL),A:INC HL
        LD A,H:CP #52:JR C,ORIGA2

        LD HL,SEC_BUF
        PUSH DE,BC
        CALL SVSINGL
        POP BC,DE
        INC DE
        LD A,D:OR E:JR NZ,$+3:INC BC

        POP AF
        DEC A:JR NZ,SVGS
        JP CMD_STR
;------------------
RD_PAR  IN A,(#05);       command ACCEPT
        IN A,(#02):LD L,A:CALL WTD
        IN A,(#02):LD E,A:CALL WTD
        IN A,(#02):LD D,A:CALL WTD
        IN A,(#02):LD C,A:CALL WTD
        IN A,(#02):LD B,A
WTD     IN A,(#04)
        RLCA:RET C
        JR WTD
;=======================================
READS   PUSH BC,DE
        LD BC,SD_RSTR
        INIR
        INIR

        IN A:DS 2
        IN A
        POP DE,BC
        RET
;-------
SAVDS   PUSH BC,DE
        LD BC,SD_SEND,A,#FE

        OUT A:DS 2
        OTIR
        OTIR

        LD A,#FF
        OUT A:DS 2
        OUT A
        POP DE,BC
        RET
;---------------------------------------
;i:HL - Address
;   A - Sectors
RDSINGL CALL CMD17:JR NZ,$
        CALL WTDO:CP #FE:JR NZ,$
        CALL READS,SNB
        CALL WTBY
        JP CSH

SVSINGL LD A,B:OR C,D,E,A,3:RET Z

        CALL CMD24:JR NZ,$
        CALL SAVDS,DRESP,SNB
        CALL WTBY
        JP CSH
;---------------------------------------
CMD00   DB %01000000+0:DS 4:DB #95
CMD08   DB %01000000+8,0,0,1,#AA,#87
CMD16   DB %01000000+16,0,0,2,0,#FF
;---------------------------------------
SD_INIT CALL CSH
        LD DE,512+10:CALL CYCL

        LD DE,8000
SDWT    DEC DE:LD A,D:OR E:JP Z,NOSD
        CALL CMD0:JR NZ,SDWT
        DEC A:JR NZ,SDWT

        CALL CMD8
        PUSH AF
.2      IN E:DS 2
        IN H:DS 2
        IN L
        POP AF:JR NZ,SDWT
        BIT 2,A:JR Z,SDNEW
;-------
SDOLD   LD DE,8000
AA      DEC DE:LD A,D:OR E:JR Z,LC
        LD H,0
        CALL ACMD41:JR NZ,AA
        CP 1:JR Z,AA
        OR A:JR NZ,LC
;SDV1 Detected
        JR FBS
;-------
LC      LD DE,8000
OO      DEC DE:LD A,D:OR E:JR Z,NOSD
        CALL CMD1:JR NZ,OO
        CP 1:JR Z,OO
        OR A:JR NZ,NOSD
;MMC Ver.3 Detected
        JR FBS
;-------
SDNEW   LD DE,#01AA
        OR A:SBC HL,DE:JR NZ,NOSD

        LD DE,8000
YY      DEC DE:LD A,D:OR E:JR Z,NOSD
        LD H,#40
        CALL ACMD41:JR NZ,YY
        CP 1:JR Z,YY
        OR A:JR NZ,NOSD
;SDV2 Detected

        CALL CMD58:JR NZ,NOSD
        LD BC,SD_RSTR
        IN A:DS 2
.3      IN L:DS 2
        BIT 6,A:JR Z,FBS;SDV2 Byte Addr
;SDV2 Block Address

        LD A,1
SDFND   LD (BLKT),A
        XOR A
        JR CSH
;-------
FBS     CALL CMDi6:JR NZ,NOSD
        OR A:JR Z,SDFND
;-------
NOSD    LD A,1:RET
;---------------------------------------
CSH     PUSH BC,AF
        LD A,1+#80:OUT (SCTRL),A
        LD BC,SD_SEND,A,#FF:OUT A
        POP AF,BC
        RET
CSL     PUSH BC,AF
        LD A,1+#00:OUT (SCTRL),A
        LD BC,SD_SEND,A,#FF:OUT A
        POP AF,BC
        JP WAIT

SNB     PUSH BC,AF
        LD B,16
SnB     XOR A:IN A,(SD_RSTR):DJNZ SnB
        POP AF,BC
        RET

CYCL    LD BC,SD_SEND
Cy      LD A,#FF:OUT A
        DEC DE:LD A,D:OR E:JR NZ,Cy
        RET
;-------
CMDo    CALL CSH
        CALL CSL
CMDx    PUSH BC
        LD BC,SD_SEND
        OUT A:NOP
        XOR A
        OUT A:DS 2
        OUT A:DS 2
        OUT A:DS 2
        OUT A:NOP
        DEC A:OUT A
        POP BC
        RET
CMD1    LD A,CMD_1:CALL CMDo:JP RESP
CMD55   LD A,CMD_55:CALL CMDo:JP RESP
CMD58   LD A,CMD_58:CALL CMDo:JP RESP
;-------
ACMD41  CALL CMD55
        CALL CSH
        CALL CSL

        LD BC,SD_SEND,A,ACMD_41
        OUT A:LD L,0:NOP
        OUT H:DS 2
        OUT L:DS 2
        OUT L:DS 2
        OUT L:NOP
        DEC L:OUT L
        JR RESP
;-------
CMD17   LD A,CMD_17
CMDz    CALL CSH
        CALL CSL
        PUSH HL,DE,BC

        LD L,C,H,B

        LD C,A,A,(BLKT):OR A:JR NZ,CMzz
        EX DE,HL:ADD HL,HL
        EX DE,HL:ADC HL,HL
        LD H,L,L,D,D,E,E,A

CMzz    LD A,C,BC,SD_SEND
        OUT A:DS 2
        OUT H:DS 2
        OUT L:DS 2
        OUT D:DS 2
        OUT E
        LD A,#FF:OUT A
        POP BC,DE,HL
        JR RESP
CMD24   LD A,CMD_24:JR CMDz
;-------
CMDi6   LD HL,CMD16:JR CMD
CMD8    LD HL,CMD08:JR CMD
CMD0    LD HL,CMD00
CMD     CALL CSH
        CALL CSL
        LD BC,SD_SEND
.6      OUTI

        LD BC,SD_RSTR
RESP    PUSH DE,BC
        LD BC,SD_RSTR,D,10
RESp    IN A:BIT 7,A:JR Z,REZ
        DEC D:JR NZ,RESp:INC D
REZ     POP BC,DE
        RET
;-------
DRESP   PUSH BC,AF
        LD BC,SD_RSTR
        IN A:CP #FF:JR Z,$-4
        AND #1F:CP 5:JR NZ,$
        IN A:OR A:JR Z,$-3
        POP AF,BC
        RET
;-------
WTBY    PUSH BC,AF
        LD BC,SD_RSTR:IN A:OR A:JR Z,$-3
        POP AF,BC
        RET

WTDO    PUSH BC
        LD BC,SD_RSTR
        IN A:CP #FF:JR Z,$-4
        POP BC
        RET

WAIT    PUSH BC,AF
        LD BC,SD_RSTR
        IN A:INC A:JR NZ,$-3
        POP AF,BC
        RET
;-------
BLKT    NOP
;---------------------------------------
