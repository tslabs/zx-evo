;Wild Commander
;(C) BUDDER/MGN/2014
;---------------------------------------
        ORG #6011
;-------
AFKTIME EQU 50*60*1
DEFRQ   EQU %00000001;AY+Z80
CACHE   EQU %00000010
INTM    EQU #5BFF;4 bytes!
;-------
BASIC48 EQU %00000011
;-------
STS     EQU #27AF

BORDER  EQU #0FAF

Vmod    EQU #00AF
Vpag    EQU #01AF
Vpal    EQU #07AF
Vfm     EQU #15AF
Vtm     EQU #16AF
Vtl0    EQU #17AF
Vtl1    EQU #18AF
Vsgp    EQU #19AF

VsinL   EQU #23AF
VsinH   EQU #24AF

PW0     EQU #10AF
PW1     EQU #11AF
PW2     EQU #12AF
PW4     EQU #13AF

SYC     EQU #20AF
CYC     EQU #2BAF
PE0     EQU #21AF

YoffL   EQU #04AF
YoffH   EQU #05AF
XoffL   EQU #02AF
XoffH   EQU #03AF
;-------
DMASL   EQU #1AAF
DMASH   EQU #1BAF
DMASX   EQU #1CAF
DMADL   EQU #1DAF
DMADH   EQU #1EAF
DMADX   EQU #1FAF

DMA_T   EQU #28AF;0=1, 255=256
DMA_N   EQU #26AF;255=512
DMA_C   EQU #27AF;RW 1 - - - 0 0 1
;-------
RSQB    EQU #8000

ELN     EQU 32;64

CURclr  EQU %01011000;\CUR COLOR in PANz
CURmsk  EQU %00000111;/MASK
TBG     EQU %00010111;TEXT COLOR
MARKclr EQU %00010011
WNDCLR  EQU %00011111

GSTP    EQU 4;Step (GFX Viewer)

PLHPG   EQU 127;     HEADERS
PLGPG   EQU PLHPG+1; PLUGINS
PLEPG   EQU PLGPG+32;/

TVBPG   EQU 26;      TXTbuf Start (Page)
TVEPG   EQU TVBPG+63;TXTbuf End (1024Kb)
TVvPG   EQU 8;   TXT/HEX video page
RESB    EQU 10
GVvPG   EQU 32;      GFX video page1
GV2PG   EQU GVvPG+16;GFX video page2
GV3PG   EQU GV2PG+16;GFX video page3
GV4PG   EQU GV3PG+16;GFX video page4

CTZPG   EQU 14;5 pages per CAT
PNLPG   EQU #F0;Drivers
INIPG   EQU PNLPG+2
STRPG   EQU PNLPG+3;Streams
CPPG1   EQU 24;\
CPPG2   EQU 25;/ positions
D2PG    EQU #F6
D5PG    EQU #F5
DBPG    EQU #F4
RPPG    EQU #F7
;-------
RLPNL   EQU #0000
RRPNL   EQU #1000

WINDC   EQU #5B02;(32)
TXTBU   EQU #5B22;(64)

PG0     EQU #6000
PG4     EQU PG0+1
PG8     EQU PG0+2
PGC     EQU PG0+3
ABT     EQU PG0+4
ENT     EQU PG0+5
TMN     EQU PG0+9
FEP     EQU PG0+11;\
XPP     EQU PG0+12;/
CNFv    EQU PG0+13
HEI     EQU PG0+14;\
TXTmdCO EQU PG0+15;/
INIflg  EQU PG0+16
RSQBC   EQU PG0+17
RSQB2   EQU RSQBC+2

Fun     EQU #6006
LOBU    EQU #B000;Main Buffer
DNT     EQU #C000;CATZ
CURO    EQU #C000;POZs in browsing

ENCODET EQU #D000;(TVvPG+1)
;---------------------------------------
        DI
        EX (SP),HL:LD SP,#6000-2
        EX (SP),HL

        CALL INIT,#C000

        DI
INTA    LD HL,I_N_T,(INTM+0),HL
        LD HL,#C9FB,(INTM+2),HL
        DI
        LD A,INTM[,I,A:IM 2

        CALL FINI,DEF

        CALL PATH
;-------
MAIN    EI:HALT:CALL CURSOR
        CALL ALT,NZ,F12:JR NZ,MAIN
        CALL UPPP,NZ,CRUP
        CALL DWWW,NZ,CRDN
        CALL PGU,NZ,PGSUP
        CALL PGD,NZ,PGSDN
        CALL HOME,NZ,PGSHM
        CALL END,NZ,PGSED
        CALL LFFF,NZ,PGSHM
        CALL RGGG,NZ,PGSED

        CALL BSPC,NZ,BENT
        CALL STATUS

        CALL SHIFT,NZ,R2B2:JR NZ,MAIN

        CALL F1,NZ,HELP
        CALL F3,NZ,VIEW
        CALL F10,NZ,F11MENU

        CALL TABK,NZ,XPAN

        CALL F5,NZ,COPY
        CALL F6,NZ,Move
        CALL F7,NZ,MkDir
        CALL F8,NZ,DelFl
        CALL F9,NZ,F9STP
        CALL DELE,NZ,DelFl

        CALL INS,NZ,Mark
        CALL SPKE,NZ,Mark

        CALL TMAFK

        CALL ENKE,NZ,ENTR
        CALL ESC:JP Z,MAIN

        CALL GED
        CALL MNG0D
        LD BC,Vmod:XOR A:OUT A
        RET
;---------------------------------------
Mark    CALL GETEN:JP Z,CRDN
        DEC DE
        LD A,(DE)
        OR A:LD A,MARKclr:JR Z,$+3:XOR A
        LD (DE),A

        LD L,(IX+16)
        LD H,(IX+17)
        PUSH HL
        CALL CRDN
        POP HL
        LD E,(IX+16)
        LD D,(IX+17):OR A:SBC HL,DE
        RET NZ
        CALL CURSER,WLIT,CURSOR
        RET
IMrk    CALL GETEN:RET Z
        DEC DE
        LD A,(DE)
        OR A:LD A,MARKclr:JR Z,$+3:XOR A
        LD (DE),A
        CALL WLIT
        LD A,1,(MRCT),A:OR A
        RET
;---------------------------------------
STATUS  LD A,(IX+10):CP 2:RET NZ
        XOR A:LD HL,STUS:CP (HL):RET Z
        LD (HL),A

        CALL GETEN

        EXA
        LD HL,ENTRY,DE,LOBU,BC,8:LDIR
        LD A,32,(DE),A:INC DE
        LD C,3:LDIR
        LD (DE),A:INC DE
        EXA

        LD HL,SDIR:JR Z,$+5:LD HL,SFIL
        LD C,5:LDIR

        LD A,32
.7      LD (DE),A:INC DE

        EXX
        LD HL,(ARRR),DE,(ARRR+2)
        PUSH IX
        CALL DECZON4
        POP IX

        DEC DE
        LD HL,DE,BC,0-9:ADD HL,BC

        LD B,10,A,#30
DZF     CP (HL):JR NZ,DzF
        LD (HL),32:INC HL
        DJNZ DZF
DzF     LD HL,DE
.3      INC DE
        LD A,32
        LD BC,3:LDDR
        LD (DE),A:DEC DE
        LD C,3:LDDR
        LD (DE),A:DEC DE
        LD C,3:LDDR
        LD (DE),A:DEC DE
        LD A,(HL),(DE),A

        LD A,(IX+5):SUB 2
_LD HL,LOBU,D,A,E,1,BC,38:CALL PRSRW
        RET
;-------
R2B2    CALL ENKE:JP NZ,EXTZEL
        LD A,1:OR A
        RET
;-------
F12     CALL F1:JR NZ,SLM
        CALL F2:JR NZ,SRM
        JR BER
;-------
SLM     LD HL,WINDOW:JR $+5
SRM     LD HL,WINDO2

        CALL SXM:INC B:JR Z,BER
        PUSH IX
        LD IX,(IXHL),(IX+29),A,(IX+28),0
        CALL DRACT,ORIGA
        POP IX
        CALL DRACT

BER     LD A,1:OR A
        RET
;-------
SXM     ;i:HL - SOW, IX - SOW(now)
;        o: A - CurPoz-1

        PUSH IX
        PUSH HL:CALL CURSER:POP HL
        LD (IXHL),HL
        LD DE,WINDC,BC,32:LDIR
        LD IX,WINDC

        LD (IX+1),0
.2      INC (IX+2)
.2      INC (IX+3)

        LD (IX+4),32
        LD (IX+5),3+2

        LD (IX+6),%01111111

        LD (IX+8),B
        LD (IX+9),B
        LD (IX+10),B
        LD (IX+11),B
        LD A,(IX+29):INC A
        LD (IX+12),A;CUR
        LD (IX+13),3;CURMAX
        LD (IX+14),%11100000;CLR
        CALL PRWOW

_LD HL,TXT4,DE,#0009,BC,14:CALL PRSRW
_LD A,%11110111:CALL PRIAT
_LD HL,THDD,DE,#0102,BC,16:CALL PRSRW
_LD HL,TSDZ,DE,#0208,BC,16:CALL PRSRW
_LD HL,TSDG,DE,#0308,BC,16:CALL PRSRW

SMC     EI:HALT:CALL CURSOR
        CALL UPPP,NZ,CrUP
        CALL DWWW,NZ,CrDN

        CALL ESC:LD B,#FF:JR NZ,AMC
        CALL ENKE:JR Z,SMC
        LD B,0
AMC     PUSH BC
        CALL RRESB
        POP BC
        LD A,(IX+12):DEC A
        POP IX
        RET
;---------------------------------------
ENTR    CALL GETEN:JP NZ,VIE
        INC DE:LD A,(DE):OR A:RET Z

        CALL MPATH
        CALL CURSER
        JP FOLDER

BENT    LD HL,0
        CALL GETen:RET NZ
        INC DE:LD A,(DE):CP ".":RET NZ

        CALL MPATH
        CALL CURSER

        XOR A
        LD (IX+12),1
        LD (IX+16),A
        LD (IX+17),A
        JP FOLDER
;---------------------------------------
XPAN    PUSH IX
        POP HL
        LD DE,WINDO2:OR A:SBC HL,DE
        JR Z,LPAN
;-------
RPAN    CALL CURSER
        LD IX,WINDO2:CALL DRACT
        JP STT

LPAN    CALL CURSER
        LD IX,WINDOW:CALL DRACT
        JP STT
;---------------------------------------
PGSED   CALL CURSER
        LD A,(IX+20):OR A:JR NZ,CR4
        LD L,(IX+16),H,(IX+17)
EDD     PUSH HL
        CALL Gwe
        POP HL:INC HL:JR NZ,EDD

        LD A,(IX+5):SUB 1,(IX+10)
        LD B,0,C,A
        OR A:SBC HL,BC
        LD A,H:CP #FF:RET NC
        LD (IX+16),L,(IX+17),H
        CALL WLIT
        JR CR4

PGSDN   CALL CURSER
        LD A,(IX+20):OR A:JR NZ,CR4
        LD A,(IX+5):SUB 2,(IX+10)
        LD C,A,B,0
        LD L,(IX+16),H,(IX+17):ADD HL,BC
        LD (IX+16),L,(IX+17),H
        CALL WLIT
CR4     CALL CR4EG
        JP STT

SM      PUSH HL:CALL CURSER:POP HL
        JR SL

PGSUP   ;LD A,(IX+21):OR A:RET NZ
        LD A,(IX+5):SUB 2,(IX+10)
        LD C,A,B,0
        LD L,(IX+16),H,(IX+17)
        OR A:SBC HL,BC:JR NC,SM
PGSHM   CALL CURSER
        LD HL,0,(IX+12),1
        JR SL
;-------
CRDN    LD A,(IX+12)
        CP (IX+13):JR NC,SRLDN
RDN     CALL CURSER
        INC (IX+12)
        JR STT
SRLDN   LD A,(IX+20):OR A:RET NZ
        LD L,(IX+16),H,(IX+17):INC HL
SL      LD (IX+16),L,(IX+17),H
        CALL WLIT
        CALL CURSOR
        RET

CR4EG   LD A,(IX+20):OR A:RET Z
        LD A,(IX+13):OR A:RET Z
        LD (IX+12),A
        RET
CR4eg   LD A,(IX+13)
        OR A:JR NZ,$+3:INC A
        CP (IX+12):RET NC
        LD (IX+12),A
        RET
;-------
CRUP    LD A,(IX+12)
        CP 1:JR Z,SRLUP
RUP     CALL CURSER
        DEC (IX+12)
STT     CALL CURSOR
        LD A,1,(STUS),A
        RET
SRLUP   LD A,(IX+21):OR A:RET NZ
        LD L,(IX+16),H,(IX+17):DEC HL
        JR SL
;-------
CrDN    LD A,(IX+12)
        CP (IX+13):RET NC
        JR RDN
CrUP    LD A,(IX+12)
        CP 1:RET Z
        JR RUP
;-------
CrPU    CALL CURSER:LD (IX+12),1:JR STT
CrPD    CALL CURSER
        LD A,(IX+13),(IX+12),A:JR STT
;-------
PANK    LD L,(IX+18)
        LD H,(IX+19)
        LD A,(IX+17):CP H:RET C
        LD A,(IX+16):CP L:RET C

        LD A,(IX+5):SUB 2,(IX+10)
        LD B,0,C,A
        OR A:SBC HL,BC:JR NC,$+5:LD HL,0

        LD (IX+16),L
        LD (IX+17),H
        RET
;---------------------------------------
PANE    CALL PANELI
        LD (IX+23),A,(IX+24),A
        LD (IX+12),1
        LD (IX+16),A,(IX+17),A,(IX+26),A
        RET

PANELI  ;i:IX - SOW
        LD A,1
        LD (STUS),A
        XOR A
        LD (IX+13),A
        LD (IX+15),A
        LD (IX+20),A
        LD (IX+21),A
        RET

GETEN   ;i:IX - SOW
;        o:DE - flag addres
;          HL - ENTRY addres
;          ENTRY(12), BRRR(8)

        LD B,0,C,(IX+12):DEC C
        LD L,(IX+16),H,(IX+17)
        ADD HL,BC

GETen   CALL GWE
        PUSH HL
        LD DE,BRRR,BC,8:LDIR
        LD C,4:ADD HL,BC
        LD DE,ENTRY,C,8:LDIR
        INC HL:LD C,3:LDIR
        XOR A:LD (DE),A;flg
        POP HL

        PUSH HL
        LD C,11:ADD HL,BC:EX DE,HL
        POP HL

        LD A,(DE):OR A
        RET
;-------
GETWE   LD L,(IX+16),H,(IX+17)
GWE     CALL UM32
        LD BC,DNT:ADD HL,BC
        CALL CAT1
        RET

Gwe     CALL UM32
        LD BC,DNT+12:ADD HL,BC
        CALL CAT1
        LD A,(HL):OR A
        RET

UM32    LD B,0
.5      SLA L:RL H,B
.2      SLA B

        LD A,H,C,#40
        SUB C:JR C,GW:INC B
        SUB C:JR C,GW:INC B
        SUB C:JR C,GW:INC B
        SUB C
GW      ADD A,C:LD H,A
        LD (IX+26),B
        RET
;-------
CURPOZ  LD A,(IX+22):OR A:RET Z
        CALL MNGC

        LD DE,CURO
        LD C,(IX+16),B,(IX+17)
        LD L,(IX+23),H,(IX+24)
        LD A,(IX+12)
        DEC A:JR Z,LUP

Lup     LD A,(IX+12)
        ADD HL,DE
        LD (HL),C:INC HL
        LD (HL),B:INC HL
        LD (HL),A:INC HL
        LD (HL),0:INC HL

        LD (IX+12),1
        LD (IX+16),0
        LD (IX+17),0

NEKO    OR A:SBC HL,DE
        LD (IX+23),L,(IX+24),H
        RET
;-------
LUP     LD A,B:OR C:JR NZ,Lup
        LD A,L:OR H:JR Z,Lup
        ADD HL,DE

        DEC HL
        DEC HL:LD A,(HL),(IX+12),A
        DEC HL:LD A,(HL),(IX+17),A
        DEC HL:LD A,(HL),(IX+16),A
        JR NEKO
;---------------------------------------
ER0     LD HL,TER0
        LD DE,#0116
        LD BC,17
ERX     CALL ERR0
        PUSH IX
        POP HL
        CALL SXM
        LD (IX+29),A,(IX+28),0
        CALL DRACT
        JR ORIG
ER1     LD HL,TER1
        LD DE,#0116
        LD BC,17
        JR ERX
;-------
ORIGA2  LD A,(HEI):SUB 2:LD (IX+5),A
        CALL PRWOW
ORIG    CALL IDE_INI
        XOR A:CALL SEL_DEV:JR NZ,ER0
        CALL HDD:JR NZ,ER1

        LD HL,BRRR,B,4:CALL NOPING

        JP PANE

ORIGA   CALL ORIGA2
FOLD    CALL NEWDIR
        CALL PANK
        CALL WLIT,CR4eg
        XOR A
        RET

FOLDER  CALL PANELI,CURPOZ
        CALL FOLD
        RET

;---------------------------------------
;GENERATING DIRECTORY IN RAM:
NEWDIR  ;i:BRRR(4) - fstCLUS of NEW DIR

        CALL PPATH

        LD HL,DNT,(INTABL),HL
        LD HL,BRRR:CALL GLSTCAT
        LD HL,BRRR:CALL GIPAG

        XOR A
        LD (IX+18),A,(IX+19),A
        LD (IX+26),A:CALL CAT1

BUM     LD HL,LOBU
        LD B,4:CALL LOAD512
        PUSH AF
        LD B,16:CALL NOPING
        CALL DECODE
        POP AF
        CP #0F:JR Z,DOOM
        LD A,H:CP LOBU[+8:JR Z,BUM
DOOM    LD HL,(INTABL)
        CALL A440
        LD B,32:CALL NOPING
        RET

DECODE  ;i:LOBU(2048) - SEGMENT OF DIR
;          INTABL(2) - ADDRESS

        LD HL,LOBU
NXFL    LD A,(HL):OR A:RET Z

        CP ".":JP NZ,NEWEA
        INC HL
        LD A,(HL)
        CP ".":JP NZ,RMFL1
        DEC HL

NEWEA   CP #E5:JP Z,RMFL
        LD BC,11:ADD HL,BC
        LD A,(HL):OR A:SBC HL,BC
        BIT 3,A:JR NZ,RMFL

        EX DE,HL
        LD HL,(INTABL)
        LD A,H:OR A:JR NZ,NPGE
        LD A,(IX+26):CP 3:RET NC
        INC (IX+26):CALL CAT1
        LD HL,DNT
NPGE    LD BC,12:ADD HL,BC
        EX DE,HL
        LD C,8:LDIR
        LD A,".",(DE),A:INC DE
        LD C,3:LDIR

        LD A,(HL)
        AND %00010000
        XOR %00010000:JR NZ,TERN
        LD C,4
        EX DE,HL
        OR A:SBC HL,BC
        LD (HL)," "
        ADD HL,BC
        EX DE,HL
TERN    EX DE,HL
        LD C,13
        OR A:SBC HL,BC
        LD (HL),A;      Flag
        LD C,3
        SBC HL,BC
        EX DE,HL
        LD C,5:ADD HL,BC
.2      LDI
        LD C,8:ADD HL,BC
        EX DE,HL
        LD (HL),B;      Mark
        LD C,10:SBC HL,BC
        EX DE,HL
.2      LDI
        OR A:SBC HL,BC
.2      LDI
        ADD HL,BC
.4      LDI
        EX DE,HL
        LD C,ELN-8:ADD HL,BC
        LD (INTABL),HL
        EX DE,HL

        INC (IX+18):JP NZ,NXFL
        INC (IX+19)
        JP NXFL
;-------
RMFL1   DEC HL
RMFL    LD C,32:ADD HL,BC
        JP NXFL

;---------------------------------------
WLIT    XOR A
        LD (IX+13),A
        LD (IX+20),A
        LD (IX+21),A
        INC A
        LD (STUS),A

        CALL GETWE

        LD DE,#0101
        LD A,(IX+17):OR A:JR NZ,A123
        LD A,(IX+16):OR A:JR NZ,A123
        LD (IX+21),1
A123    PUSH DE
        CALL A440
        LD BC,10:ADD HL,BC
        LD A,(HL),(RSTB),A:INC HL
        LD A,(HL),(RSTA),A:INC HL
        LD A,(HL)
        LD DE,TXTBU
.12     LDI
        LD DE,ELN-24:ADD HL,DE
        POP DE
        OR A:JR Z,EPG:INC (IX+13)

        PUSH HL
        LD HL,TXTBU
        LD BC,12:CALL PRSRW:INC D
        LD C,TBG
        LD A,(RSTB):OR A:JR Z,$+3:LD C,A
        LD A,(RSTA):OR A:LD A,C
        JR NZ,$+4:OR %00001000

        CALL PRIAT
        LD A,(IX+5):SUB 2,(IX+10)
        POP HL
        CP D:JR NC,A123

        CALL A440
        LD DE,12:ADD HL,DE
        LD A,(HL):OR A:RET NZ
        LD (IX+20),1
        RET

EPG     LD (IX+20),1
        XOR A:CALL MNGC
E_G     LD HL,TXTBU
        LD BC,12:CALL PRSRW:INC D
        LD A,TBG
        CALL PRIAT
        LD A,(IX+5):SUB 2,(IX+10)
        CP D:JR NC,E_G
        RET

A440    LD A,H:OR A:JP NZ,CAT1
        LD HL,DNT:INC (IX+26)
        JP CAT1
;-------
PRSRW   ;i:IX - SOW
;          HL - TEXT
;          BC - Length
;           D - Y
;           E - X
;        o:HL - Address

        PUSH DE
        PUSH HL
        CALL GPOZA;INC H,L
        LD A,D:ADD A,H:LD H,A
        LD A,E:ADD A,L:LD L,A
        EX DE,HL
        POP HL
        LD A,C
        LDIR
        LD B,A
        EX DE,HL
        POP DE
        RET
;-------
PRIAT   ;i:HL - Address in SCREEN
;           A - Color
;           B - Lenght
        SET 7,L
        DEC L:LD (HL),A:DEC L:DJNZ $-2
        RET
;-------
GADRW   ;i:IX - SOW
;           D - Y
;           E - X
;        o:HL - Address

        PUSH DE
        CALL GPOZA
        LD A,D:ADD A,H:LD H,A
        LD A,E:ADD A,L:LD L,A
        POP DE
        RET
;---------------------------------------
YN      CP 1:JR Z,IYN
        CP #FF:JR Z,EYN
        CALL LFFF,NZ,AYES
        CALL RGGG,NZ,ANOP

        LD DE,(AAHL)
        LD HL,TXT00,BC,8:CALL PRSRW
YNmc    LD A,%11110111:CALL PRIAT

        LD DE,(AADE)
        LD HL,TXT01,BC,8:CALL PRSRW
YNm2    LD A,%00000111:CALL PRIAT
        RET

EYN     LD A,(YNmc+1),HL,CSEL:CP (HL)
        RET

IYN     LD A,(IX+6)
.4      RLCA
        LD (CSEL),A
        LD A,(IX+6):AND %11110000
.4      RLCA
        LD (CNSL),A

        LD A,(IX+5):SUB 2
        LD D,A,H,A
        LD A,(IX+4):SRL A:SUB 9
        LD L,A:ADD A,10:LD E,A

        LD (AAHL),HL
        LD (AADE),DE
;-------
AYES    LD A,(CSEL),(YNmc+1),A
        LD A,(CNSL),(YNm2+1),A
        RET
ANOP    LD A,(CNSL),(YNmc+1),A
        LD A,(CSEL),(YNm2+1),A
        RET
;---------------------------------------
PRWOW   ;i:IX - Structure Of Window
        LD A,(IX):OR A:RET NZ
        CALL GPOZA
        PUSH HL:CALL GRESB:POP HL

        EI:HALT

        LD A,(IX+4):DEC A:LD (FLL+1),A
        LD A,(IX+6),(AA0+1),A,(AA1+1),A

        LD DE,#C9BB,C,#CD:CALL FLL
        LD A,(IX+5)
        SUB 2:JR Z,OMS

        LD DE,#BABA,C,#20
HE1     CP (IX+10):JR Z,HET
        CP (IX+11):JR Z,HET
        CALL FLL
LET     DEC A:JR NZ,HE1

OMS     LD DE,#C8BC,C,#CD:CALL FLL
        RET
;-------
HET     PUSH DE,BC
        LD DE,#C7B6,C,#C4
        CALL FLL
        POP BC,DE
        JR LET
;---------------------------------------
FLL     LD B,0
        PUSH HL
        LD (HL),D
        SET 7,L
AA0     LD (HL),0
        RES 7,L

WE      INC HL:LD (HL),C
        SET 7,L
AA1     LD (HL),0
        RES 7,L
        DJNZ WE

        LD (HL),E
        POP HL
        INC H
        RET
;-------
GRESB   LD A,(IX+8):OR (IX+9):RET NZ
        LD DE,(RSQBC)
        LD (IX+8),E
        LD (IX+9),D

        LD A,(IX+4),(He2a),A,(He2b),A
        LD A,(IX+5)

        EXA
        LD A,RESB:CALL MNg8
        LD A,L
        EXA
        LD B,0
HE2     EXA
He2a    EQU $+1:LD C,0:LDIR:LD L,A
        SET 7,L
He2b    EQU $+1:LD C,0:LDIR:LD L,A
        INC H
        EXA:DEC A:JR NZ,HE2
        LD (RSQBC),DE
        JP MNG8R
;-------
RRESB   CALL GPOZA
        EX DE,HL
        LD L,(IX+8)
        LD H,(IX+9)
        LD A,H:CP #BF:RET NC:OR L:RET Z

        PUSH HL
        LD A,(IX+4),(He3a),A,(He3b),A
        LD A,(IX+5)

        EXA
        LD A,RESB:CALL MNg8
        LD A,E
        EXA

        LD B,0
HE3     EXA
He3a    EQU $+1:LD C,0:LDIR:LD E,A
        SET 7,E
He3b    EQU $+1:LD C,0:LDIR:LD E,A
        INC D
        EXA:DEC A:JR NZ,HE3
        POP BC

        EX DE,HL
        LD HL,(RSQBC)
        OR A:SBC HL,DE:JR Z,XeT
;LD A,B,B,H,H,A
;LD A,C,C,L,L,A
;EX DE,HL
;LDIR
;LD BC,DE
        JR XET

XeT     LD (RSQBC),BC
XET     CALL MNG8R
        XOR A
        LD (IX+8),A
        LD (IX+9),A
        RET
;-------
GPOZA   XOR A:CALL MNGC
        LD HL,#C000
        LD A,(IX+2):ADD A,L:LD L,A
        LD A,(IX+3):ADD A,H:LD H,A
        RET
;---------------------------------------
CURSOR  CALL SOR
.2      DEC B:RET Z
        LD A,(IX+1)
        AND A,(HL)
        OR (IX+14)

        CP (HL):JR Z,CRS
        LD C,(HL),(IX+15),C
CRS     LD (HL),A:INC L:DJNZ $-2
        RET

CURSER  CALL SOR
.2      DEC B:RET Z
        LD A,(IX+15)
        JR CRS

SOR     CALL GPOZA:INC L
        SET 7,L
        LD A,(IX+12):ADD A,H:LD H,A

        LD B,(IX+4)
        RET

;-  -  -  -  -  -  -  -  -  -  -  -  -
I_N_T   PUSH AF,BC,DE,HL,IX
        EXX:EXA
        PUSH AF,BC,DE,HL

        LD HL,(TMN):INC HL:LD (TMN),HL

        CALL VPRT
        CALL PSD2
        CALL TIME

        CALL ESC2,NZ,ABTF
        CALL ENK2,NZ,ENTF

        POP HL,DE,BC,AF
        EXX:EXA
        POP IX,HL,DE,BC,AF
        EI
        RET
;-  -  -  -  -  -  -  -  -  -  -  -  -

VPRT    LD HL,VVpag

        LD BC,Vpag+256:OUTI
        LD B,Vmod[+#01:OUTI

        LD B,YoffL[+1:OUTI
        LD B,YoffH[+1:OUTI
        LD B,XoffL[+1:OUTI
        LD B,XoffH[+1:OUTI
        RET

ENTF    LD A,1,(ENT),A:RET
ABTF    LD A,1,(ABT),A:RET

TIME    LD HL,TMR
        LD A,(HL):OR A:JR Z,IME:DEC (HL)
        LD A,(HL)
.2      ADD A,(HL)
        LD B,0,C,A
        SUB (HL)
        LD HL,TTM+6
        OR A:SBC HL,BC

        LD BC,#DFF7:OUT A
        LD B,#BF:IN A
        CALL NORK
        JR HIME

IME     INC HL
_LD A,(HL):DEC A:LD (HL),A:RET NZ

        INC HL
        LD A,(HL):DEC HL
        LD (HL),A:DEC HL
        LD (HL),3
        RET

HIME    XOR A:CALL MNgC
        LD HL,TTM,DE,#C000+72,BC,8:LDIR
        JP MNGCR
;-------
TMTOEN  LD D,0
        LD A,2:CALL SEDT
        LD E,A
.5      SLA E:RL D
        XOR A:CALL SEDT:SRL A
        OR E:LD E,A
        LD A,4:CALL SEDT
.3      SLA A
        OR D:LD D,A
        LD (ENTRY+14),DE
        LD (ENTRY+22),DE

        LD A,9:CALL SEDT:ADD A,20
        LD D,A
        LD A,8:CALL SEDT
.5      SLA A
        RL D:LD E,A
        LD A,7:CALL SEDT
        OR E:LD E,A
        LD (ENTRY+16),DE
        LD (ENTRY+18),DE
        LD (ENTRY+24),DE
        RET

SEDT    LD BC,#DFF7:OUT A
        LD B,#BF:IN A

        LD C,A:AND %00001111:LD B,A
.4      SRL C
        LD A,C
.9      ADD A,C
        ADD A,B
        RET
;---------------------------------------
SWPPAN  PUSH IX
        POP HL
        LD DE,WINDOW
        OR A:SBC HL,DE:JR NZ,PPA
        LD IX,WINDO2
        RET
PPA     LD IX,WINDOW
        RET

DRACT   CALL FRST
        LD A,(IX+28):OR A:RET NZ

        CALL RPATH
        LD (IX+28),1
        LD A,(IX+29)
        JP DOS_SWP
FRST    LD A,PNLPG:ADD A,(IX+27):JP MNG0
;---------------------------------------
MNG0D   LD BC,PE0,A,%00000001:OUT A
        LD BC,PW0,A,%00000000:OUT A
        RET
MNG0I   LD BC,PE0,A,%00001110:OUT A
        RET
MNG0    LD (PG0),A,BC,PW0:OUT A;NeedInit
        RET

MNG4    LD (PG4),A,BC,PW1:OUT A:RET
MNG8R   LD A,(PG8)
MNG8    LD (PG8),A
MNg8    LD BC,PW2:OUT A:RET

MNGCM   XOR A:JP MNGC
MNGCR   LD A,(PGC)
MNGC    PUSH BC:LD (PGC),A,BC,PW4:OUT A
        POP BC
        RET
MNgC    LD BC,PW4:OUT A:RET
;-------
CAT1    LD A,CTZPG
        ADD A,(IX+26)
        ADD A,(IX+25)
        CALL MNGC
        RET
;-------
MNGC_PL CP #FE:JR Z,MNGCM
        CP #FF:JR Z,MNGCFNT
        CP 64:RET NC
        ADD A,PLGPG
        PUSH HL:LD HL,PPGP:ADD A,(HL)
        POP HL
        JP MNGC
MNGCFNT LD A,1:CALL MNGC
        RET

MNG0_PL CP 64:RET NC
        ADD A,PLGPG
        PUSH HL:LD HL,PPGP:ADD A,(HL)
        POP HL
        JP MNG0

MNG8_PL CP 64:RET NC
        ADD A,PLGPG
        PUSH HL:LD HL,PPGP:ADD A,(HL)
        POP HL
        JP MNG8

MNGCVPL CP 16*4:RET NC
        ADD A,GVvPG
        JP MNGC
MNG0VPL CP 16*4:RET NC
        ADD A,GVvPG
        JP MNG0
MNG8VPL CP 16*4:RET NC
        ADD A,GVvPG
        JP MNG8

MNGV_PL CP 1:JR Z,VB1
        CP 2:JR Z,VB2
        CP 3:JR Z,VB3
        CP 4:JP NZ,GED
VB4     LD A,GV4PG:JR VB1+2
VB3     LD A,GV3PG:JR VB1+2
VB2     LD A,GV2PG:JR VB1+2
VB1     LD A,GVvPG,(VVpag),A
        RET

GVtm    LD A,C:CP 16*4:RET NC
        ADD A,GVvPG:LD BC,Vtm:OUT A
        RET
GVtl    LD A,C:CP 16*4:RET NC
        ADD A,GVvPG
        BIT 0,B:JR NZ,Stl1
        LD BC,Vtl0:OUT A:RET
Stl1    LD BC,Vtl1:OUT A:RET
GVsgp   LD A,C:CP 16*4:RET NC
        ADD A,GVvPG:LD BC,Vsgp:OUT A
        RET
;-------
NOPING  XOR A:LD (HL),A:INC HL:DJNZ $-2
        RET

GEDPL
GED     DI
        XOR A
        LD (VVpag),A,(INIflg),A

DED     LD A,(TXTmdCO),(VVmod),A

DDD     XOR A
        LD B,A,C,A
        LD (VYofL),BC
        LD (VXofL),BC

        EI:HALT
        LD BC,BORDER:OUT A

        LD A,GVvPG:CALL MNGC
        CALL PABE
        LD HL,PALLIT,DE,#1000,BC,32:LDIR
        CALL PAED
        LD BC,Vpal:OUT A
        RET
PAED    XOR A:LD BC,Vfm:OUT A:RET
PABE    LD A,%00010001,BC,Vfm:OUT A:RET

Vv      XOR A
        LD B,A,C,A
        LD (VYofL),BC
        LD (VXofL),BC
        LD (VVpag),A
        LD BC,BORDER:OUT A
        RET

GVmod   LD (VVmod),A:RET
GYoff   LD (VYofL),HL:RET
GXoff   LD (VXofL),HL:RET
;---------------------------------------
DEL64
.6      SRL D:RR E,H,L
        RET

DLT4PCH LD BC,(PBSTH+1),A,B:OR C
        LD BC,(PBSTL+1):OR B,C:RET Z

DELIT4P LD IX,0-1
NAZE    OR A
PBSTH   LD BC,0:INC IX
        EX DE,HL:SBC HL,BC:JR C,ND
PBSTL   LD BC,0
        EX DE,HL:SBC HL,BC:JR NC,PBSTH
        DEC DE
        LD A,D:INC A:JR NZ,NAZE
        LD A,E:INC A:JR NZ,NAZE
        INC DE

        ADD HL,BC
        EX DE,HL
        LD BC,(PBSTH+1)
ND      ADD HL,BC
        EX DE,HL
        PUSH IX
        POP BC
        LD A,C:ADD A,#30
        RET

DECZON4 ;i:[DE,HL] - int32
;           EXX DE - String address
;        o:Decimal string(10)

        LD BC,#CA00,(PBSTL+1),BC
        LD BC,#3B9A,(PBSTH+1),BC
        CALL DELIT4P
        EXX:LD (DE),A:INC DE:EXX

        LD BC,#E100,(PBSTL+1),BC
        LD BC,#05F5,(PBSTH+1),BC
        CALL DELIT4P
        EXX:LD (DE),A:INC DE:EXX

        LD BC,#9680,(PBSTL+1),BC
        LD BC,#0098,(PBSTH+1),BC
        CALL DELIT4P
        EXX:LD (DE),A:INC DE:EXX

        LD BC,#4240,(PBSTL+1),BC
        LD BC,#000F,(PBSTH+1),BC
        CALL DELIT4P
        EXX:LD (DE),A:INC DE:EXX

        LD BC,#86A0,(PBSTL+1),BC
        LD BC,#0001,(PBSTH+1),BC
        CALL DELIT4P
        EXX:LD (DE),A:INC DE:EXX
;-------
DECZON2 LD BC,10000,(PBSTL+1),BC
        LD BC,0,(PBSTH+1),BC
        CALL DELIT4P
        PUSH HL
        EXX:LD (DE),A:INC DE
        POP HL
DECZ2   LD BC,1000
        CALL DELIT
        LD (DE),A:INC DE
DECZ1   LD BC,100
        CALL DELIT
        LD (DE),A:INC DE
DECZ    LD C,10
        CALL DELIT
        LD (DE),A:INC DE
        LD C,1
        CALL DELIT
        LD (DE),A:INC DE
        RET
;-------
DELIT   LD A,#FF
        OR A
DLIT    INC A
        SBC HL,BC:JP NC,DLIT
        ADD HL,BC,A,#30
        RET
;-------
NORK    ;i:HL,Addr A,val
        INC HL
        LD C,A
        AND %00001111
        CP 10:JR C,$+4:ADD A,7
        ADD A,#30
        LD (HL),A:DEC HL
        LD (HL),C
        XOR A
        RLD
        CP 10:JR C,$+4:ADD A,7
        ADD A,#30
        LD (HL),A
        INC HL,HL
        RET

INIT    LD BC,#EFF7,A,#80:OUT A
        LD BC,#DFF7,A,#F0:OUT A
        LD BC,#BFF7,A,#02:OUT A

        LD A,DEFRQ:JR TURBO

TURBOof LD BC,#EFF7:XOR A:OUT A
BOF     EQU $+1
        LD A,0
TURBO   AND %00000011
        LD BC,SYC:OUT A
        LD A,CACHE
        LD BC,CYC:OUT A
        RET
;---------------------------------------
XLD512  CALL XPO,XPo
        PUSH DE:CALL LOAD512
        POP DE
        CALL XPc:JP XPC
XSV512  CALL XPO,XPo
        PUSH DE:CALL SAVE512
        POP DE
        CALL XPc:JP XPC
XGIPGPL CALL XPO,GIPAGPL:JP XPC
XTNTRY2 CALL XPO,TENTRY2:JP XPC
XCHTS   CALL XPO,CHTOSEP:JP XPC
XTNTRYN CALL XPO,TENTRYN:JP XPC
XTMRKFL CALL XPO,TMRKDFL:JP XPC
XTMRKNX CALL XPO,TMRKNXT:JP XPC
XSTREAM CALL XPO,STREAM
        LD A,(PG0),(FEP),A:JP XPC
XMKFL   CALL XPO,MKFL:JP XPC
XFENTRY CALL XPO,FENTRY:JP XPC
XLD256  CALL XPO,LOAD256:JP XPC
XLDNON  CALL XPO,LOADNON:JP XPC
XGFILE  CALL XPO,GFILE:JP XPC
XGDIR   CALL XPO,GDIR:JP XPC
XMKfile CALL XPO,MKfile:JP XPC
XMKdir  CALL XPO,MKdir:JP XPC

XPO     PUSH AF,BC
        LD A,(PG0),(XPP),A
        LD A,(FEP):CALL MNG0
        POP BC,AF
        RET
XPC     PUSH AF,BC
        LD A,(XPP):CALL MNG0
        POP BC,AF
        RET

XPo     PUSH AF,BC
        LD D,1
        LD A,H:CP #40:JR NC,Xpo:DEC D
        LD A,(PGC),E,A
        LD A,(XPP):CALL MNGC
        LD BC,#C000:ADD HL,BC
Xpo     POP BC,AF
        RET

XPc     PUSH AF,BC
        DEC D:JR Z,Xpc
        LD A,E:CALL MNGC
        LD BC,0-#C000:ADD HL,BC
Xpc     POP BC,AF
        RET

TURBOPL INC B:JR Z,DEF
        DEC B:JR NZ,TAY
        LD A,C:AND %00000011
        LD C,A,B,%00111000
Tay     LD A,(AYZ80):AND B:OR C
Ta      LD BC,SYC:OUT A
        LD A,CACHE
        LD BC,CYC:OUT A
        RET
TAY     LD A,C:AND %00000111
.3      SLA A
        LD C,A,B,%00000011
        JR Tay
DEF     LD A,(DFRQ):AND %00111011:JR Ta
GIPAGPL LD HL,BRRR:JP GIPAG
TENTRY2 LD HL,ENTRY,BC,32:LDIR:RET
CHTOSEP LD HL,BRRR:JP CHTOSE
;-------
PDST3   LD A,%00000001;RAM2RAM
        JR PUDZ
PDST4   LD A,%10000001;BLT2RAM
        JR PUDZ
PDST5   LD A,%00000100;FILL
        JR PUDZ
PDST6   LD A,%10000100;RAM2CRAM
        JR PUDZ
PDST7   LD A,%10000101;RAM2SFILE
PUDZ    LD HL,DSA
        OR (HL):INC HL
        OR (HL):INC HL
        OR (HL)
        EXA:CALL PDSTS:RET NZ
        EXA
        LD BC,DMA_C:OUT A
        JR DSTS

DMAPL   CP #FC:JR Z,PDST3
        CP #FB:JR Z,PDST4
        CP #FA:JR Z,PDST5
        CP #F9:JR Z,PDST6
        CP #F8:JR Z,PDST7

        CP #FF:JR Z,DSTS
        CP #FE:JR Z,PDST1
        CP #FD:JR Z,PDST2

        OR A:JR Z,PDISD
        DEC A:JR Z,PDIS
        DEC A:JR Z,PDID
        DEC A:JR Z,PDISP
        DEC A:JR Z,PDIDP
        DEC A:JR Z,PDIT
        DEC A:JR Z,PDIN;6

        DEC A:JP Z,PDITN
        DEC A:JP Z,PDISSA
        DEC A:JP Z,PDISDA
        DEC A:JP Z,PDISAS
        DEC A:JP Z,PDISDS;11
        RET
DSTS    LD BC,STS:INF:JP M,$-2:XOR A:RET
PDSTS   LD BC,STS:INF:JP M,$+5:XOR A:RET
        LD A,1:OR A
        RET
PDST1   CALL PDST2:RET NZ:JR DSTS
PDST2   CALL PDSTS:RET NZ
        LD BC,DMA_C,A,%00000001:OUT A
        XOR A
        RET
PDISD   PUSH BC:CALL PDIS
        POP BC
        JR PDID
PDIS    LD A,B:CALL PDBIT
PDis    LD BC,DMASL:OUT L
        LD B,DMASH[:OUT H
        LD B,DMASX[:OUT A:RET
PDID    LD A,C:CALL PDBIT
PDid    LD BC,DMADL:OUT E
        LD B,DMADH[:OUT D
        LD B,DMADX[:OUT A:RET
PDISP   CALL PDPG:JR PDis
PDIDP   CALL PDPG:JR PDid
PDIT    LD A,B,BC,DMA_T:OUT A:RET
PDIN    LD A,B,BC,DMA_N:OUT A:RET
PDITN   PUSH BC:CALL PDIT
        POP BC:LD B,C:JR PDIN

PDISDS  LD C,E:CALL PDISAS
        LD C,H:CALL PDISSA
        LD C,L:JR PDISDA
PDISSA  LD A,C:RRC A,A,A:AND %00100000
        LD (DSA),A
        RET
PDISDA  LD A,C:RRC A,A,A,A:AND %00010000
        LD (DDA),A
        RET
PDISAS  LD A,C:SLA A,A,A:AND %00001000
        LD (DAS),A
        RET
;-------
PDBIT   BIT 7,A:JR NZ,PDBI
        AND 63:ADD A,GVvPG
        RET
PDBI    AND 15:ADD A,PLGPG
        EXX:LD HL,PPGP:ADD A,(HL)
        EXX
        RET
PDPG    LD A,B:AND 3
        EXX:LD H,PG0[,L,A,A,(HL)
        EXX
        RET

KBSCN   OR A:JP Z,CLAvA
        DEC A:JP Z,CLAVA
        RET

TENTRYN RET
TMRKDFL LD A,H:OR L:JP Z,MARKSRH

        PUSH DE
        PUSH HL:LD HL,0:EXX
        POP DE
RKsrh   EXX
        LD (MRRN),HL:CALL Gwe:JR Z,ERk

        DEC HL,HL:LD A,(HL):OR A
        LD HL,(MRRN):INC HL:JR Z,RKsrh+1
        EXX
        INC HL:OR A:SBC HL,DE:JR Z,EGE
        ADD HL,DE
        JP RKsrh
EGE     EXX:DEC HL
        CALL GETen
        POP DE
        LD HL,ENTRY,BC,11:LDIR
        CALL GIPAGPL
        XOR A
        RET
ERk     POP DE
        LD A,1:OR A
        RET
TMRKNXT RET
MKFL    PUSH DE:LD DE,ENTRY+28,BC,4:LDIR
        POP HL
        LD DE,ENTRY,C,12:LDIR
        CALL TMTOEN
        LD HL,ENTRY:CALL GENTRY

        LD HL,(ENTRY+28),DE,(ENTRY+30)
        CALL MKSG:RET NZ
        CALL SVHDFL:RET NZ
MKF     LD (BRRR),HL,(BRRR+2),DE

        PUSH HL,DE
        LD DE,ENTRY:CALL TENTRY
        CALL GIPAGPL
        POP DE,HL

        XOR A
        RET

STREAM  LD A,D
        CP #FF:JR Z,ACRD
        PUSH BC
        AND 1:ADD A,STRPG:CALL MNG0
        POP BC

        LD E,B
        INC BC
        LD A,B:OR C:RET Z
        LD A,E

TSBC    CP 3:JR C,$+3:XOR A
        OR A:JR Z,BDSD
        DEC A:JR Z,BDSD+2
        DEC A:RET NZ
        CALL DOS_SWP
        LD A,1
        JR BDIS
BDSD    LD A,1:CALL DOS_SWP
        CALL IDE_INI
        XOR A
BDIS    CALL SEL_DEV:RET NZ
        CALL HDD:RET NZ
        XOR A
        RET
ACRD    LD HL,0
        LD (CRRR),HL
        LD (CRRR+2),HL
        JR GDIR

FENTRY  CALL SRHDRN:RET Z
        LD (CRRR),HL
        LD (CRRR+2),DE
        EXX
        LD DE,ENTRY:CALL TENTRY
        LD HL,(ENTRY+28)
        LD DE,(ENTRY+30)
        RET
GFILE   LD HL,CRRR:JP GIPAG
GDIR    LD HL,CRRR:JP GLSTCAT

MKfile  CALL CRTM
        CALL MKFILE:RET NZ
        JP MKF
MKdir   CALL CRTM
        JP MKDIR

FNDELFL ;i:HL - Flag(1),Name(1-12),0

        CALL SRHDRN:RET Z
        LD (BRRR),HL
        LD (BRRR+2),DE
        LD A,#E5,(BC),A
        CALL STAMP

        LD HL,BRRR:CALL DLSG
        LD A,1:OR A
        RET
;-------
CRTM    PUSH HL
        CALL TMTOEN
        LD HL,ENTRY:CALL GENTRY
        POP HL
        RET
;-------
FUN     EXX
        LD HL,FUX,B,0,C,A
.2      ADD HL,BC
        LD A,(HL):INC HL
        LD H,(HL),L,A
        PUSH HL
        EXX:EXA
FEX     RET
;-------
FUX     DW MNGC_PL;0
        DW PRWOW
        DW RRESB
        DW PRSRW
        DW PRIAT
        DW GADRW
        DW CURSOR
        DW CURSER
        DW YN
        DW ISTR
        DW NORK
.2      DW FEX
        DW DMAPL
        DW TURBOPL
        DW GEDPL
;-------
        DW SPKE;16
        DW UPPP
        DW DWWW
        DW LFFF
        DW RGGG
        DW TABK
        DW ENKE
        DW ESC
        DW BSPC
        DW PGU
        DW PGD
        DW HOME
        DW END;28
;-------
        DW F1
        DW F2
        DW F3
        DW F4
        DW F5
        DW F6
        DW F7
        DW F8
        DW F9
        DW F10
;-------
        DW ALT;39
        DW SHIFT
        DW CTRL
;-------
        DW KBSCN;42
;-------
        DW FEX
        DW CAPS
;-------
        DW ANYK;45
        DW USPO;46
        DW NUSP
;-------
        DW XLD512; 48
        DW XSV512; 49
        DW XGIPGPL;50
        DW XTNTRY2;51
        DW XCHTS;  52
        DW XTNTRYN;53
        DW XTMRKFL;54
        DW XTMRKNX;55
        DW FEX;    56
        DW XSTREAM;57
        DW XMKFL;  58 (OLD)
        DW XFENTRY;59
        DW XLD256; 60
        DW XLDNON; 61

        DW XGFILE; 62
        DW XGDIR;  63
;-------
        DW MNGV_PL;64
        DW MNGCVPL;65
        DW GVmod;  66
        DW GYoff;  67
        DW GXoff;  68
        DW GVtm;   69
        DW GVtl;   70
        DW GVsgp;  71
;-------
        DW XMKfile;72
        DW XMKdir; 73
.4      DW FEX
;-------
        DW MNG0_PL;78
        DW MNG8_PL;79
        DW MNG0VPL;80
        DW MNG8VPL;81
;-------
GOPLG   LD A,PLHPG:CALL MNGC

        LD DE,#C000+64-512
PLG     LD HL,(PHED)
        OR A:SBC HL,DE:JR C,PF

        LD HL,512:ADD HL,DE:EX DE,HL

        LD HL,ENTRY+8
        PUSH DE:CALL CHext
        POP DE:JR Z,PLG

        EX DE,HL:LD BC,0-64:ADD HL,BC
        LD DE,LOBU,BC,256:LDIR
;-------
        LD BC,(ARRR)
        LD DE,(ARRR+2)
        LD HL,(LOBU+161+2)
        OR A:SBC HL,DE:JR C,PF,NZ,Pf
        LD HL,(LOBU+161)
        OR A:SBC HL,BC:JR C,PF

Pf      PUSH BC:CALL MYAU
        POP HL
        XOR A:CALL P8000
        PUSH AF
        LD A,2:CALL MNG8
        CALL GIPAGPL
        POP AF

        CP 3:CALL Z,SEXY

        EI:HALT
        RET
;-------
PF      LD A,1
        RET
MYAU    LD A,(LOBU),(PPGP),A,HL,LOBU+35
        ADD A,(HL)
        ADD A,PLGPG
        JP MNG8
;-------
RAJT    LD A,1
AJT     PUSH AF:CALL MYAU
        POP AF
        CALL P8000
        PUSH AF:LD A,2:CALL MNG8
        POP AF
        RET
;-------
RATM    LD A,PLHPG:CALL MNGC

        LD HL,#C000+197,DE,(PHED),BC,512

RAT     OR A:SBC HL,DE:JR NC,CAF
        ADD HL,DE
        LD A,(HL):ADD HL,BC
        CP 2:JR NZ,RAT
        LD BC,0-(512+197):ADD HL,BC
        LD DE,LOBU,BC,256:LDIR
        CALL AJT
CAF     LD HL,0
        JR MAF
;-------
TMAFK   CALL TAB4E:JR NZ,CAF
        LD HL,(TABTM):INC HL
        LD DE,(AFTM)
        OR A:SBC HL,DE:JR NC,RATM
        ADD HL,DE
MAF     LD (TABTM),HL
        RET
;-------
P8000   PUSH AF:XOR A:CALL MNGC
        POP AF

        LD BC,(PG0),(FEP),BC
        PUSH BC:LD BC,(BRRR+2)
        PUSH BC:LD BC,(BRRR)
        PUSH BC

        LD BC,(RSQBC),(RSQB2),BC
        LD (IXBU),IX
        CALL #8000
        LD IX,(IXBU)
        LD HL,(RSQB2),(RSQBC),HL

        POP HL:LD (BRRR),HL
        POP HL:LD (BRRR+2),HL
        POP HL
        PUSH AF:LD A,L:CALL MNG0,DEF
        POP AF
        RET
;---------------------------------------
        INCL "PS2P"
        INCL "WCFX"
        INCL "WCVLS"
        INCL "WCVW"
        INCL "WCINI"
;-------
DEHR1   INCB "DEHR1M"
MLZ4    INCB "MLZ40"
GIG_PAL INCB "GIG_PAL"
FONT    INCB "FONT32L"
KOIWIN  INCB "KOI_WIN"

NOre    ORG ENCODET,$
        INCL "ENCODET"
;---------------------------------------
        ORG #C000
CORE    EQU #4000
IDE_INI EQU CORE
SEL_DEV EQU CORE+3
REINI   EQU CORE+6
HDD     EQU CORE+9

RDD     EQU CORE+12
SDD     EQU CORE+15

GIPAG   EQU CORE+18
LOAD512 EQU CORE+21
SAVE512 EQU CORE+24

DOS_SWP EQU CORE+27

GLSTCAT EQU CORE+30
TLSTCAT EQU CORE+33

SRHFCL  EQU CORE+36
;EQU CORE+39
MKSG    EQU CORE+42
SVHDFL  EQU CORE+45
RFRH    EQU CORE+48

GENTRY  EQU CORE+51
TENTRY  EQU CORE+54

MKFILE  EQU CORE+57
MKDIR   EQU CORE+60

STAMP   EQU CORE+63
ENCEN   EQU CORE+66

DLSG    EQU CORE+69
CHTOSE  EQU CORE+72

SRHDR   EQU CORE+75
SRHDRN  EQU CORE+78

LOAD256 EQU CORE+81
LOADNON EQU CORE+84
;-------
        INCB "WDOSFC29"
