;---------------------------------------
;PS/2 HANDLER (STAND-ALONE)
;(C) BUDDER/MGN/2012
;---------------------------------------
RPT     EQU 25;AUTO REPEAT
;-------
TAB4E   LD HL,(TAB+#00):LD A,H:OR L
        LD HL,(TAB+#02):OR H,L
        LD HL,(TAB+#04):OR H,L
        LD HL,(TAB+#06):OR H,L
        LD HL,(TAB+#08):OR H,L
        LD HL,(TAB+#0A):OR H,L
        LD HL,(TAB+#0C):OR H,L
        LD HL,(TAB+#0E):OR H,L
        LD HL,(TAB+#10):OR H,L
        LD HL,(TAB+#12):OR H,L
        RET
;-------
ISTR    ;i:A=#FF Init:
;             i: HL - Address of string
;                 D - CURMAX
;                 E - CURNOW
;          A=#01 Terminate:
;             o: HL - Address of string
;
;          A=#XX Input(CALL every frame)

        INC A:JR Z,IINIT
        CP 2:JR Z,IEXIT

        CALL BSPC,NZ,IBS; Backspace

        CALL RGGG,NZ,IRG; Right Arrow
        CALL LFFF,NZ,ILF; Left Arrow

        CALL CLAvA:RET Z
        CALL ICPO
        LD (HL),A
        CALL IRG
        RET
;-------
IRG     LD BC,(ICUP)
        LD A,C:INC A
        CP B:RET NC
        CALL IRCU
        LD (ICUP),A
        JR ICUR
ILF     LD BC,(ICUP)
        LD A,C:DEC A
        CP B:RET NC
        CALL IRCU
        LD (ICUP),A
        JR ICUR
;-------
IBS     CALL ILF
        CALL ICPO:LD (HL),32
        RET
;-------
IINIT   LD (ISAD),HL
        LD (ICUP),DE

        CALL ICUR
        RET
IEXIT   CALL IRCU
        LD HL,(ISAD)
        RET
;-------
ICUR
IRCU    PUSH AF
        CALL ICPO:SET 7,L
        LD A,(HL):RRD
        POP AF
        RET

ICPO    LD HL,(ISAD),BC,(ICUP),B,0
        ADD HL,BC
        RET
;---------------------------------------
CLAvA   ;i:none
;        o: Z - no chars
;           A - char [a-z/A-Z;0-9]
;               also see TAI1,TAI2 tabls

        LD HL,TAB+13
        LD A,(HL):INC HL:OR A:JR Z,$-3
        CP #FF:RET Z

        CALL ARL:RET Z:LD A,(HL)

        LD HL,TAI0,B,48
AvA     CP (HL):JR Z,CLA:INC HL
        DJNZ AvA
        XOR A
        RET
CLA     LD BC,48:ADD HL,BC
        PUSH HL
        CALL SHIFT
        POP HL
        LD BC,48:JR Z,$+3:ADD HL,BC
        LD A,(HL)
        OR A
        RET
;---------------------------------------
CLAVA   ;i:none
;        o: Z - no chars
;           A - char [a-z;0-9]
;               also see TAI1 table

        CALL ART:RET Z

        LD HL,TAI0,B,48
AVA     CP (HL):JR Z,ClA:INC HL
        DJNZ AVA
        XOR A
        RET
ClA     LD BC,48:ADD HL,BC
        LD A,(HL):OR A
        RET
;---------------------------------------
NUSP    EI:HALT
        CALL ANYK:RET NZ
        JR NUSP
USPO    EI:HALT
        CALL ANYK:RET Z
        JR USPO
;---------------------------------------
UPPP    LD HL,BUP:JP ARC;UP
DWWW    LD HL,BDN:JP ARC;DOWN
LFFF    LD HL,BLF:JP ARC;LEFT
RGGG    LD HL,BRG:JP ARC;RIGHT
PGU     LD HL,BPU:JP ARC;pgUP
PGD     LD HL,BPD:JP ARC;pgDN

ENKE    LD A,#5A:JP ARL; ENTER
SPKE    LD A,#29:JP ARL; SPACE
BSPC    LD A,#66:JP ARL; BACKSPACE
HOME    LD A,#6C:JP ARL
END     LD A,#69:JP ARL
DELE    LD A,#71:JP ARL
INS     LD A,#70:JP ARL; INSERT

ESC     LD A,#76:JP AR2
F1      LD A,#05:JP AR2
F2      LD A,#06:JP AR2
F3      LD A,#04:JP AR2
F4      LD A,#0C:JP AR2
F5      LD A,#03:JP AR2
F6      LD A,#0B:JP AR2
F7      LD A,#83:JP AR2
F8      LD A,#0A:JP AR2
F9      LD A,#01:JP AR2
F10     LD A,#09:JP AR2

ALT     LD HL,BHM:JP ARG
SHIFT   LD HL,BCS:JP ARG
CTRL    LD HL,BSS:JP ARG
TABK    LD HL,TAB:JP ARC

ENK2    LD A,#5A,HL,TAB+13:JR II
ESC2    LD A,#76,HL,TAB+4
II      CP (HL):JR NZ,ArL
        JR AC
;-------
AR2     LD HL,TAB+4
        CP (HL):JR Z,ARC
ArL     XOR A
        RET
;-------
ART     LD HL,TAB+13
        LD A,(HL):INC HL:OR A:JR Z,$-3
        LD (ART+1),HL
        DEC HL:CP #FF:JR Z,BKZ

ARc     LD A,(HL):OR A:RET Z

        LD A,(ARK):CP (HL):JR NZ,ACZ
        LD A,(ARR)
        OR A:JR Z,ACZ
        CP #FF:JR NZ,ArCZ
        LD A,RPT,(ARR),A
ACZ     LD A,(HL)
        OR A
        RET
ArCZ    XOR A
        RET
BKZ     LD HL,TAB+13,(ART+1),HL:RET
;-------
ARL     LD HL,TAB+13,BC,7
        CPIR:JR NZ,ArL:DEC HL
;-------
ARC     LD A,(HL):OR A:RET Z
        LD A,(ARK):CP (HL):JR NZ,ArC
        LD A,(ARR)
        OR A:JR Z,AC
        CP #FF:JR NZ,ArC
        LD A,RPT,(ARR),A
AC      LD A,1:OR A
        RET
ArC     XOR A
        RET
;-------
ARG     LD A,(HL):OR A:RET Z
        JR AC
;-------
ANYK    LD HL,TAB,B,20
_XOR A:CP (HL):JR NZ,NYK:INC HL:DJNZ $-4
        RET
NYK     LD A,RPT,(ARR),A
        RET
;---------------------------------------
ALM     LD HL,TAB+13,BC,7
        CPIR:RET Z

        LD E,A
        XOR A
        LD HL,TAB+13,BC,7
        CPIR:RET NZ:DEC HL

        LD (HL),E
        LD (IX+24),E
        LD (IX+23),#FF
        RET
;---------------------------------------
OVER    LD BC,#DFF7,A,#0C:OUT A
        LD BC,#BFF7,A,#01:OUT A
        LD BC,#DFF7,A,#F0:OUT A

AGU     XOR A
GUI     LD (IX+22),A
        XOR A
        LD HL,TAB
        LD B,20,(HL),A:INC HL:DJNZ $-2
        LD A,1:OR A
        RET
K9      LD (BHM),A
        RET
;---------------------------------------
;GET SCAN CODE:
PSD2    LD IX,TAB

        LD A,(IX+23)
        OR A:JR Z,PSD
        CP #FF:JR Z,PSD
        DEC (IX+23)

PSD     LD BC,#DFF7,A,#F0:OUT A

        LD BC,#BFF7
Psd     IN A
        OR A:RET Z
        CP #E0:JR Z,Psd
        CP #F0:JP Z,KOF
        CP #FF:JR Z,OVER

BAT     JP Z,KoF

        CP #1F:JR Z,GUI
        CP #27:JR Z,GUI
;-------
        EXA
        LD A,(IX+22):OR A:RET NZ
        EXA
;-------
        CP #11:JR Z,K9;ALT
        CP #0D:JR Z,K0;TAB
        CP #58:JR Z,K1;CAPS
        CP #12:JR Z,K2;SHIFT
        CP #59:JR Z,K2
        CP #14:JR Z,K3;CTRL

        CP #0D:JR C,K4
        CP #76:JR Z,K4;ESC
        CP #78:JR Z,K4;F11
        CP #83:JR Z,K4;F7

        CP #75:JR Z,K5;U
        CP #6B:JR Z,K6;L
        CP #72:JR Z,K7;D
        CP #74:JR Z,K8;R

        CP #7D:JR Z,KA;PGup
        CP #7A:JR Z,KC;PGdn

        CP #77:JR Z,KB;NUML
        JP ALM
;-------
K0      LD HL,TAB+0:JR KFF
K1      LD HL,TAB+1:JR KFF
K2      LD HL,TAB+2:JR KFF
K3      LD HL,TAB+3:JR KFF
K4      LD HL,TAB+4:JR KFF
K5      LD HL,TAB+5:JR KFF
K6      LD HL,TAB+6:JR KFF
K7      LD HL,TAB+7:JR KFF
K8      LD HL,TAB+8:JR KFF
KA      LD HL,TAB+10:JR KFF
KB      LD HL,TAB+11:JR KFF
KC      LD HL,TAB+12
;-------
KFF     CP (HL):RET Z
        LD (HL),A
        LD (ARK),A
        LD (IX+23),#FF
        RET
;-------
KOF     IN A;                   BC=#BFF7
        OR A:JR Z,EBU
KoF     LD C,A
        LD A,#CA,(BAT),A
        LD A,C

        CP #1F:JP Z,AGU
        CP #27:JP Z,AGU

        LD HL,TAB,BC,20
        CPIR:RET NZ:DEC HL
        LD (HL),0
        RET

EBU     LD A,#C3,(BAT),A:RET
;-------
TAB     DS 1;  +0  TAB
        DS 1;  +1  CASP LOCK
        DS 1;  +2  SHIFT
        DS 1;  +3  CTRL
        DS 1;  +4  F1-F12
        DS 4;  +5  CURSOR KEYZ
        DS 4;  +9  ALT,pgUP,NUML,pgDN
        DS 7;  +13 oth KEYZ
        DB #FF
        NOP ;+21 NXF
        NOP ;+22 WIN
ARR     NOP ;+23 AR
ARK     NOP ;+24 LST KEY
;-------
TAI0    DB "@0E161E26252E363D3E46454E55"
        DB "@151D242D2C353C43444D545B5D"
        DB "@1C1B232B34333B424B4C52"
        DB "@1A22212A32313A41494A29"
;-------
TAI1    DB #7E,"1234567890-="
        DB "qwertyuiop[]\"
        DB "asdfghjkl;'"
        DB "zxcvbnm,./ "
TAI2    DB #7E,"!@#$%^&*()_+"
        DB "QWERTYUIOP{}|"
        DB "ASDFGHJKL:",#22
        DB "ZXCVBNM<>? "
;-------
CLST    NOP ;0-LOW, 1-HI
LANG    NOP ;0-ENG, 1-RUS

ISAD    DS 2
ICUP    NOP ;\
        NOP ;/
;-------
BCA     EQU TAB+1
BCS     EQU TAB+2
BSS     EQU TAB+3
BFS     EQU TAB+4

BUP     EQU TAB+5
BLF     EQU TAB+6
BDN     EQU TAB+7
BRG     EQU TAB+8

BHM     EQU TAB+9
BPU     EQU TAB+10
BED     EQU TAB+11
BPD     EQU TAB+12
BAL     EQU TAB+13
;---------------------------------------
