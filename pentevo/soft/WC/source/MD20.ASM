;Wild Commander
;(C) KOSHI/MGN 2018
;---------------------------------------
        ORG #6011
;-------
WID     EQU 80
AFKTIME EQU 50*60*1
MAXOP   EQU 8

DEFRQ   EQU %00000001;AY+Z80
CACHE   EQU %00000010
CACH2   EQU %00000110
INTM    EQU #5BFF;4 bytes!
;-------
BASIC48 EQU %00000011
;-------
STS     EQU #27AF

BORDER  EQU #0FAF

Vmod    EQU #00AF
Vpag    EQU #01AF
Vpal    EQU #07AF
Vfm     EQU #15AF
Vtm     EQU #16AF
Vtl0    EQU #17AF
Vtl1    EQU #18AF
Vsgp    EQU #19AF

VsinL   EQU #23AF
VsinH   EQU #24AF

PW0     EQU #10AF
PW1     EQU #11AF
PW2     EQU #12AF
PW4     EQU #13AF

SYC     EQU #20AF
CYC     EQU #2BAF
PE0     EQU #21AF

YoffL   EQU #04AF
YoffH   EQU #05AF
XoffL   EQU #02AF
XoffH   EQU #03AF
;-------
DMASL   EQU #1AAF
DMASH   EQU #1BAF
DMASX   EQU #1CAF
DMADL   EQU #1DAF
DMADH   EQU #1EAF
DMADX   EQU #1FAF

DMA_T   EQU #28AF;0=1, 255=256
DMA_N   EQU #26AF;255=512
DMA_C   EQU #27AF;RW 1 - - - 0 0 1
;-------
RSQB    EQU #8000

CURclr  EQU %01011000;\CUR COLOR in PANz
CURmsk  EQU %00000111;/MASK
TBG     EQU %00010111;TEXT COLOR
MARKclr EQU %00010011
WNDCLR  EQU %00011111

GSTP    EQU 4;Step (GFX Viewer)

PLHPG   EQU 96;     HEADERS
PLGPG   EQU PLHPG+1; PLUGINS
PLEPG   EQU PLGPG+63;/

MTXPG   EQU 0;       Main TXT Page
BUFPG   EQU 8;       BUFFER Page
TVBPG   EQU 32;      TXTbuf Start (Page)
TVEPG   EQU TVBPG+63;TXTbuf End (1024Kb)
TVvPG   EQU 8;   TXT/HEX video page
RESB    EQU 29
GVvPG   EQU 32;      GFX video page1
GV2PG   EQU GVvPG+16;GFX video page2
GV3PG   EQU GV2PG+16;GFX video page3
GV4PG   EQU GV3PG+16;GFX video page4

CATMX   EQU 9
CTZPG   EQU 11;CATMX pages per CAT
PNLPG   EQU #F0;Drivers
INIPG   EQU PNLPG+2
STRPG   EQU PNLPG+3;Streams
CPPG1   EQU 30;\
CPPG2   EQU 31;/ positions
D2PG    EQU #F6
D5PG    EQU #F5
DBPG    EQU #F4
RPPG    EQU #F7
;-------
RLPNL   EQU #1000
RRPNL   EQU #2000
RAPNL   EQU #2000-4

BUX     EQU #5E00;(256)
WINDC   EQU #5E80;(32)
TXTBU   EQU #5EA0;(64)

;fixed vars:
PG0     EQU #6000
PG4     EQU PG0+1
PG8     EQU PG0+2
PGC     EQU PG0+3
ABT     EQU PG0+4
ENT     EQU PG0+5
Fun     EQU PG0+6
TMN     EQU PG0+9
FEP     EQU PG0+11;\
XPP     EQU PG0+12;/
CNFv    EQU PG0+13
HEI     EQU PG0+14;\
TXTmdCO EQU PG0+15;/
INIflg  EQU PG0+16
RSQBC   EQU PG0+17
RSQB2   EQU PG0+19
SDBSF   EQU PG0+21;SDdriver
FEP2    EQU PG0+22;2b

LOBU    EQU #B000;Main Buffer
ETY     EQU #8000;CATZ hdrs
DNT     EQU #C000;CATZ
CURO    EQU #C000;POZs in browsing

GIG_PAL EQU 0;MTXPG

FLG     EQU 13
ELN     EQU FLG+1
;---------------------------------------
        DI
        NOP:LD SP,#6000-2
        NOP

        CALL INIT,#C000

        DI
INTA    LD HL,I_N_T,(INTM+0),HL
        LD HL,#C9FB,(INTM+2),HL
        DI
        LD A,INTM[,I,A:IM 2

        CALL FINI,DEF

        CALL PATH
;-------
MAIN    EI:HALT:CALL CURSOR
        CALL ALT,NZ,F12:JR NZ,MAIN
        CALL CTRL,NZ,F36:JR NZ,MAIN
        CALL UPPP,NZ,CRUP
        CALL DWWW,NZ,CRDN
        CALL PGU,NZ,PGSUP
        CALL PGD,NZ,PGSDN
        CALL HOME,NZ,PGSHM
        CALL END,NZ,PGSED
        CALL LFFF,NZ,PGSHM
        CALL RGGG,NZ,PGSED
        CALL DELE,NZ,DelFl
        CALL INS,NZ,Mark

        CALL BSPC,NZ,BENT
        CALL STATUS

        CALL SHIFT,NZ,R2B2:JR NZ,MAIN

        CALL F1,NZ,HELP
        CALL F3,NZ,VIEW
        CALL F10,NZ,F11MENU

        CALL TABK,NZ,XPAN

        CALL F4,NZ,EDIT
        CALL F5,NZ,COPY
        CALL F6,NZ,Move
        CALL F7,NZ,MkDir
        CALL F8,NZ,DelFl
        CALL F9,NZ,F9STP

        CALL SPKE,NZ,Mark

        CALL TMAFK

        CALL ENKE,NZ,ENTR
        JP MAIN
;---------------------------------------
ENTR    CALL GETEN
        EXA:LD A,H:OR L:RET Z
        EXA:JP NZ,VIE
        INC DE

        CALL MPATH
        CALL CURSER
        JP FOLDER

BENT    LD HL,0:CALL GETen:RET NZ
        LD A,H:OR L:RET Z

        LD B,2
Bent    INC DE:LD A,(DE):CP ".":RET NZ
        DJNZ Bent
        INC DE:LD A,(DE):OR A:RET NZ
.2      DEC DE

        CALL MPATH
        CALL CURSER

        XOR A
        LD (IX+12),1
        LD (IX+16),A
        LD (IX+17),A
        JP FOLDER
;---------------------------------------
XPAN    PUSH IX
        POP HL
        LD DE,WINDO2:OR A:SBC HL,DE
        JR Z,LPAN
;-------
RPAN    CALL CURSER
        CALL MNGP
        LD A,#42,(RAPNL+#C000),A
        LD IX,WINDO2:CALL DRACT
        JP STT

LPAN    CALL CURSER
        CALL MNGP
        LD A,#41,(RAPNL+#C000),A
        LD IX,WINDOW:CALL DRACT
        JP STT
;---------------------------------------
PGSED   CALL CURSER
        LD A,(IX+20):OR A:JR NZ,CR4
        LD L,(IX+16),H,(IX+17)
EDD     PUSH HL
        CALL Gwe
        POP HL:INC HL:JR NZ,EDD

        LD A,(IX+5):SUB 1,(IX+10)
        LD B,0,C,A
        OR A:SBC HL,BC
        LD A,H:CP #FF:RET NC
        LD (IX+16),L,(IX+17),H
        CALL WLIT
        JR CR4

PGSDN   CALL CURSER
        LD A,(IX+20):OR A:JR NZ,CR4
        LD A,(IX+5):SUB 2,(IX+10)
        LD C,A,B,0
        LD L,(IX+16),H,(IX+17):ADD HL,BC
        LD (IX+16),L,(IX+17),H
        CALL WLIT
CR4     CALL CR4EG
        JP STT

SM      PUSH HL:CALL CURSER:POP HL
        JR SL

PGSUP   ;LD A,(IX+21):OR A:RET NZ
        LD A,(IX+5):SUB 2,(IX+10)
        LD C,A,B,0
        LD L,(IX+16),H,(IX+17)
        OR A:SBC HL,BC:JR NC,SM
PGSHM   CALL CURSER
        LD HL,0,(IX+12),1
        JR SL
;-------
CRDN    LD A,(IX+12)
        CP (IX+13):JR NC,SRLDN
RDN     CALL CURSER
        INC (IX+12)
        JR STT
SRLDN   LD A,(IX+20):OR A:RET NZ
        LD L,(IX+16),H,(IX+17):INC HL
SL      LD (IX+16),L,(IX+17),H
        CALL WLIT
        JP CURSOR

CR4EG   LD A,(IX+20):OR A:RET Z
        LD A,(IX+13):OR A:RET Z
        LD (IX+12),A
        RET
CR4eg   LD A,(IX+13)
        OR A:JR NZ,$+3:INC A
        CP (IX+12):RET NC
        LD (IX+12),A
        RET
;-------
CRUP    LD A,(IX+12)
        CP 1:JR Z,SRLUP
RUP     CALL CURSER
        DEC (IX+12)
STT     CALL CURSOR
        LD A,1,(STUS),A
        RET
SRLUP   LD A,(IX+21):OR A:RET NZ
        LD L,(IX+16),H,(IX+17):DEC HL
        JR SL
;-------
CrDN    LD A,(IX+12)
        CP (IX+13):RET NC
        JR RDN
CrUP    LD A,(IX+12)
        CP 1:RET Z
        JR RUP
;-------
CrPU    CALL CURSER:LD (IX+12),1:JR STT
CrPD    CALL CURSER
        LD A,(IX+13),(IX+12),A:JR STT
;-------
PANK    LD L,(IX+18)
        LD H,(IX+19)
        LD A,(IX+17):CP H:RET C
        LD A,(IX+16):CP L:RET C

        LD A,(IX+5):SUB 2,(IX+10)
        LD B,0,C,A
        OR A:SBC HL,BC:JR NC,$+5:LD HL,0

        LD (IX+16),L
        LD (IX+17),H
        RET
;---------------------------------------
PANE    CALL PANELI
        LD (IX+23),A,(IX+24),A
        LD (IX+12),1
        LD (IX+16),A,(IX+17),A,(IX+26),A
        RET

PANELI  ;i:IX - SOW
        LD A,1
        LD (STUS),A
        XOR A
        LD (IX+13),A
        LD (IX+15),A
        LD (IX+20),A
        LD (IX+21),A
        RET

GETEN   ;i:IX - SOW
;        o:DE - flag addres
;          HL - ENTRY addres
;          ENTRY(12), BRRR(8)

        LD B,0,C,(IX+12):DEC C
        LD L,(IX+16),H,(IX+17)
        ADD HL,BC

GETen   CALL GWE
        PUSH HL
        INC HL
        LD DE,BRRR,BC,8:LDIR
        LD C,FLG-9:ADD HL,BC
        LD DE,ENTRY:CALL LNGSNM
        XOR A:LD (DE),A
        POP HL

        PUSH HL
        LD C,FLG:ADD HL,BC:EX DE,HL
        POP HL

        LD A,(DE):OR A
        RET
;-------
GETWE   LD L,(IX+16),H,(IX+17)
GWE     ADD HL,HL,HL,HL
        LD BC,DNT
        ADD HL,BC
        CALL CAT2
        LD A,(HL):INC L:LD (IX+26),A
        LD C,(HL):INC L
        LD B,(HL):INC L
        LD A,(HL),H,B,L,C
        LD C,A
        JP CAT1

Gwe     CALL GWE:LD A,H:OR L:RET
;-------
CURPOZ  LD A,(IX+22):OR A:RET Z
        CALL MNGC

        LD DE,CURO
        LD C,(IX+16),B,(IX+17)
        LD L,(IX+23),H,(IX+24)
        LD A,(IX+12)
        DEC A:JR Z,LUP

Lup     LD A,(IX+12)
        ADD HL,DE
        LD (HL),C:INC HL
        LD (HL),B:INC HL
        LD (HL),A:INC HL
        LD (HL),0:INC HL

        LD (IX+12),1
        LD (IX+16),0
        LD (IX+17),0

NEKO    OR A:SBC HL,DE
        LD (IX+23),L,(IX+24),H
        RET
;-------
LUP     LD A,B:OR C:JR NZ,Lup
        LD A,L:OR H:JR Z,Lup
        ADD HL,DE

        DEC HL
        DEC HL:LD A,(HL),(IX+12),A
        DEC HL:LD A,(HL),(IX+17),A
        DEC HL:LD A,(HL),(IX+16),A
        JR NEKO
;---------------------------------------
ER0     LD HL,TER0
ERX     CALL ERR0
        PUSH IX
        POP HL
        CALL SXM
        LD (IX+29),A,(IX+28),0
        CALL DRACT
        JR ORIG
ER1     LD HL,TER1
        JR ERX
;-------
ORIGA2  LD A,(HEI):SUB 2:LD (IX+5),A
        CALL PRWOW
ORIG    CALL DEV_INI:JR NZ,ER0
        CALL HDD:JR NZ,ER1

        LD HL,BRRR,B,4:CALL NOPING

        JP PANE

ORIGA   CALL ORIGA2
FOLD    CALL NEWDIR
        CALL PANK
        CALL WLIT,CR4eg
        XOR A
        RET

FOLDER  CALL PANELI,CURPOZ
        JP FOLD

;---------------------------------------
;GENERATING DIRECTORY IN RAM:
NEWDIR  ;i:BRRR(4) - fstCLUS of NEW DIR

        CALL PPATH

        LD HL,BRRR:CALL GLSTCAT

        XOR A
        LD (IX+18),A,(IX+19),A
        INC A:LD (IX+26),A:CALL CAT1
        CALL CAT0

        XOR A:LD (DNT+ELN),A
        LD DE,DNT
        PUSH DE
        XOR A:LD (DE),A:INC DE
        CALL BDSL,NXTETY,BDSH
        LD BC,DE,HL,ETY-1
        POP DE:JP Z,BEX
        LD HL,FLG:ADD HL,DE
        LD A,(HL):OR A:JR NZ,XX
        INC HL:LD A,(HL):CP ".":JR NZ,XX
        INC HL:LD A,(HL):OR A

XX      LD HL,ETY,DE,DNT:JR Z,BUMM
        LD A,(IX+26)
        LD (HL),A:INC L
        LD (HL),E:INC L
        LD (HL),D:INC L
        LD A,(TTHL)
        LD (HL),A:INC HL
        LD DE,BC:INC (IX+18)

BUMM    DEC HL
BUM     LD A,D:CP #FE:JR C,DOOM
        INC (IX+26):CALL CAT1
        LD DE,DNT

DOOM    LD A,(IX+26):CP CATMX:JR NC,BEX
        LD C,A
        LD A,H:CP ETY[:JR C,DuuM+1
        LD A,(TTHL)
DuuM    LD (HL),A:INC HL
        LD (HL),C:INC L
        LD (HL),E:INC L
        LD (HL),D:INC L
        INC (IX+18):JP NZ,AXA
        INC (IX+19)

AXA     XOR A:LD (DE),A:INC DE
        PUSH HL:CALL BDSL,NXTETY,BDSH
        POP HL:JR NZ,BUM

.4      DEC HL
        DEC (IX+18)
        LD A,(IX+18):INC A:JR NZ,BEX
        DEC (IX+19)

BEX     XOR A
        INC HL
        LD (HL),A:INC L
        LD (HL),A:INC L
        LD (HL),A

        LD A,2:CALL MNG8

        LD A,(IX+26):CP 1:RET NZ
        LD A,(IX+19):OR A:JR NZ,SPM
        LD A,(IX+18):CP 200:JR C,SORTZ
SPM     PUSH IX:LD IX,SMWND:CALL PRWOW
        POP IX
        CALL SORTZ
        PUSH IX:LD IX,SMWND:CALL RRESB
        POP IX
        RET

SORTZ   LD A,CACH2:CALL CaC
        CALL SORT
        CALL FRST
        JP CAC

LNGSNM  LD C,(HL):INC HL

        LD B,8
LNG_    LD A,(HL)
        OR A:JR Z,LNGSF
        CP ".":JR Z,LNGSE
        LD (DE),A:INC HL,DE
        DJNZ LNG_
        LD A,(HL):OR A:JR Z,LNGSF
        LD A,C:OR A:JR Z,LNGSF
SE      XOR A:LD BC,256:CPIR:DEC HL

        LD A,256-1:SUB C:JR Z,LNGSF
        CP 4:LD B,A:JR C,Se
        LD B,4
Se      DEC HL:LD A,(HL):CP ".":JR Z,SFE
        DJNZ Se

LNGSF   INC B,B,B
SF      LD A," ",(DE),A:INC DE:DJNZ $-2
        RET
SFE     LD B,3
Sf      INC HL:LD A,(HL):OR A:JR Z,SF
        CP #40:JR C,EXTR
        CP #80:JR NC,$+4:RES 5,A
EXTR    LD (DE),A:INC DE
        DJNZ Sf
        RET
LNGSE   CALL SF:JR SE

BDSL    LD (TTDE),DE:RET
BDSH    EXA
        LD HL,DE
        LD BC,(TTDE)
        OR A:SBC HL,BC
        LD BC,15:SBC HL,BC
        LD (TTHL),HL
        EXA
        RET
;---------------------------------------
WLIT    XOR A
        LD (IX+13),A
        LD (IX+20),A
        LD (IX+21),A
        INC A
        LD (STUS),A

        LD H,(IX+17),L,(IX+16)
        LD DE,#0101
        LD A,H:OR L:JR NZ,A123
        LD (IX+21),1
A123    PUSH HL,DE

        CALL GWE

        LD A,H:OR L:JR Z,EPG
        LD A,(HL),(RSTB),A
        LD DE,FLG:ADD HL,DE
        LD A,(HL),(RSTA),A:INC HL

        LD DE,TXTBU:CALL CGD
        POP DE,HL:INC HL
        INC (IX+13)

        PUSH HL
        LD HL,TXTBU
        LD BC,38:CALL PRSRW:INC D
        LD C,TBG
        LD A,(RSTB):OR A:JR Z,$+3:LD C,A
        LD A,(RSTA):OR A:LD A,C
        JR NZ,$+4:OR %00001000

        CALL PRIAT
        LD A,(IX+5):SUB 2,(IX+10)
        POP HL:CP D:JR NC,A123

        CALL GWE:LD A,H:OR L:RET NZ
        LD (IX+20),1
        RET

EPG     POP DE,HL
        LD (IX+20),1
E_G     LD HL,TXTBU
        PUSH HL:LD B,40:CALL NOPING
        POP HL
        LD BC,38:CALL PRSRW:INC D
        LD A,TBG
        CALL PRIAT
        LD A,(IX+5):SUB 2,(IX+10)
        CP D:JR NC,E_G
        RET

CGD     ;LD A,(LFLT):BIT 2,A:JR NZ,CGE

        LD B,38,C,B
        XOR A
CG1     CP (HL):JR Z,CG2
        LDI:DJNZ CG1
        RET
CG2     LD (DE),A:INC DE:DJNZ $-2
        RET

;CGE
;RET
;---------------------------------------
YN      CP 1:JR Z,IYN
        CP #FF:JR Z,EYN
        CALL LFFF,NZ,AYES
        CALL RGGG,NZ,ANOP

        LD DE,(AAHL)
        LD HL,TXT00,BC,8:CALL PRSRW
YNmc    LD A,%11110111:CALL PRIAT

        LD DE,(AADE)
        LD HL,TXT01,BC,8:CALL PRSRW
YNm2    LD A,%00000111:JP PRIAT

EYN     LD A,(YNmc+1),HL,CSEL:CP (HL)
        RET

IYN     LD A,(IX+6)
.4      RLCA
        LD (CSEL),A
        LD A,(IX+6):AND %11110000
.4      RLCA
        LD (CNSL),A

        LD A,(IX+5):SUB 2
        LD D,A,H,A
        LD A,(IX+4):SRL A:SUB 9
        LD L,A:ADD A,10:LD E,A

        LD (AAHL),HL
        LD (AADE),DE
;-------
AYES    LD A,(CSEL),(YNmc+1),A
        LD A,(CNSL),(YNm2+1),A
        RET
ANOP    LD A,(CNSL),(YNmc+1),A
        LD A,(CSEL),(YNm2+1),A
        RET
;---------------------------------------


;-  -  -  -  -  -  -  -  -  -  -  -  -
I_N_T   PUSH AF,BC,DE,HL,IX
        EXX:EXA
        PUSH AF,BC,DE,HL

        LD HL,(TMN):INC HL:LD (TMN),HL

        LD A,(INTPL):OR A:CALL NZ,INTP
        CALL VPRT
        LD A,(INTPS):OR A:CALL NZ,PSD2
        LD A,(INTTM):OR A:CALL NZ,TIME

        CALL ESC2,NZ,ABTF
        CALL ENK2,NZ,ENTF

        POP HL,DE,BC,AF
        EXX:EXA
        POP IX,HL,DE,BC,AF
        EI
        RET
;-  -  -  -  -  -  -  -  -  -  -  -  -

VPRT    LD HL,VVpag

        LD BC,Vpag+256:OUTI
        LD B,Vmod[+#01:OUTI

        LD B,YoffL[+1:OUTI
        LD B,YoffH[+1:OUTI
        LD B,XoffL[+1:OUTI
        LD B,XoffH[+1:OUTI
        RET

ENTF    LD A,1,(ENT),A:RET
ABTF    LD A,1,(ABT),A:RET

TIME    LD HL,TMR
        LD A,(HL):OR A:JR Z,IME:DEC (HL)
        LD A,(HL)
.2      ADD A,(HL)
        LD B,0,C,A
        SUB (HL)
        LD HL,TTM+6
        OR A:SBC HL,BC

        LD BC,#DFF7:OUT A
        LD B,#BF:IN A
        CALL NORK
        JR HIME

IME     INC HL
_LD A,(HL):DEC A:LD (HL),A:RET NZ

        INC HL
        LD A,(HL):DEC HL
        LD (HL),A:DEC HL
        LD (HL),3
        RET

HIME    XOR A:CALL MNgC
        LD HL,TTM,DE,#C000+72,BC,8:LDIR
        JP MNGCR
;-------
TMTOEN  LD D,0
        LD A,2:CALL SEDT
        LD E,A
.5      SLA E:RL D
        XOR A:CALL SEDT:SRL A
        OR E:LD E,A
        LD A,4:CALL SEDT
.3      SLA A
        OR D:LD D,A
        LD (ENTRY+14),DE
        LD (ENTRY+22),DE

        LD A,9:CALL SEDT:ADD A,20
        LD D,A
        LD A,8:CALL SEDT
.5      SLA A
        RL D:LD E,A
        LD A,7:CALL SEDT
        OR E:LD E,A
        LD (ENTRY+16),DE
        LD (ENTRY+18),DE
        LD (ENTRY+24),DE
        RET

SEDT    LD BC,#DFF7:OUT A
        LD B,#BF:IN A

        LD C,A:AND %00001111:LD B,A
.4      SRL C
        LD A,C
.9      ADD A,C
        ADD A,B
        RET
;---------------------------------------
SWPPAN  PUSH IX
        POP HL
        LD DE,WINDOW
        OR A:SBC HL,DE:JR NZ,PPA
        LD IX,WINDO2
        RET
PPA     LD IX,WINDOW
        RET

DRACT   CALL FRST
        LD A,(IX+28):OR A:RET NZ

        CALL RPATH
        LD (IX+28),1
        LD A,(IX+29)
        JP DOS_SWP
FRST    LD A,PNLPG:ADD A,(IX+27):JP MNG0
;---------------------------------------
MNG0D   LD BC,PE0,A,%00000001:OUT A
        LD BC,PW0,A,%00000000:OUT A
        RET
MNG0I   LD BC,PE0,A,%00001110:OUT A
        RET
MNG0    LD (PG0),A,BC,PW0:OUT A;NeedInit
        RET

MNG4    LD (PG4),A,BC,PW1:OUT A:RET
MNG8R   LD A,(PG8)
MNG8    LD (PG8),A
MNg8    LD BC,PW2:OUT A:RET

MNGCM   XOR A:JP MNGC
MNGCR   LD A,(PGC)
MNGC    PUSH BC:LD (PGC),A,BC,PW4:OUT A
        POP BC
        RET
MNgC    LD BC,PW4:OUT A:RET
MNGP    LD A,RPPG:JR MNGC
;-------
CAT3    LD A,CTZPG
        ADD A,(IX+25)
        JP MNG0
CAT2    LD A,CTZPG
        ADD A,(IX+25)
        JP MNGC
CAT1    LD A,CTZPG
        ADD A,(IX+26)
        ADD A,(IX+25)
        JP MNGC
CAT0    LD A,CTZPG
        ADD A,(IX+25)
        JP MNG8
;-------
MNGC_PL CP #FE:JR Z,MNGCM
        CP #FF:JR Z,MNGCFNT
        CP 64:RET NC
        ADD A,PLGPG
        PUSH HL:LD HL,PPGP:ADD A,(HL)
        POP HL
        JP MNGC
MNGCFNT LD A,1:JP MNGC

MNG0_PL CP 64:RET NC
        ADD A,PLGPG
        PUSH HL:LD HL,PPGP:ADD A,(HL)
        POP HL
        JP MNG0

MNG8_PL CP 64:RET NC
        ADD A,PLGPG
        PUSH HL:LD HL,PPGP:ADD A,(HL)
        POP HL
        JP MNG8

MNGCVPL CP 16*4:RET NC
        ADD A,GVvPG
        JP MNGC
MNG0VPL CP 16*4:RET NC
        ADD A,GVvPG
        JP MNG0
MNG8VPL CP 16*4:RET NC
        ADD A,GVvPG
        JP MNG8

MNGV_PL CP 1:JR Z,VB1
        CP 2:JR Z,VB2
        CP 3:JR Z,VB3
        CP 4:JP NZ,GED
VB4     LD A,GV4PG:JR VB1+2
VB3     LD A,GV3PG:JR VB1+2
VB2     LD A,GV2PG:JR VB1+2
VB1     LD A,GVvPG,(VVpag),A
        RET

GVtm    LD A,C:CP 16*4:RET NC
        ADD A,GVvPG:LD BC,Vtm:OUT A
        RET
GVtl    LD A,C:CP 16*4:RET NC
        ADD A,GVvPG
        BIT 0,B:JR NZ,Stl1
        LD BC,Vtl0:OUT A:RET
Stl1    LD BC,Vtl1:OUT A:RET
GVsgp   LD A,C:CP 16*4:RET NC
        ADD A,GVvPG:LD BC,Vsgp:OUT A
        RET
;-------
NOPING  XOR A:LD (HL),A:INC HL:DJNZ $-2
        RET

GEDPL
GED     DI
        XOR A
        LD (VVpag),A,(INIflg),A

DED     LD A,(TXTmdCO),(VVmod),A

DDD     XOR A
        LD B,A,C,A
        LD (VYofL),BC
        LD (VXofL),BC

        EI:HALT
        LD BC,BORDER:OUT A

        LD A,GVvPG:CALL MNGC
        CALL PABE
        LD HL,PALLIT,DE,#1000,BC,32:LDIR
        LD HL,PALLIT,DE,#11E0,C,32:LDIR
        CALL PAED
        LD BC,Vpal:OUT A
        RET
PAED    XOR A:LD BC,Vfm:OUT A:RET
PABE    LD A,%00010001
PAbe    LD BC,Vfm:OUT A:RET

Vv      XOR A
        LD B,A,C,A
        LD (VYofL),BC
        LD (VXofL),BC
        LD (VVpag),A
        LD BC,BORDER:OUT A
        RET

GVmod   LD (VVmod),A:RET
GYoff   LD (VYofL),HL:RET
GXoff   LD (VXofL),HL:RET
;---------------------------------------
DEL64
.6      SRL D:RR E,H,L
        RET

DLT4PCH LD BC,(PBSTH+1),A,B:OR C
        LD BC,(PBSTL+1):OR B,C:RET Z

DELIT4P LD IX,0-1
NAZE    OR A
PBSTH   LD BC,0:INC IX
        EX DE,HL:SBC HL,BC:JR C,ND
PBSTL   LD BC,0
        EX DE,HL:SBC HL,BC:JR NC,PBSTH
        DEC DE
        LD A,D:INC A:JR NZ,NAZE
        LD A,E:INC A:JR NZ,NAZE
        INC DE

        ADD HL,BC
        EX DE,HL
        LD BC,(PBSTH+1)
ND      ADD HL,BC
        EX DE,HL
        PUSH IX
        POP BC
        LD A,C:ADD A,#30
        RET

DECZON4 ;i:[DE,HL] - int32
;           EXX DE - String address
;        o:Decimal string(10)

        LD BC,#CA00,(PBSTL+1),BC
        LD BC,#3B9A,(PBSTH+1),BC
        CALL DELIT4P
        EXX:LD (DE),A:INC DE:EXX

        LD BC,#E100,(PBSTL+1),BC
        LD BC,#05F5,(PBSTH+1),BC
        CALL DELIT4P
        EXX:LD (DE),A:INC DE:EXX

        LD BC,#9680,(PBSTL+1),BC
        LD BC,#0098,(PBSTH+1),BC
        CALL DELIT4P
        EXX:LD (DE),A:INC DE:EXX

        LD BC,#4240,(PBSTL+1),BC
        LD BC,#000F,(PBSTH+1),BC
        CALL DELIT4P
        EXX:LD (DE),A:INC DE:EXX

        LD BC,#86A0,(PBSTL+1),BC
        LD BC,#0001,(PBSTH+1),BC
        CALL DELIT4P
        EXX:LD (DE),A:INC DE:EXX
;-------
DECZON2 LD BC,10000,(PBSTL+1),BC
        LD BC,0,(PBSTH+1),BC
        CALL DELIT4P
        PUSH HL
        EXX:LD (DE),A:INC DE
        POP HL
DECZ2   LD BC,1000
        CALL DELIT
        LD (DE),A:INC DE
DECZ1   LD BC,100
        CALL DELIT
        LD (DE),A:INC DE
DECZ    LD C,10
        CALL DELIT
        LD (DE),A:INC DE
        LD C,1
        CALL DELIT
        LD (DE),A:INC DE
        RET
;-------
DELIT   LD A,#FF
        OR A
DLIT    INC A
        SBC HL,BC:JP NC,DLIT
        ADD HL,BC,A,#30
        RET
;-------
NORK    ;i:HL,Addr A,val
        INC HL
        LD C,A
        AND %00001111
        CP 10:JR C,$+4:ADD A,7
        ADD A,#30
        LD (HL),A:DEC HL
        LD (HL),C
        XOR A
        RLD
        CP 10:JR C,$+4:ADD A,7
        ADD A,#30
        LD (HL),A
        INC HL,HL
        RET

INIT    LD BC,Vmod,A,%00110000:OUT A

        LD BC,#EFF7,A,#80:OUT A
        LD B,#DF,A,#F0:OUT A
        LD B,#BF,A,#02:OUT A

        LD A,DEFRQ:CALL TURBO

INTPLD  XOR A
        LD (INTPL),A
        INC A
        LD (INTTM),A
        LD (INTPS),A
        RET

TURBOof LD BC,#EFF7:XOR A:OUT A
BOF     EQU $+1
        LD A,0
TURBO   AND %00000011
        LD BC,SYC:OUT A
CAC     LD A,CACHE
CaC     LD BC,CYC:OUT A
        RET
;---------------------------------------
XLD512  CALL XPO,XPo
        PUSH DE:CALL MNGCR,LOAD512
        POP DE
        CALL XPc:JP XPC
XSV512  CALL XPO,XPo
        PUSH DE:CALL SAVE512
        POP DE
        CALL XPc:JP XPC
XGIPGPL CALL XPO,GIPAGPL:JP XPC
XTNTRY2 CALL XPO,TENTRY2:JP XPC
XCHTS   CALL XPO,CHTOSEP:JP XPC
XTNTRYN CALL XPO,TENTRYN:JP XPC
XTMRKFL CALL XPO,TMRKDFL:JP XPC
XTMRKNX CALL XPO,TMRKNXT:JP XPC
XADIR   CALL XPO,ADIR:JP XPC
XSTREAM CALL XPO,STREAM
        LD A,(PG0),(FEP),A:JP XPC
XXTETY2 CALL XPO,NXTETY2:JP XPC
XFENTRY CALL XPO,FENTRY2:JP XPC
XLD256  CALL XPO,LOAD256:JP XPC
XLDNON  CALL XPO,LOADNON:JP XPC
XGFILE  CALL XPO,GFILE:JP XPC
XGDIR   CALL XPO,GDIR:JP XPC
XMKfile CALL XPO,MKfile:JP XPC
XMKdir  CALL XPO,MKdir:JP XPC
XREname CALL XPO,RENAM:JP XPC
XDelFl  CALL XPO,FNDELFL:JP XPC

XPO     PUSH AF,BC
        LD A,(PG0),(XPP),A
        LD A,(FEP):CALL MNG0
        POP BC,AF
        RET
XPC     PUSH AF,BC
        LD A,(XPP):CALL MNG0
        POP BC,AF
        RET

XPo     PUSH AF,BC
        LD D,1
        LD A,H:CP #40:JR NC,Xpo:DEC D
        LD A,(PGC),E,A
        LD A,(XPP):CALL MNGC
        LD BC,#C000:ADD HL,BC
Xpo     POP BC,AF
        RET

XPc     PUSH AF,BC
        DEC D:JR Z,Xpc
        LD A,E:CALL MNGC
        LD BC,0-#C000:ADD HL,BC
Xpc     POP BC,AF
        RET

TURBOPL INC B:JR Z,DEF
        DEC B:JR NZ,TAY
        LD A,C:AND %00000011
        LD C,A,B,%00111000
Tay     LD A,(AYZ80):AND B:OR C
Ta      LD BC,SYC:OUT A
        LD A,CACHE
        LD BC,CYC:OUT A
        RET
TAY     LD A,C:AND %00000111
.3      SLA A
        LD C,A,B,%00000011
        JR Tay
DEF     LD A,(DFRQ):AND %00111011:JR Ta
GIPAGPL LD HL,BRRR:JP GIPAG
TENTRY2 LD HL,ENTRY,BC,32:LDIR:RET
CHTOSEP LD HL,BRRR:JP CHTOSE
;-------
PDST3   LD A,%00000001;RAM2RAM
        JR PUDZ
PDST4   LD A,%10000001;BLT2RAM
        JR PUDZ
PDST5   LD A,%00000100;FILL
        JR PUDZ
PDST6   LD A,%10000100;RAM2CRAM
        JR PUDZ
PDST7   LD A,%10000101;RAM2SFILE
PUDZ    LD HL,DSA
        OR (HL):INC HL
        OR (HL):INC HL
        OR (HL)
        EXA:CALL PDSTS:RET NZ
        EXA
        LD BC,DMA_C:OUT A
        JR DSTS

DMAPL   CP #FC:JR Z,PDST3
        CP #FB:JR Z,PDST4
        CP #FA:JR Z,PDST5
        CP #F9:JR Z,PDST6
        CP #F8:JR Z,PDST7

        CP #FF:JR Z,DSTS
        CP #FE:JR Z,PDST1
        CP #FD:JR Z,PDST2

        OR A:JR Z,PDISD
        DEC A:JR Z,PDIS
        DEC A:JR Z,PDID
        DEC A:JR Z,PDISP
        DEC A:JR Z,PDIDP
        DEC A:JR Z,PDIT
        DEC A:JR Z,PDIN;6

        DEC A:JP Z,PDITN
        DEC A:JP Z,PDISSA
        DEC A:JP Z,PDISDA
        DEC A:JP Z,PDISAS
        DEC A:JP Z,PDISDS;11
        RET
DSTS    LD BC,STS:INF:JP M,$-2:XOR A:RET
PDSTS   LD BC,STS:INF:JP M,$+5:XOR A:RET
        LD A,1:OR A
        RET
PDST1   CALL PDST2:RET NZ:JR DSTS
PDST2   CALL PDSTS:RET NZ
        LD BC,DMA_C,A,%00000001:OUT A
        XOR A
        RET
PDISD   PUSH BC:CALL PDIS
        POP BC
        JR PDID
PDIS    LD A,B:CALL PDBIT
PDis    LD BC,DMASL:OUT L
        LD B,DMASH[:OUT H
        LD B,DMASX[:OUT A:RET
PDID    LD A,C:CALL PDBIT
PDid    LD BC,DMADL:OUT E
        LD B,DMADH[:OUT D
        LD B,DMADX[:OUT A:RET
PDISP   CALL PDPG:JR PDis
PDIDP   CALL PDPG:JR PDid
PDIT    LD A,B,BC,DMA_T:OUT A:RET
PDIN    LD A,B,BC,DMA_N:OUT A:RET
PDITN   PUSH BC:CALL PDIT
        POP BC:LD B,C:JR PDIN

PDISDS  LD C,E:CALL PDISAS
        LD C,H:CALL PDISSA
        LD C,L:JR PDISDA
PDISSA  LD A,C:RRC A,A,A:AND %00100000
        LD (DSA),A
        RET
PDISDA  LD A,C:RRC A,A,A,A:AND %00010000
        LD (DDA),A
        RET
PDISAS  LD A,C:SLA A,A,A:AND %00001000
        LD (DAS),A
        RET
;-------
PDBIT   BIT 7,A:JR NZ,PDBI
        AND 63:ADD A,GVvPG
        RET
PDBI    AND 15:ADD A,PLGPG
        EXX:LD HL,PPGP:ADD A,(HL)
        EXX
        RET
PDPG    LD A,B:AND 3
        EXX:LD H,PG0[,L,A,A,(HL)
        EXX
        RET

KBSCN   OR A:JP Z,CLAvA
        DEC A:JP Z,CLAVA
        RET

TENTRYN RET
TMRKDFL LD A,H:OR L:JP Z,MARKSRH

        BIT 7,H
        PUSH AF
        RES 7,H
        PUSH DE
        PUSH HL:LD HL,0
        EXX
        POP DE:LD HL,0
RKsrh   EXX
        LD (MRRN),HL:CALL Gwe:JR Z,ERk

        LD A,(HL):OR A
        LD HL,(MRRN):INC HL:JR Z,RKsrh+1
        EXX
        INC HL:OR A:SBC HL,DE:JR Z,EGE
        ADD HL,DE
        JP RKsrh
EGE     EXX:DEC HL
        CALL GETen
        EX DE,HL:INC HL
        POP DE

        LD BC,#FFFF
FEED    LD A,(HL):OR A:JR Z,EzE
        LD A,D
        CP #C0:JR NC,E_E
        LDI:DJNZ FEED

EzE     XOR A:LD (DE),A
E_E     POP AF:CALL Z,GIPAGPL

        XOR A
        RET
ERk     POP DE,AF
        LD A,1:OR A
        RET
MARKSRH LD HL,0:XOR A:LD (ABT),A
        EXX:LD BC,0
RKSRH   EXX
        LD (MRRN),HL:CALL Gwe:JR Z,ERK

        LD A,(HL):OR A
        LD HL,(MRRN):INC HL:JR Z,RKSRH+1
        EXX
        INC BC
        JP RKSRH
ERK     EXX
        LD HL,0
        LD (MRRN),HL
        LD (MRCT),BC
        LD A,B:OR C
        RET
TMRKNXT RET

STREAM  LD A,D
        CP #FF:JR Z,ACRD
        CP #FE:JR Z,CSTR
        PUSH BC
        AND 1:ADD A,STRPG:CALL MNG0
        POP BC

        LD E,B
        INC BC
        LD A,B:OR C:RET Z
        LD A,E

TSBC    OR A:JR Z,BDSD
        DEC A:LD C,#00:JR Z,BDIS
        DEC A:LD C,#05:JR Z,BDIS
        DEC A:JR Z,BDSD
        DEC A:LD C,#03:JR Z,BDIS
        DEC A:LD C,#04:JR Z,BDIS
BDSD    LD C,#01
BDIS    LD A,C
        CALL DOS_SWP
        CALL DEV_INI:RET NZ
        CALL HDD:RET NZ
        XOR A
        RET
ACRD    LD HL,0
        LD (CRRR),HL
        LD (CRRR+2),HL
        JP GDIR

CSTR    LD HL,0
        LD DE,HL
        LD A,(FEP2):CALL PDis
        LD A,STRPG:CALL PDid
        LD B,31:CALL PDIT
        LD B,255:CALL PDIN
        LD BC,DMA_C,A,%00000001:OUT A
        CALL DSTS

        LD A,(FEP2):CALL PDis
        LD A,STRPG+1:CALL PDid
        LD BC,DMA_C,A,%00000001:OUT A
        CALL DSTS

        LD A,STRPG
        JP MNG0

FYJ     LD B,255:INC HL
FYI     LD A,(HL)
        OR A:RET Z
        CP "\":SCF:RET Z
        CP "/":SCF:RET Z
        INC HL:DJNZ FYI
        XOR A:DEC A
        RET
FIJ     LD DE,BUX,(DE),A:INC DE,HL
        EXA
        LD A,255:SUB B:RET Z
        LD C,#FF,B,A:LDI:DJNZ $-2
        LD (TTHL),HL
        XOR A:LD (DE),A
        EXA
        INC A
        RET

FENTRY2 PUSH HL:CALL FYJ
        POP HL:JR C,$+4,Z,FENTRY
        INC A:RET Z

        LD A,#10:CALL FIJ:RET Z

        CALL SAVECD
FYD     LD HL,BUX:CALL SRHDRN:JR Z,FYA
        LD (CRRR),HL
        LD (CRRR+2),DE
        CALL GDIR

        LD HL,(TTHL)
        CALL FYJ:JR C,FIA,Z,FIG
FYA     CALL FIN
        XOR A
        RET
FIA     LD A,#10
FIG     LD HL,(TTHL):CALL FIJ:JR Z,FYA
        CP #10+1:JR Z,FYD

        LD HL,BUX:CALL FENTRY:JR Z,FYA
FIN     PUSH HL,DE
        CALL LOADCD
        POP DE,HL
        XOR A:INC A
        RET

SAVECD  LD DE,DRRR:JP TLSTCAT
LOADCD  LD HL,DRRR:JP GLSTCAT

FENTRY  CALL SRHDRN:RET Z
        LD (CRRR),HL
        LD (CRRR+2),DE
        EXX
        LD DE,ENTRY:CALL TENTRY
        LD HL,(ENTRY+28)
        LD DE,(ENTRY+30)
        RET
ADIR    LD DE,CRRR:CALL TLSTCAT
        CP 1:JR Z,GDIR
        OR A:RET NZ
GFILE   LD HL,CRRR:JP GIPAG
GDIR    LD HL,CRRR:JP GLSTCAT

MKfile  CALL CRTM
        CALL MKFILE:RET NZ

        LD (BRRR),HL,(BRRR+2),DE

        PUSH HL,DE
        LD DE,ENTRY:CALL TENTRY
        CALL GIPAGPL
        POP DE,HL

        XOR A
        RET

MKdir   CALL CRTM
        JP MKDIR

FNDELFL ;i:HL - Flag(1),Name(1-12),0

        CALL DELFL:RET Z
        RET
;-------
INTP    JP 0
INTPI   LD (INTP+1),HL,(INTPL),A:RET
INT_PL  CP #FF:JR Z,INTPI

        OR A:JR Z,DISALL
        DEC A:JR Z,DISTM
        DEC A:JR Z,DISPS
        RET

DISALL  CALL DISPS
        LD (INTPL),A
DISTM   LD (INTTM),A:RET
DISPS   LD (INTPS),A:RET
;-------
CRTM    PUSH HL
        CALL TMTOEN
        LD HL,ENTRY:CALL GENTRY
        POP HL
        RET
;-------
FUN     EXX
        PUSH HL
        LD HL,FUX,B,0,C,A
.2      ADD HL,BC
        LD C,(HL):INC HL
        LD B,(HL)
        POP HL
        PUSH BC
        EXX:EXA
FEX     RET
;-------
FUX     DW MNGC_PL;0
        DW PRWOW
        DW RRESB
        DW PRSRW
        DW PRIAT
        DW GADRW
        DW CURSOR
        DW CURSER
        DW YN
        DW ISTR
        DW NORK
        DW TXTPR
        DW MEZZ
        DW DMAPL
        DW TURBOPL
        DW GEDPL
;-------
        DW SPKE;16
        DW UPPP
        DW DWWW
        DW LFFF
        DW RGGG
        DW TABK
        DW ENKE
        DW ESC
        DW BSPC
        DW PGU
        DW PGD
        DW HOME
        DW END;28
;-------
        DW F1
        DW F2
        DW F3
        DW F4
        DW F5
        DW F6
        DW F7
        DW F8
        DW F9
        DW F10
;-------
        DW ALT;39
        DW SHIFT
        DW CTRL
;-------
        DW KBSCN;42
;-------
        DW DELE
        DW CAPS
;-------
        DW ANYK;45
        DW USPO;46
        DW NUSP
;-------
        DW XLD512; 48
        DW XSV512; 49
        DW XGIPGPL;50
        DW XTNTRY2;51
        DW XCHTS;  52
        DW XTNTRYN;53
        DW XTMRKFL;54
        DW XTMRKNX;55
        DW XADIR;  56
        DW XSTREAM;57
        DW XXTETY2;58
        DW XFENTRY;59
        DW XLD256; 60
        DW XLDNON; 61

        DW XGFILE; 62
        DW XGDIR;  63
;-------
        DW MNGV_PL;64
        DW MNGCVPL;65
        DW GVmod;  66
        DW GYoff;  67
        DW GXoff;  68
        DW GVtm;   69
        DW GVtl;   70
        DW GVsgp;  71
;-------
        DW XMKfile;72
        DW XMKdir; 73
        DW XREname;74
        DW XDelFl; 75
.2      DW FEX
;-------
        DW MNG0_PL;78
        DW MNG8_PL;79
        DW MNG0VPL;80
        DW MNG8VPL;81
.2      DW FEX
;-------
        DW SCRLWOW;84
        DW INS;    85
        DW INT_PL; 86
;-------
NYAU    PUSH BC:CALL MYAU
        POP HL
NYAA    EQU $+1
        LD A,0:CALL P8000
        PUSH AF
        LD A,2:CALL MNG8
        CALL GIPAGPL
        POP AF
        RET

MYAU    LD A,(LOBU),(PPGP),A,HL,LOBU+35
        ADD A,(HL)
        ADD A,PLGPG
        JP MNG8
;-------
RAJT    LD A,1
AJT     PUSH AF:CALL MYAU
        POP AF
        CALL P8000
        PUSH AF:LD A,2:CALL MNG8
        POP AF
        RET
;-------
P8000   PUSH AF
        XOR A
        LD (DSA),A
        LD (DDA),A
        LD (DAS),A
        CALL MNGC
        POP AF

        LD BC,(PG0),(FEP),BC,(FEP2),BC
        PUSH BC:LD BC,(BRRR+2)
        PUSH BC:LD BC,(BRRR)
        PUSH BC

        LD BC,(RSQBC),(RSQB2),BC
        LD (IXBU),IX
        EXA
ENV     LD A,0
        EXA
        LD BC,BUX:CALL #8000
        LD IX,(IXBU)
        LD HL,(RSQB2),(RSQBC),HL

        POP HL:LD (BRRR),HL
        POP HL:LD (BRRR+2),HL
        POP HL
        PUSH AF
        LD A,L:CALL MNG0,DEF
        CALL INTPLD
        POP AF
        RET
;---------------------------------------
        INCL "PS2P"
        INCL "WCIF"
        INCL "WCVLS"
        INCL "WCFX"
        INCL "WCVW"
        INCL "WCINI"
;-------
FONT    INCB "FONT32L"
DEHR1M  INCB "DEHR1M"
DEHR1L  EQU $-DEHR1M
MLZ40   INCB "MLZ40"
MLZ4L   EQU $-MLZ40

DEHR1   EQU GIG_PAL-DEHR1L
MLZ4    EQU DEHR1-MLZ4L

;---------------------------------------
        ORG #C000
CORE    EQU #4000
;IDE_INI EQU CORE
DEV_INI EQU CORE+3
;REINI EQU CORE+6
HDD     EQU CORE+9

RDD     EQU CORE+12
SDD     EQU CORE+15

GIPAG   EQU CORE+18
LOAD512 EQU CORE+21
SAVE512 EQU CORE+24

DOS_SWP EQU CORE+27

GLSTCAT EQU CORE+30
TLSTCAT EQU CORE+33

SRHFCL  EQU CORE+36
;EQU CORE+39
MKSG    EQU CORE+42
;EQU CORE+45
RFRH    EQU CORE+48

GENTRY  EQU CORE+51
TENTRY  EQU CORE+54

MKFILE  EQU CORE+57
MKDIR   EQU CORE+60

DELFL   EQU CORE+63
RENAM   EQU CORE+66

DLSG    EQU CORE+69
CHTOSE  EQU CORE+72

;EQU CORE+75
SRHDRN  EQU CORE+78

LOAD256 EQU CORE+81
LOADNON EQU CORE+84

NXTETY  EQU CORE+87
NXTETY2 EQU CORE+90
;-------
        INCB "WDOSFC34"
