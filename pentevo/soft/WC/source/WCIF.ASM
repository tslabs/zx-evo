;---------------------------------------
PBY     EQU 1
PBUP    EQU #DC;DC
PBDN    EQU #F6;DF
PBDN2   EQU #DF;#F6;#F5;DB
;-------
PBINIT  ;i: IX - SOW
;           DE - Count

        LD (PBCNT),DE
        LD A,D:OR E:RET Z

        LD A,(IX+10)
        OR A:LD A,PBDN
        JR NZ,$+4:LD A,PBDN2
        LD (PBDNX),A
        LD A,(IX+5);Height
        SUB (IX+10);Line1
        SUB PBY+1+2-1

        LD (PBH),A;PB Height (full)
        LD B,0
        LD H,0,L,A
DPD     INC B:OR A:SBC HL,DE
        JR Z,PDP,NC,DPD
PDP     LD (PBHX),A;PB Height2
        LD A,B,(PBBH),A;BAR Height
        RET

PBPRINT ;i: IX - SOW
;           HL - globY

        LD E,(IX+12),D,0:DEC E
        ADD HL,DE;globY+Y

        LD B,0
PBHX    EQU $-1; PB Height2
        EX DE,HL
;POZ*100%:
        LD HL,0:ADD HL,DE:DJNZ $-1
;/count:
        LD DE,0;total objects (count)
PBCNT   EQU $-2
        LD A,D:OR E:RET Z
        XOR A
PBCNTG  INC A:SBC HL,DE:JR Z,PBCNTE
        JR NC,PBCNTG
        DEC A
PBCNTE  LD C,A

        LD B,0
PBH     EQU $-1; PB Height

        LD A,B:SUB C
        LD C,A

        LD D,PBY;Y
        LD E,(IX+4):DEC E;X=winW-1
        CALL GADRW

        LD (HL),PBUP:INC H
        LD DE,#B0DB
        LD A,C
PBHPR   CP B:CALL Z,PBBHGO:JR Z,PBBHE
        LD (HL),D:INC H
        DJNZ PBHPR
PBBHE   LD (HL),PBDN
PBDNX   EQU $-1
        RET

PBBHGO  LD A,0
PBBH    EQU $-1; BAR Height
PBBHG   LD (HL),E:INC H
        DEC B:RET Z
        DEC A:JR NZ,PBBHG
        LD A,B:OR A
        LD A,#FF
        RET
;---------------------------------------
WOWSHAD BIT 7,(IX+0):RET Z
        CALL GPOZA

        LD A,(WID),B,A
        LD A,(IX+4):CP 2:RET C
        ADD A,L:LD L,A
        CP B:RET NC

        SET 7,L
        LD A,(IX+5):CP 2:RET C
        LD B,A
SHADOW1 INC H
        LD A,(HL)
        AND %00000000
;OR %00000001
        LD (HL),A:DJNZ SHADOW1

        LD B,(IX+4):DEC B
SHADOW2 DEC L
        LD A,(HL)
        AND %00000000
;OR %00000001
        LD (HL),A:DJNZ SHADOW2
        RET
;---------------------------------------
WOWHEAD BIT 4,(IX+0):JR Z,WOWhead
        PUSH AF
.4      RLCA
        LD (AA0+1),A,(AA1+1),A
        LD DE,#2020,C,#20:CALL FLL
        POP AF
        LD (AA0+1),A,(AA1+1),A
        RET

WOWhead LD (AA0+1),A,(AA1+1),A
WOWST1  LD DE,#DABF,C,#C4:CALL FLL
        RET
;---------------------------------------
WOWTPS  EQU 3
WOWST   DB "@BBC9CDBABAB6C7BCC8CD"
        DB "@F9F8F7FFFEFBFAFDFC5F"
        DB "@BFDAC4B3B3B4C3D9C0C4"

PRWOW   ;i:IX - Structure Of Window
        LD B,WOWTPS
        LD A,(IX+0):AND %00001111
        LD HL,WOWST,DE,10
PRwow   JR Z,WOW
        DEC A:JR Z,WOW1
        DEC A:JR Z,WOW2
        ADD HL,DE
        DEC A:DJNZ PRwow
        RET

WOW2    CALL WOW
        LD A,(IX+17):OR A:JR Z,Hk1
        LD L,(IX+16)
        LD H,A
        LD DE,0:CALL TXTPR

Hk1     LD A,(IX+19):OR A:JR Z,Hk2
        LD L,(IX+18)
        LD H,A
        LD D,(IX+5):DEC D
        LD E,0:CALL TXTPR

Hk2     LD A,(IX+21):OR A:RET Z
        LD L,(IX+20),H,A
        LD DE,#0101:JP TXTPR
;-------
WOW1    CALL WOW
        LD A,(IX+13):OR A:JR Z,HK1
        LD L,(IX+12),H,A
        LD DE,0:CALL TXTPR

HK1     LD A,(IX+15):OR A:JR Z,HK2
        LD L,(IX+14),H,A
        LD D,(IX+5):DEC D
        LD E,0:CALL TXTPR

HK2     LD A,(IX+17):OR A:RET Z
        LD L,(IX+16),H,A
        LD DE,#0101:JP TXTPR
;-------
WOW     LD A,(HL):INC HL:LD (WOWST1+1),A
        LD A,(HL):INC HL:LD (WOWST1+2),A
        LD A,(HL):INC HL:LD (WOWST1+4),A
        LD A,(HL):INC HL:LD (WOWST2+1),A
        LD A,(HL):INC HL:LD (WOWST2+2),A
        LD A,(HL):INC HL:LD (WOWST3+1),A
        LD A,(HL):INC HL:LD (WOWST3+2),A
        LD A,(HL):INC HL:LD (OMS+1),A
        LD A,(HL):INC HL:LD (OMS+2),A
        LD A,(HL):INC HL:LD (OMS+4),A

        CALL GRESB

        LD A,(IX+4):DEC A:LD (FLL+1),A
        LD A,(IX+6)
        CALL WOWHEAD

        LD A,(IX+5):SUB 2:JR Z,OMS
WOWST2  LD DE,#B3B3,C,#20
HE1     CP (IX+10):JR Z,HET
        CP (IX+11):JR Z,HET
        CALL FLL
LET     DEC A:JR NZ,HE1

OMS     LD DE,#C0D9,C,#C4:CALL FLL
        JP WOWSHAD
;-------
HET     PUSH DE,BC
WOWST3  LD DE,#C3B4,C,#C4:CALL FLL
        POP BC,DE
        JR LET
;---------------------------------------
FLL     LD B,0
        PUSH HL
        LD (HL),D
        SET 7,L
AA0     LD (HL),0
        RES 7,L

WE      INC HL:LD (HL),C
        SET 7,L
AA1     LD (HL),0
        RES 7,L
        DJNZ WE

        LD (HL),E
        POP HL
        INC H
        RET
;-------
GRESB   LD A,(IX+4):OR A:JR NZ,GRB_
        LD A,(WID),(IX+4),A
GRB_    LD A,(IX+5):OR A:JR NZ,GRB
        LD A,(HEI),(IX+5),A

GRB     LD A,(IX+2):CP 255:JR NZ,NAC_
        LD A,(WID):SUB (IX+4):SRL A
        LD (IX+2),A
NAC_    LD A,(IX+3):CP 255:JR NZ,NAC
        LD A,(HEI):SUB (IX+5):SRL A
        LD (IX+3),A

NAC     CALL GPOZA
        LD A,(IX+8):OR (IX+9):RET NZ

        PUSH HL
        LD DE,(RSQBC)
        LD (IX+8),E
        LD (IX+9),D

        LD A,(IX+4)
        BIT 7,(IX+0):JR Z,$+3:INC A
        LD (He2a),A,(He2b),A

        LD A,(IX+5)
        BIT 7,(IX+0):JR Z,$+3:INC A

        EXA
        LD A,RESB:CALL MNg8
        LD A,L
        EXA
        LD B,0
HE2     EXA
He2a    EQU $+1:LD C,0:LDIR:LD L,A
        SET 7,L
He2b    EQU $+1:LD C,0:LDIR:LD L,A
        INC H
        EXA:DEC A:JR NZ,HE2
        LD (RSQBC),DE
        POP HL
        JP MNG8R
;-------
RRESB   CALL GPOZA
        EX DE,HL
        LD L,(IX+8)
        LD H,(IX+9)
        LD A,H:CP #BF:RET NC:OR L:RET Z

        PUSH HL
        LD A,(IX+4)
        BIT 7,(IX+0):JR Z,$+3:INC A
        LD (He3a),A,(He3b),A

        LD A,(IX+5)
        BIT 7,(IX+0):JR Z,$+3:INC A

        EXA
        LD A,RESB:CALL MNg8
        LD A,E
        EXA

        LD B,0
HE3     EXA
He3a    EQU $+1:LD C,0:LDIR:LD E,A
        SET 7,E
He3b    EQU $+1:LD C,0:LDIR:LD E,A
        INC D
        EXA:DEC A:JR NZ,HE3
        POP BC

        EX DE,HL
        LD HL,(RSQBC)
        OR A:SBC HL,DE:JR Z,XeT
;LD A,B,B,H,H,A
;LD A,C,C,L,L,A
;EX DE,HL
;LDIR
;LD BC,DE
        JR XET

XeT     LD (RSQBC),BC
XET     CALL MNG8R
        XOR A
        LD (IX+8),A
        LD (IX+9),A
        RET
;-------
GPOZA   XOR A:CALL MNGC
        LD HL,#C000
        LD A,(IX+2):ADD A,L:LD L,A
        LD A,(IX+3):ADD A,H:LD H,A
        RET
;---------------------------------------
SWDMA   LD A,H
        OR A:JR Z,WSDDN
        DEC A:JR Z,WSDUP
        RET

WSDUP   CALL DMAMTCH:JP C,NWSD

        LD HL,#0000
        LD A,(IX+2):ADD A,L,A,E:LD L,A
        LD A,(IX+3):ADD A,H,A,D:LD H,A

        LD DE,BC:DEC D,D,E

        XOR A
        LD BC,DMADL:OUT L
        LD B,DMADH[:OUT H
        LD B,DMADX[:OUT A
        LD B,DMASX[:OUT A:INC H

        LD B,DMASL[:OUT L
        LD B,DMASH[:OUT H

        LD B,DMA_N[:OUT E
        LD B,DMA_T[:OUT D

        LD B,DMA_C[,A,%00110001:OUT A
        INF:JP M,$-2
        RET
;-------
WSDDN   CALL DMAMTCH:JR C,NWSD

        LD HL,#0000
        LD A,(IX+2):ADD A,L,A,E:LD E,A
        LD A,(IX+3):ADD A,H,A,D,A,B
        LD D,A:DEC D
        LD HL,DE:DEC H

        LD A,B:DEC A
        EXA
        LD A,C
        LD BC,DMA_N:OUT A
        XOR A
        LD B,DMADX[:OUT A
        LD B,DMASX[:OUT A
        LD B,DMA_T[:OUT A

        EXA
ZUPZUP  EXA
        LD B,DMADL[:OUT E
        LD B,DMADH[:OUT D:DEC D
        LD B,DMASL[:OUT L
        LD B,DMASH[:OUT H:DEC H

        LD B,DMA_C[,A,%00000001:OUT A
        INF:JP M,$-2
        EXA:DEC A:JR NZ,ZUPZUP
        RET
;-------
SCRLWOW ;i: D - Y
;           E - X
;           B - H
;           C - W
;           A - [7]: %1 - with attr
;                    %0 - chars only
;               [6]: %1 - clear src side
;                    %0 - don't clear
;             [5-2]: %0000 - 1 char step
;                    %1111 - 16 chars
;             [1-0]: %00 - down
;                    %01 - up
;                    %10 - right
;                    %11 - left

        LD H,A:AND %11111100:JP Z,SWDMA
NWSD    LD A,H

        LD HL,ATTE+1,(HL),0
        BIT 7,A:JR Z,$+4:LD (HL),1

        LD HL,SWCL+1,(HL),0
        BIT 6,A:JR Z,$+4:LD (HL),1

        LD L,A
        AND %00111100
.2      RRA
        INC A:LD (WSST+1),A

        LD A,L
        AND %00000011
        OR A:JR Z,WSDN
        DEC A:JR Z,WSUP
        DEC A:JR Z,WSRG
WSLF    RET
WSRG    RET
WSUP    CALL GPOZA
        LD A,D:ADD A,H:LD H,A
        LD A,E:ADD A,L:LD L,A
        LD DE,HL

        LD A,(WSST+1):ADD A,H:LD H,A
        LD A,B
WSST    SUB 0:RET C

        LD B,A
WSup    PUSH BC
        PUSH HL,DE
        LD A,C:EXA
        LD B,0:LDIR
ATTE    LD A,0:OR A:JR Z,ATTD

        SET 7,L
        SET 7,E:DEC L,E
        EXA:LD C,A:LDDR

ATTD    POP DE,HL:INC H,D
        POP BC:DJNZ WSup

        DEC H
SWCL    LD A,0:OR A:RET Z
        XOR A
        LD B,C,(HL),A:INC L:DJNZ $-2

        LD A,(ATTE+1):OR A:RET Z
        SET 7,L
        LD A,(IX+6)
        LD B,C:DEC L:LD (HL),A:DJNZ $-2
        RET
;-------
WSDN    CALL GPOZA
        LD A,D:ADD A,H,A,B:LD H,A:DEC H
        LD A,E:ADD A,L:LD L,A
        LD DE,HL

        PUSH BC
        LD A,(WSST+1),C,A
        LD A,H:SUB C:LD H,A
        LD A,B:SUB C
        POP BC:RET C

        LD B,A
WSdn    PUSH BC
        PUSH HL,DE
        LD A,C:EXA
        LD B,0:LDIR
        LD A,(ATTE+1):OR A:JR Z,ATTd

        SET 7,L
        SET 7,E:DEC L,E
        EXA:LD C,A:LDDR

ATTd    POP DE,HL:DEC H,D
        POP BC:DJNZ WSdn

        INC H
        JR SWCL
;-------
DMAMTCH LD A,(IX+2):ADD A,E:RRA:RET C
        LD A,C:RRA
        RET
;---------------------------------------
CURSORF
.2      DEC B

        DEC L
        LD A,%00001111:AND A,(HL):LD C,A
        LD A,%11110000:AND (IX+14):OR C
        LD (HL),A
        INC L

        PUSH AF
        LD A,(IX+1)
        AND A,(HL):OR (IX+14)
        CP (HL):JR Z,CURB
        LD C,(HL),(IX+15),C
CURB    CALL CRS
        POP AF
        LD (HL),A
        RET

CURSOR  CALL SOR:JR NZ,CURSORF
.2      DEC B:RET Z
        LD A,(IX+1)
        AND A,(HL):OR (IX+14)

        CP (HL):JR Z,CRS
        LD C,(HL),(IX+15),C
CRS     LD (HL),A:INC L:DJNZ $-2
        RET

CURSER  CALL SOR:JR NZ,CURSERF
.2      DEC B:RET Z
        LD A,(IX+15)
        JR CRS

CURSERF DEC L:LD A,(IX+6),(HL),A:INC L
.2      DEC B
        PUSH AF:LD A,(IX+15):CALL CRS
        POP AF:LD (HL),A
        RET

SOR     CALL GPOZA
        LD B,(IX+4):SET 7,L:INC L
        LD A,(IX+12):ADD A,H:LD H,A

        BIT 6,(IX)
        RET
;---------------------------------------
PRSRW   ;i:IX - SOW
;          HL - TEXT
;          BC - Length
;           D - Y
;           E - X
;        o:HL - Address

        PUSH DE
        PUSH HL
        CALL GPOZA;INC H,L
        LD A,D:ADD A,H:LD H,A
        LD A,E:ADD A,L:LD L,A
        EX DE,HL
        POP HL
        LD A,C
        LDIR
        LD B,A
        EX DE,HL
        POP DE
        RET
;-------
PRIAT   ;i:HL - Address in SCREEN
;           A - Color
;           B - Lenght

        CALL VALIDAD:RET C

        SET 7,L
        DEC L:LD (HL),A:DEC L:DJNZ $-2
        RET
;-------
GADRW   ;i:IX - SOW
;           D - Y
;           E - X
;        o:HL - Address

        PUSH DE
        CALL GPOZA
        LD A,D:ADD A,H:LD H,A
        LD A,E:ADD A,L:LD L,A
        POP DE
        RET
;-------
VALIDAD PUSH AF
        LD A,B:CP 90+1:JR NC,XEP
        LD A,H:CP #C0:JR C,XEP
        BIT 7,L:JR NZ,XEP
        LD A,(PGC):CP MTXPG:JR NZ,XEP
        POP AF
        OR A
        RET
XEP     POP AF
        SCF
        RET
;---------------------------------------
;i: D - Y
;   E - X
;  HL - text addres
;   A - message number

MEZZ    OR A:JR Z,TXTPR
        PUSH DE
        LD E,A
        LD BC,8192
BXX     XOR A
BAX     CPIR
        LD A,(HL):INC HL
        OR A:JR NZ,BXX
        DEC E:JR NZ,BAX
        POP DE
;---------------------------------------
TXTPR   ;i:HL - Text
;           E - X
;           D - Y

;        o: E - old X
;           D - new Y

        XOR A:CALL MNGC
        LD (LXY),DE,A,(IX+6),(CLRN),A

BTOOOM  LD A,(HL)
        OR A:JR Z,LOOOL
        CP 11:JR Z,TTAB
        CP 12:JR Z,TTRA
        CP 13:JP Z,NxtLine
        CP 14:JR Z,CNTR
        CP #FE:CALL Z,CybLnk:JR Z,BTOOOM

        CP 10:CALL C,CCOD:JR C,BTOOOM
        CALL CHAR
        JP BTOOOM
LOOOL   LD DE,(LXY):INC D
        RET
TTAB    INC HL:LD A,E:ADD A,(HL):LD E,A
        INC HL:JR BTOOOM
TTRA    INC HL:LD A,D:ADD A,(HL):LD D,A
        INC HL:JR BTOOOM
CNTR    PUSH HL
        LD BC,#5000:CALL STSCN:JR NZ,CNt
        LD A,C:OR A:JR Z,CNt
        LD A,(IX+4):SUB C:JR C,CNt,Z,CNt
        SRL A:LD E,A
CNt     POP HL:INC HL:JR BTOOOM

STSCN   INC HL
        LD A,(HL)
        OR A:RET Z
        CP 13:RET Z
        CP 14:JR Z,BDCD
        CP #FE:JR NC,BDCD

        CP 16:JR C,$+3:INC C
        CP 11:JR NZ,$+3:INC HL
        CP 12:JR NZ,$+3:INC HL
        DJNZ STSCN
BDCD    LD A,#FE
        OR A
        RET
;-------
CHAR    PUSH HL
        LD A,(HL)
        EXA
        LD HL,#C000
        LD A,(IX+2):ADD A,L:LD L,A
        LD A,(IX+3):ADD A,H:LD H,A
        LD A,D:ADD A,H:LD H,A
        LD A,E:ADD A,L:LD L,A
        EXA:LD (HL),A
        SET 7,L
        LD A,(CLRN),(HL),A
        POP HL
        INC E,HL
        RET
;---------------------------------------
NxtLine LD DE,(LXY):INC D,HL:JP TXTPR
;-------
CybLnk  INC HL
        LD A,(HL):INC HL:EXA
        LD A,(HL):INC HL
        PUSH HL
        LD H,A:EXA
        LD L,A

        CALL STRING

        POP HL
        XOR A
        RET

STRING  LD A,(HL)
        OR A:RET Z
        CP 13:RET Z

        CP 10:CALL C,CCOD:JR C,STRING
        CALL CHAR
        JP STRING
;-------
CCOD    CP 9:JR NZ,XA
        LD A,(CLRN)
.4      RRCA
        LD (CLRN),A
        INC HL
        SCF
        RET
;-------
XA      EXA:INC HL:LD A,(HL):CP 9:JR C,X
        EXA

        AND 7:LD C,A
        LD A,(IX+6):AND %11110000:OR C
        LD (CLRN),A
        SCF
        RET
;-------
X       EXX
        LD C,A:EXA
        CP C:JR Z,BRO
        DEC A,C
.4      ADD A,A
        OR C
GGB     LD (CLRN),A:SCF
        EXX
        INC HL
        RET
BRO     OR %00001000
        LD C,A,A,(IX+6):AND %11110000
        OR C:JR GGB
;---------------------------------------
