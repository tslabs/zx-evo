        ORG #6000
        ORG #3800,$;      SD Card Driver
        INCL "PRTGS"
;-------
SEC_BUF EQU #5000
;-------
DMA_L   EQU #1AAF;X X X X X X X 0
DMA_H   EQU #1BAF;X X X X X X X X
DMA_X   EQU #1CAF;0 0 X X X X X X

DMA_C   EQU #26AF;R/W ZWT 0 0 0 0 V1 V0
DMA_N   EQU #27AF;0=2,1=4,...,255=512
;-------
P_CONF  EQU #77
P_DATA  EQU #57

CMD_12  EQU #4C
CMD_17  EQU #51
CMD_18  EQU #52
CMD_24  EQU #58
CMD_25  EQU #59
CMD_55  EQU #77
CMD_58  EQU #7A
CMD_59  EQU #7B
ACMD_41 EQU #69
;---------------------------------------
GAFF    JP IDE_INI
        JP SEL_DEV
        JP REINI

        JP XPOZI
        JP PROZ

        JP RDDSE
        JP SDDSE

.17     JP 0
;---------------------------------------
NSDC    NOP ;\ номер сектора в CLUS
EOC     NOP ;/ флаг конца цепочки

ABT     NOP

BZN     DB 4
NR0     DW 4;кол-во грузимых секторов

CAHL    DS 2
CADE    DS 2

LSTSE   DS 4

REZDE   DS 2

PR      DS 4

CLHL    DS 2
CLDE    DS 2

LLHL    DS 4

LTHL    DS 2;LAST
LTDE    DS 2
;------Шаблон элемента каталога:--------
ENTRY   DS 11
EFLG    DB 0,0
        DB #00;ms
        DW #7000:DW #3910;time,date
        DW #3910;acc date
CLSDE   DS 2
        DW #7000:DW #3910;time,date
CLSHL   DS 2
SIZIK   DS 4
        NOP
;---------------------------------------
BREZS   DS 2;+14          FAT PARAMETERS
FSINF   DS 4;[+48(2)]+[ADDTOP]

BFATS   NOP
BFTSZ   DS 4
BSECPC  DS 2;USE 1
BROOTC  DS 4

FSTFRC  DW 2,0

ADDTOP  DS 4

SFAT    DS 2
SDFAT   DS 4

CUHL    DS 2
CUDE    DS 2

NXDE    DS 2
NXHL    DS 2

LDHL    DS 2;аддрес с которого/в который
;            идет запись/чтение
COUNT   NOP
DUHL    DS 2
DUDE    DS 2

DUBA    NOP
UUHL    DS 2
BUHL    DS 2
GARY    DS 2;AAA
CLCNT   DS 2;счетчик
FCTS    DS 4
BUTS    DS 4

LSTCAT  DS 4;активный каталог
RECCAT  DS 4;каталог корзина

BLKNUM  DS 4
;---------------------------------------
SENDCOM OUT (#BB),A
GSWC    IN A,(#BB)
        RRCA:JR C,GSWC
        RET

SENDDAT OUT (#B3),A
GSWD    IN A,(#BB)
        RLCA:JR C,GSWD
        RET ;       DB #03,#20:DB 0:DS 2
;---------------------------------------
;ИНИЦИАЛИЗАЦИЯ SD КАРТЫ:
REINI   RET

IDE_INI LD A,#80:OUT (#33),A
        EI
.2      HALT
        LD A,#F3:OUT (GSCOM),A
        CALL DIK:JR Z,WSE

        XOR A:OUT (GSDAT),A
        LD A,#1D:OUT (GSCOM),A

        CALL DIK:JR Z,WSE

        IN A,(GSDAT)
        CP #8B:LD A,0:JR NZ,WSE

;LD A,#F3:CALL SENDCOM

        XOR A:OUT (#B3),A
        LD A,#14:CALL SENDCOM;LOAD memBL
        LD A,#03:CALL SENDDAT; len #0300

        XOR A:CALL SENDDAT;   to  ADDRES
        LD A,#40:CALL SENDDAT;#4000 inGS

        LD HL,TOGS,BC,#0300
WAV     LD A,(HL):CALL SENDDAT:INC HL
        DEC BC:LD A,B:OR C:JR NZ,WAV

        XOR A:OUT (#B3)
        LD A,#13:CALL SENDCOM;JPtoADDRES
        LD A,#40:CALL SENDDAT;#4000 inGS

        XOR A:OUT (#BB),A
        DEC A
WSE     INC A
        LD (FANK+1),A
        IN A,(#7B)
        RET

DIK     LD B,#30
D_K     HALT:HALT
        DEC B:LD A,B:RET Z
        IN A,(GSCOM):RRA:JR C,D_K
        XOR A:INC A
        RET
;---------------------------------------
XPOZI   LD (LTHL),HL,(LTDE),DE
PROZ    LD (BLKNUM),HL,(BLKNUM+2),DE
        RET
;---------------------------------------
SNDPAR  LD DE,(BLKNUM);BC(BLKNUM+2)

        OUT (#B3),A
        PUSH AF
        LD A,B:CALL SENDCOM

        LD A,E:CALL SENDDAT
        LD A,D:CALL SENDDAT
        LD A,(BLKNUM+2):CALL SENDDAT
        LD A,(BLKNUM+3):CALL SENDDAT
        XOR A:OUT (#BB),A,(#B3),A
        LD E,A
        POP AF

        LD D,A
        RET

RDDSE   LD B,#10:CALL SNDPAR
LAWL    IN A,(#BB):RLCA:JR NC,$-3
        LD B,128
SGI     IN A,(#BB):RLCA:JR NC,$-3
        IN A,(#B3):LD (HL),A:INC HL
        IN A,(#BB):RLCA:JR NC,$-3
        IN A,(#B3):LD (HL),A:INC HL
        IN A,(#BB):RLCA:JR NC,$-3
        IN A,(#B3):LD (HL),A:INC HL
        IN A,(#BB):RLCA:JR NC,$-3
        IN A,(#B3):LD (HL),A:INC HL
        DJNZ SGI
        DEC D:JR NZ,LAWL

        XOR A
        JP SENDCOM

SDDSE   LD B,#12:CALL SNDPAR
LOL     IN A,(#BB):RLCA:JR C,$-3
        LD A,(HL):OUT (#B3),A:INC HL
        IN A,(#BB):RLCA:JR C,$-3
        LD A,(HL):OUT (#B3),A:INC HL
        DEC DE:LD A,E:OR D:JR NZ,LOL
        JP SENDCOM
;---------------------------------------

;идентификация CD и HDD
SEL_DEV OR A:RET NZ
FANK    LD A,0:OR A:RET NZ

        LD A,#20:CALL SENDCOM:IN A,(#B3)
        OR A:RET NZ
        XOR A
        RET
UDAFF
;---------------------------------------
;---------------------------------------
TOGS    ORG #4000,#6000+UDAFF-GAFF
WAIT    DI
        LD SP,#6000
        LD A,#9C:OUT (SCTRL),A
        LD A,3:OUT (#0F),A

CMD_STR IN A,(#05)
CMD_CHK IN A,(#04):RRCA:JR NC,$-3
        IN A,(#01)
        OR A:JR Z,CMD_STR
        CP #10:JR Z,RD_SEC
        CP #12:JP Z,SV_SEC
        CP #20:JR Z,SDINI
        CP #F3:JP Z,0
        CP #F4:JP Z,0
        JR CMD_CHK
;---------------------------------------
SDINI   CALL SD_INIT
        OUT (#03),A
        JR CMD_STR
;-------
RD_SEC  CALL RD_PAR
;DE=(BLKNUM),BC=(BLKNUM+2),L-COUNT
        IN A,(#02)
        LD A,L

RDGS    PUSH AF
        LD HL,SEC_BUF
        PUSH DE,BC
        CALL RDSINGL
        POP BC,DE
        INC DE
        LD A,D:OR E:JR NZ,$+3:INC BC

        LD HL,SEC_BUF
ORIGA   IN A,(#04):RLCA:JR C,$-3
        LD A,(HL):OUT (#03),A:INC L
        IN A,(#04):RLCA:JR C,$-3
        LD A,(HL):OUT (#03),A:INC L
        IN A,(#04):RLCA:JR C,$-3
        LD A,(HL):OUT (#03),A:INC L
        IN A,(#04):RLCA:JR C,$-3
        LD A,(HL):OUT (#03),A:INC L
        IN A,(#04):RLCA:JR C,$-3
        LD A,(HL):OUT (#03),A:INC L
        IN A,(#04):RLCA:JR C,$-3
        LD A,(HL):OUT (#03),A:INC L
        IN A,(#04):RLCA:JR C,$-3
        LD A,(HL):OUT (#03),A:INC L
        IN A,(#04):RLCA:JR C,$-3
        LD A,(HL):OUT (#03),A:INC HL
        LD A,H:CP #52:JR C,ORIGA

        POP AF
        DEC A:JR NZ,RDGS
        JP CMD_STR
;-------
SV_SEC  CALL RD_PAR
        IN A,(#02)
        LD A,L

SVGS    PUSH AF
        LD HL,SEC_BUF
ORIGA2  IN A,(#04):RLCA:JR NC,$-3
        IN A,(#02):LD (HL),A:INC L
        IN A,(#04):RLCA:JR NC,$-3
        IN A,(#02):LD (HL),A:INC HL
        LD A,H:CP #52:JR C,ORIGA2

        LD HL,SEC_BUF
        PUSH DE,BC
        CALL SVSINGL
        POP BC,DE
        INC DE
        LD A,D:OR E:JR NZ,$+3:INC BC

        POP AF
        DEC A:JR NZ,SVGS
        JP CMD_STR
;------------------
RD_PAR  IN A,(#05);       command ACCEPT
        IN A,(#02):LD L,A:CALL WTD
        IN A,(#02):LD E,A:CALL WTD
        IN A,(#02):LD D,A:CALL WTD
        IN A,(#02):LD C,A:CALL WTD
        IN A,(#02):LD B,A
WTD     IN A,(#04)
        RLCA:RET C
        JR WTD
;=======================================
ZAW003  CALL SD__OFF
        INC A
        RET

SD_INIT CALL SD__OFF
        LD BC,SD_SEND,DE,#20FF:OUT E
        DEC D:JR NZ,$-3
        LD BC,SD_RSTR
;XOR A;A=0
        EXA
ZAW001  LD HL,CMD00
        CALL OUTCOM,IN_OOUT
        EXA:DEC A:JR Z,ZAW003
        EXA:DEC A:JR NZ,ZAW001
        LD HL,CMD08
        CALL OUTCOM,IN_OOUT
.3      IN H:NOP
        IN H
        LD HL,0
        BIT 2,A:JR NZ,ZAW006
        LD H,#40
ZAW006  LD A,CMD_55
        CALL OUT_COM,IN_OOUT
        LD BC,SD_SEND
        LD A,ACMD_41
        OUT A:NOP
        OUT H:NOP
        OUT L:NOP
        OUT L:NOP
        OUT L
        LD A,#FF:OUT A:CALL IN_OOUT
        AND A:JR NZ,ZAW006
;ZAW004  LD A,CMD_59
;        CALL OUT_COM,IN_OOUT
;        AND A:JR NZ,ZAW004
ZAW005  LD HL,CMD16
        CALL OUTCOM,IN_OOUT
        AND A:JR NZ,ZAW005

SD__OFF LD A,M_SDNCS+M_SNCLR;#81
        OUT (SCTRL),A
        XOR A
        RET

CS__LOW PUSH DE
        LD E,M_SDNCS;1
        LD BC,SCTRL:OUT E
        POP DE
        RET

OUTCOM  PUSH BC
        CALL CS__LOW
        LD BC,SD_SEND
.5      OUTI:NOP
        OUTI
        POP BC
        RET

OUT_COM PUSH BC
        CALL CS__LOW
        LD BC,SD_SEND
        OUT A:XOR A
.3      OUT A:NOP
        OUT A:DEC A
        OUT A
        POP BC
        RET

SECM200 PUSH HL,DE,BC,AF,BC
        LD A,CMD_58,BC,SD_RSTR
        CALL OUT_COM,IN_OOUT
        IN A:NOP
        IN H:NOP
        IN H:NOP:IN H
        BIT 6,A:POP HL:JR NZ,SECN200
        EX DE,HL:ADD HL,HL
        EX DE,HL:ADC HL,HL
        LD H,L,L,D,D,E,E,0
SECN200 POP AF
        LD BC,SD_SEND
        OUT A:NOP
        OUT H:NOP
        OUT L:NOP
        OUT D:NOP
        OUT E
        LD A,#FF:OUT A
        POP BC,DE,HL
        RET

IN_OOUT PUSH BC,DE
        LD DE,#20FF,BC,SD_RSTR
IN_WAIT IN A
        CP E:JR NZ,IN_EXIT
        DEC D:JR NZ,IN_WAIT
IN_EXIT POP DE,BC
        RET

RDSINGL LD A,CMD_17:CALL SECM200
        CALL IN_OOUT:CP #FE:JR NZ,$-5
        CALL READS
        CALL IN_OOUT:INC A:JR NZ,$-4
J_SI    JP SD__OFF

SVSINGL LD A,CMD_24:CALL SECM200
        CALL IN_OOUT:INC A:JR NZ,$-4
        LD A,#FE:CALL SAVDS
        CALL IN_OOUT:INC A:JR NZ,$-4
        JR J_SI
;-------
CMD00   DB #40,#00,#00,#00,#00,#95
;                          GO_IDLE_STATE
CMD08   DB #48,#00,#00,#01,#AA,#87
;                           SEND_IF_COND
CMD16   DB #50,#00,#00,#02,#00,#FF
;                            SET_BLOCKEN
;=======================================
;HL,in da kudy A,secs
READS   PUSH BC,DE
        LD BC,SD_RSTR
        INIR:NOP
        INIR

        IN A:NOP
        IN A
        POP DE,BC
        RET
;-------
;запись очередных 512б данных на HDD
SAVDS   PUSH BC,DE
        LD BC,SD_SEND

        OUT A:NOP
        OTIR:NOP
        OTIR

        LD A,#FF
        OUT A:NOP
        OUT A
        POP DE,BC
        RET
;---------------------------------------
