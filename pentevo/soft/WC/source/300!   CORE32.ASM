        ORG #C000;    WildDOSFileCore#23
;-------
        LD HL,CORE32,DE,#4000
        LD BC,END-START
        LDIR
        RET

;***************************************
CORE32  ORG #4000,$
;-------
GENBU   EQU #0000
GENBE   EQU #2000

DRVR    EQU #3800
DRV_LN  EQU #0500
VALS    EQU DRVR+24*3

SECBU   EQU #3000
SECBE   EQU SECBU+512
LOBU    EQU #3200
LOBE    EQU LOBU+512
;-------
IDE_INI EQU DRVR
SEL_DEV EQU DRVR+3
REINI   EQU DRVR+3*2

XPOZI   EQU DRVR+3*3
PROZ    EQU XPOZI+3

RDDSE   EQU PROZ+3
SDDSE   EQU RDDSE+3

RDD256  EQU SDDSE+3
;---------------------------------------
NSDC    EQU VALS;  \ Sec num in Cluster
EOC     EQU NSDC+1;/ Flag (EndOfChain)

ABT     EQU EOC+1

BZN     EQU ABT+1;NOT USED
NR0     EQU BZN+1

CAHL    EQU NR0+2
CADE    EQU CAHL+2

LSTSE   EQU CADE+2

REZDE   EQU LSTSE+4

PR      EQU REZDE+2

CLHL    EQU PR+4
CLDE    EQU CLHL+2

LLHL    EQU CLDE+2

LTHL    EQU LLHL+4;LAST
LTDE    EQU LTHL+2
;------------Entry Pattern:-------------
ENTRY   EQU LTDE+2;DS 11
EFLG    EQU ENTRY+11
CLSDE   EQU ENTRY+20
CLSHL   EQU ENTRY+26
SIZIK   EQU ENTRY+28
;---------------------------------------
;------------FAT PARAMETERS:------------
BREZS   EQU ENTRY+33;           [+14(2)]
FSINF   EQU BREZS+2;   [+48(2)]+[ADDTOP]

BFATS   EQU FSINF+4
BFTSZ   EQU BFATS+1
BSECPC  EQU BFTSZ+4
BROOTC  EQU BSECPC+2

FSTFRC  EQU BROOTC+4

ADDTOP  EQU FSTFRC+4

SFAT    EQU ADDTOP+4
SDFAT   EQU SFAT+2

CUHL    EQU SDFAT+4
CUDE    EQU CUHL+2

NXDE    EQU CUDE+2
NXHL    EQU NXDE+2

LDHL    EQU NXHL+2;ADDRESS COPY

COUNT   EQU LDHL+2
DUHL    EQU COUNT+1
DUDE    EQU DUHL+2

DUBA    EQU DUDE+2
UUHL    EQU DUBA+1
BUHL    EQU UUHL+2
CLCNT   EQU BUHL+2; COUNTER USED in MKSG

FCTS    EQU CLCNT+4; FirstClusTS
BUTS    EQU FCTS+4;  BUferTS

LSTCAT  EQU BUTS+4;  Active DIR
RECCAT  EQU LSTCAT+4;RECYCLED BIN DIR

;***************************************
START   JP IDE_INI;             inDriver
        JP SEL_DEV;             inDriver
        JP REINI;               inDriver
        JP HDD

        JP RDD
        JP SDD

        JP GIPAG
        JP LOAD512
        JP SAVE512

        JP DOS_SWP

        JP GLSTCAT
        JP TLSTCAT

        JP SRHFCL
        JP Z0
        JP MKSG
        JP SVHDFL
        JP RFRH

        JP GENTRY
        JP TENTRY

        JP MKDIR

        JP STAMP
        JP ENCEN

        JP DLSG
        JP CHTOSE

        JP SRHDR
        JP SRHDRN

        JP LOAD256
        JP LOADNON
;---------------------------------------
GENTRYX ;i:HL - Text String
;        o:ENTRY(11)

        LD DE,ENTRY
        LD B,8:CALL RYX,Z,NOPIDE
_LD A,(HL):CP ".":JR NZ,$+3:INC HL
        LD B,3:CALL RYX,Z,NOPIDE
        RET

RYX     LD A,(HL):OR A:RET Z
        CP ".":INC HL:RET Z
        LD (DE),A:INC DE:DJNZ RYX
        LD A,1:OR A
        RET

;---------------------------------------
GENTRY  ;i:HL(32) -> ENTRY
        LD DE,ENTRY,BC,32:LDIR
        RET

TENTRY  ;i:DE(32) <- ENTRY
        LD HL,ENTRY,BC,32:LDIR
Z0      RET

;---------------------------------------
;GIVE/TAKE Active DIR:
GLSTCAT ;i:HL(4) - CLUS num
        LD DE,LSTCAT,BC,4:LDIR
        RET

TLSTCAT ;i:DE(4) - Addres of value
        LD HL,LSTCAT,BC,4:LDIR
        RET

;---------------------------------------
;READ SECTORS WITH POSITIONING:
RDD     ;i:[DE,HL] - SEC number
;               BC - Address
;                A - number
        PUSH BC
        CALL XPOZI
        POP HL
        JP RDDSE

;---------------------------------------
;SAVE SECTORS WITH POSITIONING:
SDD     ;i:[DE,HL] - SEC number
;               BC - Address
;                A - number
        PUSH BC
        CALL XPOZI
        POP HL
        JP SDDSE

;---------------------------------------
;SKIP DATA from FAT32:
LOADNON LD DE,Z0,(NW0+1),DE
        CALL LOAD512
        LD DE,RDDSE,(NW0+1),DE
        RET

;---------------------------------------
;READ DATA from FAT32(256+256):
LOAD256 LD DE,RDD256,(NW0+1),DE
        CALL LOAD512
        LD DE,RDDSE,(NW0+1),DE
        RET

;---------------------------------------
;SAVE DATA to FAT32 (STREAM):
SAVE512 LD DE,SDDSE,(NW0+1),DE
        CALL LOAD512
        LD DE,RDDSE,(NW0+1),DE
        RET

;---------------------------------------
;READ DATA from FAT32 (STREAM):
LOAD512 ;i:HL - Address
;           B - lenght (512b blocks)
;     CUHL(4) - CLUSnum (if EOC+NSDC=0!)
;        o:HL - New value
;           A - EndOfChain

        XOR A:LD (ABT),A
        CALL LPREX:JR NZ,RH
KUKRY   PUSH BC
        LD HL,(LDHL)
        LD A,1:CALL NEWCLA
        POP BC
        DJNZ KUKRY
RH      LD HL,(LDHL)
        LD A,(EOC)
        RET

;Positioning to Cluster, if needed:
LPREX   LD (LDHL),HL
        LD A,(EOC):OR A:RET NZ
        LD A,(NSDC):OR A:JR NZ,RX
        PUSH BC
        LD HL,CUHL
        CALL GIPAG
        POP BC
        RET
RX      XOR A
        RET
;-------
NEWCLA  LD (NR0),A
        PUSH HL
        LD HL,(LTHL),DE,(LTDE):CALL PROZ
        POP HL
        LD A,(NR0)
NW0     CALL RDDSE;       READ Sector(s)
        LD (LDHL),HL;   updating Address

        LD HL,LTHL,DE,LLHL,BC,4:LDIR

        LD HL,(LTHL),DE,(LTDE)
_LD BC,(NR0):ADD HL,BC:JR NC,$+3:INC DE
        LD (LTHL),HL,(LTDE),DE

        LD HL,NSDC,A,C:ADD A,(HL)
        LD (HL),A

        LD BC,(BSECPC)
        CP C:RET C;      End OF Cluster?
;                        YES!

        LD HL,(CUHL),DE,(CUDE)
        CALL CURIT,GIPAG:RET Z

EOFC    POP BC,BC
        JP RH

;------Searching for free Cluster:------
SRHFCL  LD HL,FSTFRC,DE,CAHL,BC,4:LDIR
SRHFC   ;i:[CADE,CAHL]-Cluster number
;        o:[DE,HL]- Cluster number
;          EXX HL - position in BUFFER+4

        LD HL,(CAHL),DE,(CADE)
        CALL CURIT:RET C

FC      LD A,(HL):INC HL
        OR (HL):INC HL
        OR (HL):INC HL
        OR (HL):INC HL:JR Z,GETZE

        EX DE,HL
        LD HL,CAHL
        INC (HL):JP NZ,AGA:INC HL
        INC (HL):JR NZ,AGA:INC HL
        INC (HL):JR NZ,AGA:INC HL
        INC (HL)
AGA     EX DE,HL
        LD A,H:CP SECBE[:JP C,FC

        LD HL,(LTHL),DE,(LTDE):INC HL
        LD A,H:OR L:JR NZ,$+3:INC DE
        CALL XPOZI

        LD HL,SECBU,A,1:CALL RDDSE
        LD HL,SECBU
        JP FC
;-------
GETZE   EXX
        LD HL,(CAHL),DE,(CADE)
        PUSH HL:LD HL,CAHL:CALL INC4b
        POP HL
        XOR A
        RET

;------Read Sector from FAT:------------
CURIT   ;i:[DE,HL]-Cluster number
;        o:SECBU(512)
;          HL-poz in SECBU where Cluster

        CALL DEL128
.2      SLA C:RL B

        PUSH BC
        LD (LSTSE+2),DE,(LSTSE),HL

        LD BC,(BFTSZ+2)
        LD A,D:CP B:JR C,JK
        LD A,E:CP C:JR C,JK
        LD BC,(BFTSZ)
        LD A,H:CP B:JR C,JK
        LD A,L:CP C:JR NC,FATEND

JK      LD BC,(SFAT)
        CALL ADD4B
        CALL XSPOZ
        CALL XPOZI
        LD HL,SECBU,A,1:CALL RDDSE
        POP BC
        LD HL,SECBU:ADD HL,BC
        XOR A
        RET
;-------
FATEND  POP BC
        SCF
        RET

;----Pos. to First Sector of Cluster:---
GIPAG   ;i:HL(4) - Cluster number
        CALL TOS

        LD E,(HL):INC HL
        LD D,(HL):INC HL
        LD A,(HL):INC HL
        LD H,(HL),L,A:OR H,E,D:JR Z,RDIR

        LD A,H:AND #0F:CP #0F:JR Z,MDC
        EX DE,HL
POM     LD (CUHL),HL,(CUDE),DE

_LD BC,2:OR A:SBC HL,BC:JR NC,$+3:DEC DE

        LD A,(BSECPC):CALL UMNOX2
        LD BC,(SDFAT):CALL ADD4B
        EX DE,HL
        LD BC,(SDFAT+2):ADD HL,BC
        EX DE,HL
        CALL XSPOZ
        CALL XPOZI
        XOR A
        RET

RDIR    LD HL,(BROOTC),DE,(BROOTC+2)
        JR POM

MDC     LD (EOC),A
        OR A
        RET

;---Getting Absolute Position of SEC:---
XSPOZ   LD BC,(ADDTOP),(CLHL),BC
        LD BC,(ADDTOP+2),(CLDE),BC
        JP ADD4BF

;-----ADD NEW ENTRY TO ACTIVE DIR:------
SVHDFL  ;i:ENTRY-name,flag,size
;          LSTCAT(4)-Active DIR
;          FCTS(4)-Cluster numbr of DATA
;        o:[DE,HL]=FCTS(4)

        LD HL,ENTRY:CALL ENCEN
;-------
        LD HL,(LSTCAT),DE,(LSTCAT+2)
SHDFL   LD (CUHL),HL,(CUDE),DE
        CALL TOS
NXDCL   LD HL,LOBU
        LD B,1:CALL LOAD512
        LD HL,LOBU,DE,32,B,16
        XOR A
FIEL    CP (HL):JP Z,FELD
        ADD HL,DE
        DJNZ FIEL
        LD A,(EOC):CP #0F:JR NZ,NXDCL
        CALL SRHFCL:JR C,IEL
        LD (BUTS),HL,(BUTS+2),DE
        EXX
        LD A,#FF
        DEC HL:LD (HL),#0F
        DEC HL:LD (HL),A
        DEC HL:LD (HL),A
        DEC HL:LD (HL),A
        LD HL,SECBU
        LD A,1:CALL SDDSE

        LD HL,(CUHL),DE,(CUDE)
        CALL CURIT:JR C,IEL
        EX DE,HL
        LD HL,BUTS,BC,4:LDIR
        LD HL,SECBU
        LD A,1:CALL SDDSE

        LD HL,BUTS
        CALL GIPAG:RET NZ

        LD HL,SECBU,B,0
.2      CALL NOPING

        LD HL,(LTHL),DE,(LTDE)
        PUSH HL,DE
        LD HL,SECBU
        LD A,1:CALL SDDSE

        LD A,(BSECPC)
        LD HL,SECBU:CALL NOPCLA
        POP DE,HL
        CALL XPOZI
        JP NXDCL
;-------
IEL     LD A,1:OR A:RET
;-------
FELD    EX DE,HL
        LD HL,(FCTS),(CLSHL),HL
        LD HL,(FCTS+2),(CLSDE),HL

        LD HL,ENTRY,BC,33:LDIR
        LD A,D,(DUBA),A

        LD HL,(LLHL),DE,(LLHL+2)
        CALL PROZ
        LD HL,LOBU
        LD A,1:CALL SDDSE

        LD HL,(FCTS),DE,(FCTS+2)
        XOR A
        RET

;------------Name Filter:---------------
ENCEN   ;i:HL - ENTRY(11) Address

        PUSH HL
        LD B,11
REGUP   LD A,(HL)
        CP #21:JR Z,MUR
        CP #2D:JR Z,MUR
        CP #2A:JR NC,TER
        CP #23:JR NC,MUR

TER     CP #30:JR C,MU
        CP #3A:JR C,NU
        CP #40:JR NC,NU
MU      LD (HL),#5F
        JR MUR
NU      CP #5B:JR Z,MU
        CP #5C:JR Z,MU
        CP #5D:JR Z,MU
        CP #61:JR C,MUR
        CP #7B:JR C,MuR
        CP #7C:JR Z,MU
        CP #F2:JR NC,MU
        JR MUR
MuR     SUB #20:LD (HL),A
MUR     INC HL
        DJNZ REGUP
        POP HL

        PUSH HL
_LD BC,7:ADD HL,BC:LD B,7:CALL RU
        POP HL
_LD BC,10:ADD HL,BC:LD B,3:CALL RU
        RET

RU      LD A,(HL):CP #5F:RET NZ
        LD (HL),#20:DEC HL
        DJNZ RU
        RET

;-----Generate Chain in FAT:------------
ERG2    LD HL,FCTS:CALL DLSG
        LD HL,FCTS,DE,FSTFRC,BC,4:LDIR
ERG1    LD A,1:OR A
        RET
;-------
MKSG    ;i:[DE,HL] - Number of Bytes
;       FSTFRC - First free Cluster
;o:FCTS(4)-First Cluster in New Chain
;FSTFRC(4)-New value

        CALL DEL512
        LD A,(BSECPC):CALL DELITX2

        LD (CLCNT+2),DE
        LD (CLCNT+0),HL

        CALL SGENBU:JR C,ERG1
ROSTIK  CALL PREPFC:JR C,ERG2
        CALL BUtoFAT:RET Z
        CALL SGENB2:JR C,ERG2
        JR ROSTIK
;---------------------------------------
SGENBU  LD HL,GENBU,(GARY),HL

        CALL SRHFCL:RET C
        LD (FCTS),HL,(FCTS+2),DE
GENB    LD (FSTFRC),HL,(FSTFRC+2),DE

        LD A,H,C,L
        LD HL,(GARY)
        LD (HL),C:INC HL
        LD (HL),A:INC HL
        LD (HL),E:INC HL
        LD (HL),D:INC HL
        LD (GARY),HL
        XOR A
        RET
;-------
SGENB2  CALL SRHFC:RET C
        JR GENB
;-------
PREPFC  LD HL,(CLCNT):DEC HL
        LD (CLCNT),HL
        LD A,H:OR L:JR Z,EOFG

AMM     EXX
        LD A,H:CP SECBE[
        JR C,ARM
        CALL SRHFC:RET C
        JR AR2
ARM     CALL FC
AR2     LD (FSTFRC),HL,(FSTFRC+2),DE
;-------
        LD A,H,C,L
        LD HL,(GARY)
        LD (HL),C:INC HL
        LD (HL),A:INC HL
        LD (HL),E:INC HL
        LD (HL),D:INC HL
        LD A,H:CP GENBE[:RET NC
        LD (GARY),HL
        JP PREPFC
;-------
EOFG    LD HL,(CLCNT+2)
        LD A,H:OR L:JR NZ,AmM

        LD DE,#0FFF
        LD HL,(GARY)
        LD (HL),E:INC HL
        LD (HL),E:INC HL
        LD (HL),E:INC HL
        LD (HL),D:INC HL
        LD (GARY),HL
        RET
;-------
AmM     DEC HL:LD (CLCNT+2),HL:JP AMM
;---------------------------------------
BUtoFAT LD HL,GENBU
GENFC   LD C,(HL):INC HL
        LD B,(HL):INC HL
        LD E,(HL):INC HL
        LD D,(HL):INC HL
;-------
        PUSH HL
        LD HL,BC:CALL CURIT:EX DE,HL
        POP HL

GNFC    LD (UUHL),HL
        LD BC,4:LDIR

_DEC HL:LD A,(HL):CP #0F:JR Z,LSTSR
_INC HL:LD A,H:CP GENBE[:JR NC,LSTsr

        LD HL,(UUHL)
        LD C,(HL):INC HL
        LD B,(HL):INC HL
        LD E,(HL):INC HL
        LD D,(HL):INC HL
        LD (BUHL),HL

        LD HL,BC:CALL DEL128
        LD BC,(LSTSE)
        OR A:SBC HL,BC:JR NZ,GGC
        EX DE,HL:LD BC,(LSTSE+2)
        OR A:SBC HL,BC:JR Z,GFC

GGC     LD HL,SECBU,A,1:CALL SDDSE
        LD HL,(UUHL)
        JP GENFC

GFC     LD H,0,L,A
.2      SLA L:RL H
        LD BC,SECBU:ADD HL,BC
        EX DE,HL
        LD HL,(BUHL)
        JR GNFC
;-------
LSTSR   LD HL,SECBU:LD A,1:CALL SDDSE
;CALL RFRH
        XOR A
        RET
;-------
LSTsr   CALL LSTSR
        LD HL,(UUHL),DE,GENBU,BC,4:LDIR
        LD (GARY),DE

        LD A,1:OR A
        RET

;-----Delete Chain from FAT:------------
DLSG    ;i:HL(4) - Cluster number

        LD DE,LOBU,BC,4:LDIR
        LD HL,0
        LD (FSTFRC),HL
        LD (FSTFRC+2),HL
LWT     LD HL,(LOBU),DE,(LOBU+2)
        LD A,D:CP #0F:RET Z
        OR E,H,L:RET Z

        CALL CURIT:RET C
GOCE    LD DE,LOBU,C,0
.3      LD A,(HL),(HL),C,(DE),A:INC L,E
        LD A,(HL),(HL),C,(DE),A

        LD HL,(LOBU),DE,(LOBU+2)
        LD A,D:CP #0F:JR Z,Ne
        CALL DEL128
        LD BC,(LSTSE)
        OR A:SBC HL,BC:JR NZ,NE:EX DE,HL
        LD BC,(LSTSE+2)
        OR A:SBC HL,BC:JR NZ,NE

        LD H,0,L,A
.2      SLA L:RL H
        LD BC,SECBU:ADD HL,BC
        JP GOCE

NE      LD HL,SECBU,A,1:CALL SDDSE
        JP LWT
Ne      LD HL,SECBU,A,1:JP SDDSE

;-----Searching ENTRY in Active DIR:----
;BY NAME:
SRHDRN  ;i:LSTCAT(4) - Active DIR
;          HL - Buffer with Name
;               [flag(1)+name(1-12)+#00]
;        o: Z: NOT FOUNT
;          NZ: ENTRY(32)
;              [DE,HL] - Cluster Number

        LD A,(HL):INC HL
        LD (ENTRY+11),A:CALL GENTRYX

        LD HL,LSTCAT,DE,CUHL,BC,4:LDIR
        CALL TOS

HDR     LD A,(EOC):CP #0F:RET Z
        LD HL,LOBU,B,1:CALL LOAD512
        LD (HL),0

        LD HL,LOBU-32:CALL VEGA:RET NZ
        LD A,H:CP LOBU[+2
        JR HDR
;-------
VEGA    LD BC,32:ADD HL,BC
        LD A,(HL):OR A:RET Z
        CALL CHEB:JR NZ,VEGA
        LD A,1:OR A
        RET
;-------
CHEB    PUSH HL
        LD DE,ENTRY,B,11:CALL CHEE,Z,CHF
        POP HL:RET NZ

        LD DE,ENTRY,BC,32:LDIR
        LD HL,(CLSHL)
        LD DE,(CLSDE)
        XOR A
        RET
;-------
CHF     LD A,(DE),C,A
        LD A,(HL):AND #10:CP C
        RET

;BY CLUSTER NUMBER + NAME:
SRHDR   ;i:HL(4) - Cluster number
;          LSTCAT(4) - Active DIR
;          ENTRY - First 8 chars of Name
;        o:DE - Address in LOBU(512)

        LD DE,PR,BC,4:LDIR
        LD HL,LSTCAT,DE,CUHL,BC,4:LDIR
        CALL TOS
NEL     LD HL,LOBU
        LD B,1:CALL LOAD512
        LD HL,LOBU
NEV     LD A,(HL):OR A:RET Z
        LD DE,26:ADD HL,DE
        LD E,(HL):INC HL
        LD D,(HL)
        EX DE,HL
        LD BC,(PR)
        OR A:SBC HL,BC:JR Z,NSV
        LD HL,5
NFGA    ADD HL,DE
        LD A,H:CP LOBE[:JR NC,NEL
        JR NEV
NFga    LD DE,32
        POP HL
        JR NFGA
NSV     LD HL,0-7:ADD HL,DE
        LD E,(HL):INC HL
        LD D,(HL)
        EX DE,HL
        LD BC,(PR+2)
        OR A:SBC HL,BC
        LD HL,11:JR NZ,NFGA
        LD HL,0-21:ADD HL,DE
        PUSH HL
        LD DE,ENTRY,B,8
        CALL CHEE:JR NZ,NFga
        POP DE
        LD A,1:OR A
        RET

CHEE    LD A,(DE):CP (HL):RET NZ
        INC HL,DE
        DJNZ CHEE
        RET

;---------------------------------------
;SAVE Sector with ENTRY, if modified:

STAMP   LD HL,(LLHL),DE,(LLHL+2)
        CALL PROZ

        LD HL,LOBU,A,1:JP SDDSE

;---------------------------------------
;MAKE NEW DIRECTORY:
MKDIR   ;i:ENTRY(11) - DIR NAME
        LD HL,0,(SIZIK),HL,(SIZIK+2),HL
        LD A,#10,(EFLG),A
        LD DE,0,HL,512
        CALL MKSG:RET NZ
        CALL SVHDFL:RET NZ
        LD HL,FCTS
        CALL GIPAG

        LD HL,ENTRY
        LD (HL),".":INC HL
        LD (HL),#20:INC HL
        LD A,32,B,9:CALL NOPING+1
        LD HL,(CUHL),(CLSHL),HL
        LD HL,(CUDE),(CLSDE),HL
        LD HL,ENTRY,DE,LOBU,BC,32:LDIR

        LD HL,ENTRY+1
        LD (HL),"."
        LD HL,(LSTCAT),(CLSHL),HL
        LD HL,(LSTCAT+2),(CLSDE),HL
        LD HL,ENTRY,BC,32:LDIR

        LD HL,DE:INC DE
        LD BC,512;-64-1
        LD (HL),0
        LDIR
        LD HL,LOBU
        LD A,1:CALL SDDSE

        LD A,(BSECPC)
        LD HL,LOBU+64
        CALL NOPCLA
        XOR A
        RET

RFRH    LD HL,(FSINF),DE,(FSINF+2)
        CALL XPOZI
        LD HL,LOBU
        LD A,1:CALL RDDSE
        LD HL,FSTFRC,DE,LOBU+492,BC,4
        LDIR
        LD HL,LOBU
        LD A,1:CALL SDDSE
        RET
;---------------------------------------
;CHAIN->SECTORS:
CHTOSE  ;i:HL(4) - First Cluster number
;             DE - BUFFER Address
;             BC - End Of BUFFER

        LD (DABC),BC
        LD (DADE),DE
CKAGO   LD (DAHL),HL

        CALL GIPP:RET Z
        CALL CLUSSEC
        LD DE,(DABC)
        OR A:SBC HL,DE:RET NC

        LD HL,(DAHL)
        LD E,(HL):INC HL
        LD D,(HL):INC HL
        LD A,(HL):INC HL
        LD H,(HL),L,A:EX DE,HL

        CALL CURIT
        JR CKAGO

;-------
CLUSSEC ;i:  (DADE) - Buffer Address
;          (BSECPC) - Sectors per CLUS
;           [DE,HL] - Sector number
;
;        o:  (DADE) - New Value

        LD BC,HL
        LD A,(BSECPC)
        LD HL,(DADE)
USS     LD (HL),C:INC HL
        LD (HL),B:INC HL
        LD (HL),E:INC HL
        LD (HL),D:INC HL
        LD (DADE),HL:DEC A:RET Z

        INC BC
        EXA:LD A,B:OR C:JR NZ,$+3:INC DE
        EXA
        JR USS

;-------
GIPP    ;i:  HL(4) - Cluster number
;        o:[DE,HL] - Sector number
;                Z - EndOfChain

        LD E,(HL):INC HL
        LD D,(HL):INC HL
        LD A,(HL):INC HL
        LD H,(HL),L,A:OR H,E,D:RET Z
        LD A,H:CP #0F:RET Z
        EX DE,HL

_LD BC,2:OR A:SBC HL,BC:JR NC,$+3:DEC DE

        LD A,(BSECPC):CALL UMNOX2
        LD BC,(SDFAT):CALL ADD4B
        EX DE,HL
        LD BC,(SDFAT+2):ADD HL,BC
        EX DE,HL
        CALL XSPOZ

        LD A,1:OR A
        RET

;---------------------------------------
;SEARCH PARTITION:
HDD     ;i:none
;        o:NZ - FAT32 not found
;           Z - all FAT32 vars are
;               initialized

        LD HL,0,DE,HL
        LD (CUHL),HL,(CUDE),HL
        LD (DAHL),HL,(DADE),HL
        LD (DUHL),HL,(DUDE),HL
        CALL XPOZI
        LD HL,LOBU,A,1:CALL RDDSE

        LD A,3,(COUNT),A,(ZES),A

        LD HL,LOBU+446+4,DE,16,B,4
KKO     LD A,(HL)
        CP #05:JR Z,OKK
        CP #0B:JR Z,OKK
        CP #0C:JR Z,OKK
        CP #0F:JR Z,OKK
        ADD HL,DE
        DJNZ KKO

FHDD    LD A,(ZES):OR A:JP Z,Nhdd

        LD DE,(DADE),HL,(DAHL)
        CALL XPOZI

        LD HL,LOBU:LD A,1:CALL RDDSE

        LD HL,COUNT:DEC (HL):JP Z,NHDD

        LD HL,LOBU+446+16,B,16
        XOR A:OR (HL):INC HL:DJNZ $-2
        JP NZ,NHDD

        LD HL,(LOBU+446+16+8)
        LD DE,(LOBU+446+16+8+2)
        LD (CLHL),HL,(CLDE),DE
        LD HL,(DAHL),DE,(DADE)
        CALL ADD4BF
        LD (DADE),DE,(DAHL),HL
        CALL XPOZI

        LD HL,LOBU,A,1:CALL RDDSE

        LD HL,(LOBU+446+8)
        LD DE,(LOBU+446+8+2)
        CALL ADD4BF
        JR LDBPB

OKK     INC HL,HL,HL,HL
        LD E,(HL):INC HL
        LD D,(HL):INC HL
        LD A,(HL):INC HL
        LD H,(HL),L,A
        EX DE,HL

LDBPB   LD (ADDTOP),HL,(ADDTOP+2),DE
        CALL XPOZI

        LD HL,LOBU;LOAD BPB SECTOR
        LD A,1:CALL RDDSE

;LD HL,LOBU+3,B,6,A,#1D
;FIVE CP (HL):INC HL:JP NC,FHDD
;DJNZ FIVE

        LD HL,(LOBU+11)
        LD A,H:DEC A,A:OR L:JP NZ,FHDD
        LD A,(LOBU+13):OR A:JP Z,FHDD
        LD A,(LOBU+14):OR A:JP Z,FHDD
        LD A,(LOBU+16):OR A:JP Z,FHDD

        LD HL,(LOBU+17),A,H:OR L
;LD HL,(LOBU+19):OR H,L
        LD HL,(LOBU+22):OR H,L
        JP NZ,FHDD
        LD HL,(LOBU+36):OR H,L
        LD HL,(LOBU+36+2):OR H,L
        JP Z,FHDD

;LD HL,ADDTOP,DE,DUHL,BC,4:LDIR
;LD HL,DNU,A,(HL):DEC (HL)
;OR A:JP NZ,FHDD
;LD (HL),0

        LD A,(LOBU+13),(BSECPC),A
_LD B,8:SRL A:JR C,NER:DJNZ $-4:LD A,1
NER     OR A:JP NZ,FHDD
        LD HL,(LOBU+14),(BREZS),HL
        LD HL,(LOBU+48),DE,0
        CALL XSPOZ
        LD (FSINF),HL,(FSINF+2),DE

        LD A,(LOBU+16),(BFATS),A
        LD HL,(LOBU+36),(BFTSZ),HL
        LD HL,(LOBU+36+2),(BFTSZ+2),HL
        LD HL,(LOBU+44),(BROOTC),HL
        LD HL,(LOBU+44+2),(BROOTC+2),HL

        LD HL,(BFTSZ),DE,(BFTSZ+2)
        LD BC,(BFATS),B,0
        CALL UMN4B
        PUSH HL,DE
        LD HL,(BREZS)
        LD (SFAT),HL
        POP DE,BC
        CALL ADD4B
        LD (SDFAT),HL,(SDFAT+2),DE

        LD HL,0
        LD (CUHL),HL
        LD (CUDE),HL
        LD (LSTCAT),HL
        LD (LSTCAT+2),HL

;LD HL,(FSINF),DE,(FSINF+2)
;CALL XPOZI
;LD HL,LOBU
;LD A,1:CALL RDDSE
;LD HL,LOBU+492,DE,FSTFRC
;LD BC,4:LDIR
        LD HL,FSTFRC,B,4:CALL NOPING

        XOR A
        RET

NHDD    LD HL,(DUHL),DE,(DUDE)
        XOR A:LD (ZES),A
        JP LDBPB

Nhdd    LD A,1:OR A
        RET

;---------------------------------------
;ACTIVATE DRIVER:
DOS_SWP ;i:A - driver number

        LD HL,DR1:OR A:JR Z,DRR
        LD HL,DR2:DEC A:JR Z,DRR
        LD HL,DR3:DEC A:JR Z,DRR
        LD HL,DR1

DRR     LD DE,DRVR,BC,DRV_LN:LDIR
        RET

;---------------------------------------
;ARITHMETICS BLOCK:
DEL128  ;i:[DE,HL]/128
;        o:[DE,HL]
;          BC - Remainder

        LD A,L:EXA
        LD A,L,L,H,H,E,E,D,D,0
        RLA
        RL L,H,E,D
        EXA
        AND 127
        LD B,0,C,A
        RET
;-------
DEL512  ;i:[DE,HL]/512
        LD A,L,L,H,H,E,E,D,D,0
        LD BC,1:OR A:CALL NZ,ADD4B
        LD A,2
;-------
DELITX2 ;i:[DE,HL]/A
;                A - Power of Two
;        o:[DE,HL]

        CP 2:RET C
        LD C,0
        SRL A
L33T    SRL D:RR E,H,L,C
        SRL A:JR NC,L33T

        LD A,C:OR A:RET Z
        LD BC,1:CALL ADD4B
        RET
;-------
UMNOX2  ;i:[DE,HL]*A
;                A - Power of Two
;        o:[DE,HL]

        CP 2:RET C
        SRL A
L33t    SLA L:RL H,E,D
        SRL A:JR NC,L33t
        RET
;-------
UMNOG   ;HL*BC=HL DEdest
        LD DE,HL
        LD A,B,B,C,C,A:INC C
        XOR A:DEC B:JR Z,ODN
BSR     ADD HL,DE
        DJNZ BSR
ODN     LD B,A
        DEC C
        JR NZ,BSR
        RET

;INC4B   LD B,4
;EKE     INC (HL):RET NZ
;DEC HL
;DJNZ EKE
;RET

INC4b   LD B,4
EkE     INC (HL):RET NZ:INC HL:DJNZ EkE
        RET

ADD4B   ADD HL,BC:RET NC:INC DE
        RET

ADD4BF  ;i:[DE,HL]+[CLDE,CLHL]
;        o:[DE,HL]
        EX DE,HL
        LD BC,(CLDE)
        ADD HL,BC
        EX DE,HL
        LD BC,(CLHL)
        ADD HL,BC:JR NC,KNH
        INC DE
KNH     LD (CLHL),HL
        LD (CLDE),DE
        RET

UMN4B   ;i:[DE,HL]*BC o:[DE,HL]
        LD A,B,B,C,C,A:INC C
        OR A:JR NZ,TEKNO
        DEC B:JR Z,UMN1
        INC B
TEKNO   XOR A
        CP B:JR NZ,TYS
        DEC C
TYS     DEC B
        PUSH HL,BC
        LD HL,DE
        CP B:JR Z,NEGRY
EFRO    ADD HL,DE
        DJNZ EFRO
        LD B,A
NEGRY   DEC C:JR NZ,EFRO
        LD (REZDE),HL
        POP BC,HL
        LD DE,HL
        CP B:JR Z,NEGRA
OFER    ADD HL,DE
        JR C,INCDE
ENJO    DJNZ OFER
        LD B,A
NEGRA   DEC C:JR NZ,OFER
        LD DE,(REZDE)
UMN1    RET
INCDE   EXX
        LD HL,(REZDE)
        INC HL
        LD (REZDE),HL
        EXX
        JR ENJO
;---------------------------------------
TOS     XOR A:LD (NSDC),A,(EOC),A
        RET

NOPCLA  LD (NOPCA+1),HL
NOPC    DEC A:RET Z
        PUSH AF
        LD HL,(LTHL),DE,(LTDE)
        LD BC,1:ADD HL,BC
        JR NC,$+3:INC DE
        CALL XPOZI

NOPCA   LD HL,0,A,1:CALL SDDSE
        POP AF
        JR NOPC

NOPING  XOR A:LD (HL),A:INC HL:DJNZ $-2
        RET
NOPIDE  LD A,32,(DE),A:INC DE:DJNZ $-2
        RET
;---------------------------------------
GARY    DS 2;see MKSG

DABC    DS 2;see CHTOSE
DAHL    DS 2;see HDD proc.
DADE    DS 2; /
ZES     NOP ;/
;---------------------------------------
DR1     INCB "DOS_IDEN"
DR2     INCB "DOS_SDZC"
DR3     INCB "DOS_SDGS"
;---------------------------------------
END
