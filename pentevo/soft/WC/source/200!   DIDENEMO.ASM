        ORG #3800,$;     IDE Nemo Driver
;-------
LOBU    EQU #3000
;---------------------------------------
        JP IDE_INI
        JP SEL_DEV
        JP REINI

        JP XPOZI
        JP PROZ

        JP RDDSE
        JP SDDSE

        JP RDD256

.16     JP 0
;---------------------------------------
NSDC    NOP ;\ SEC number in CLUS
EOC     NOP ;/ EndOfChain (Flag)

ABT     NOP

BZN     DB 4
NR0     DW 4;number of Sectors

CAHL    DS 2
CADE    DS 2

LSTSE   DS 4

REZDE   DS 2

PR      DS 4

CLHL    DS 2
CLDE    DS 2

LLHL    DS 4

LTHL    DS 2;LAST
LTDE    DS 2
;------Entry Pattern:-------------------
ENTRY   DS 11
EFLG    DB 0,0
        DB #00;ms
        DW #7000:DW #3910;time,date
        DW #3910;acc date
CLSDE   DS 2
        DW #7000:DW #3910;time,date
CLSHL   DS 2
SIZIK   DS 4
        NOP
;---------------------------------------
BREZS   DS 2;+14          FAT PARAMETERS
FSINF   DS 4;[+48(2)]+[ADDTOP]

BFATS   NOP
BFTSZ   DS 4
BSECPC  DS 2;USE 1
BROOTC  DS 4

FSTFRC  DW 2,0

ADDTOP  DS 4

SFAT    DS 2
SDFAT   DS 4

CUHL    DS 2
CUDE    DS 2

NXDE    DS 2
NXHL    DS 2

LDHL    DS 2;Address

COUNT   NOP
DUHL    DS 2
DUDE    DS 2

DUBA    NOP
UUHL    DS 2
BUHL    DS 2
GARY    DS 2;AAA
CLCNT   DS 2;counter
FCTS    DS 4
BUTS    DS 4

LSTCAT  DS 4;Active DIR
RECCAT  DS 4;RECYCLED BIN DIR

BLKNUM  DS 4
;---------------------------------------
;INTERNAL VARIABLES:
DRVRE   NOP
BUFA    DS 2
;---------------------------------------
REINI
IDE_INI RET
;---------------------------------------
COMAH   LD BC,#F0:OUT A:RET
COMM    LD BC,#F0:OUT A:RET
LOLL    LD BC,#F0:IN A:RET
;---------------------------------------
XPOZI   LD (LTHL),HL,(LTDE),DE
PROZ    LD A,H,H,D,D,E,E,A
;DE,cyl H,head L,sec

        LD (BLKNUM),HL
        LD (BLKNUM+2),DE
        RET

REREG   PUSH HL,DE
        LD HL,(BLKNUM)
        LD DE,(BLKNUM+2)

        LD A,H:AND %00001111:LD H,A
        LD A,(DRVRE)
        OR H
        LD BC,#FFD0:OUT A
        LD C,#70:OUT L
        LD C,#B0:OUT D
        LD C,#90:OUT E
        POP DE,HL
        RET

;---------------------------------------
RPOZ    LD BC,#FFD0:IN A:AND #0F
        LD H,A,C,#70:IN L
        LD C,#B0:IN D
        LD C,#90:IN E
        RET

;---------------------------------------
;i:HL - Address
;   A - Sectors

RDDSE   EXA:CALL DRDY
        EXA
        LD BC,#50:OUT A
        EXA
        CALL REREG
        LD A,#20:CALL COMAH,READY
        EXA
RDH1    EXA
        CALL WAITDRQ
        CALL READS:LD (BUFA),HL
        CALL READY
        EXA:DEC A:JR NZ,RDH1
        RET

;---------------------------------------
SDDSE   EXA:CALL DRDY
        EXA
        LD BC,#50:OUT A
        EXA
        CALL REREG
        LD A,#30:CALL COMAH,READY
        EXA
SDH1    EXA
        CALL WAITDRQ
        CALL SAVDS:LD (BUFA),HL
        CALL READY
        EXA:DEC A:JR NZ,SDH1
        RET

;---------------------------------------
;RDYDRQ CALL LOLL:AND #88:CP 8:RET Z
;JR RDYDRQ

READY   CALL LOLL:RLCA:RET NC:JR READY
WAITDRQ CALL LOLL:AND 8:RET NZ
        JR WAITDRQ
DRDY    CALL LOLL
        AND %11000000
        CP %01000000:RET Z
        JR DRDY

ERROR_7 CALL LOLL:RRCA:RET

SEL_SLA LD A,#B0
        LD (DRVRE),A
        LD BC,#D0:OUT A:CALL LOLL
        RLCA
        RET
SEL_MAS LD A,#E0
        JR SEL_SLA+2

;---------------------------------------
DV2     CALL SEL_SLA
        JR DRDET
;-------
SEL_DEV ;i:A - N of dev
        CP 2:RET NC
        DEC A:JR Z,DV2
        CALL SEL_MAS
DRDET   LD A,#08:CALL COMM
        LD L,10
YDET    CALL LOLL
        RLCA:JR NC,RRR
        CALL ERROR_7:JR C,RRR
        EI:HALT
        DEC L:JR NZ,YDET

        LD DE,500
        JR RU

RRR     LD DE,0
        LD H,D,L,E
        CALL XPOZI,REREG
        LD BC,#F0,A,#EC:OUT A;ECCO
        EI
.3      HALT
        CALL RPOZ
        LD A,D:OR E:JR Z,KRU
;LD HL,#EB14
;OR A:SBC HL,DE:RET Z;ATAPI
RU      LD A,1:OR A
        RET
;-------
KRU     LD HL,LOBU:CALL READS
        LD DE,0
        XOR A
        RET

;---------------------------------------
;READ 512b from IDE Device BUFFER
READS   LD C,#10,D,8
RD1
.64     INI
        DEC D:JP NZ,RD1
        RET

;---------------------------------------
;SAVE 512b to IDE Device BUFFER
SAVDS   LD C,#10,D,8
SV1
.64     OUTI
        DEC D:JP NZ,SV1
        RET
;---------------------------------------
RDD256  CALL DRDY
        LD BC,#50,A,1:OUT A
        CALL REREG
        LD A,#20:CALL COMAH,READY
        CALL WAITDRQ
;-------
        LD C,#10,D,8
HUD
.32     INI
        DEC D:JP NZ,HUD
        INC H
        LD D,8
HU2
.32     INI
        DEC D:JP NZ,HU2
        INC H
;-------
        LD (BUFA),HL
        JP READY
;---------------------------------------
