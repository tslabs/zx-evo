;File Creator'&'User menu v0.5
;(C) KOSHI/MGN/2019
;-------------------------------------------;
;source for wild commander ASM compiler v0.9;
;-------------------------------------------;

        SAVEBIN "FILE_CR.WMF"
;---------------------------------------
HEADER  EQU 0
MAINMDL EQU HEADER+512

MMDL    EQU 0 ; Page with Main Module
QCOM    EQU 1 ; Page with Quick Commander

; File Creation:
MAX_NAME_SIZE EQU 26

; WC.MNU:
F2X     EQU 2; Window X
F2Y     EQU 3; Window Y
F2HMAX  EQU 20;MAX BODY height (max count of ENTRYS)
F2WIDTH EQU 40;BODY width
;---------------------------------------
        ORG HEADER
;-------
WLD     EQU #6006; WC API access point
FEP     EQU #600B; FAT Engine Page (PG0)
;---------------------------------------
;HEADER:
        DS 16
        DB "WildCommanderMDL";    Header
        DB #0C;                  Version
        DB 0;                       Type
        DB 2;    Pages
        DB MMDL; Page to #8000
;-------
        DB MMDL,MAINLN/512; CODE
        DB QCOM,32;QC in Hobeta

.4      DB 0,0
;-------
        DS 16
;-------
        DS 32*3
;-------
        DB 0
;-------
        DW #FFFF,#FFFF; MAX SIZE
;-------
        DB "Create File (v0.5)              "
;-------
        DB #11;RUN from F10 menu or by F2
;-------
        DB "Menu  "
;---------------------------------------
        ORG #8000,MAINMDL
;-------
WCMNUSZ EQU 4; WC.MNU max size in 512b blocks
LOBU    EQU #A000
F2BU    EQU LOBU+WCMNUSZ*512
F2BUEX  EQU F2BU+WCMNUSZ*512
;---------------------------------------
PLUGIN    CP #12:JP Z,F2MENU
          CP #03:LD A,0:RET NZ

          XOR A:LD (ESTAT),A

          LD IX,PLWND:CALL MENU:JR NZ,PLEXIT
          LD A,(IX+12)
          DEC A:JR Z,TRDCREATE
          DEC A:JR Z,TXTCREATE
          JR PLEXIT

TXTCREATE CALL CREATETXT:JR PLEXIT
TRDCREATE LD IX,P1WND:CALL MENU,Z,CREATETRD
PLEXIT    LD A,(ESTAT)
          RET
;---------------------------------------
F2ERR     LD (F2ERRME),HL
          LD IX,F2ERWND
          CALL PRWOW
          CALL USPO
          CALL NUSP
          CALL RRESB
          JR PLEXIT
;---------
F2ERR1    CP 2:JR Z,F2ERR11
; can't find device/FAT32 volume
          LD HL,F2ER1TX:JR F2ERR
F2ERR11   ; can't find wc folder
          LD HL,F2ER11T:JR F2ERR
F2ERR2    ; can't find wc.mnu
          LD HL,F2ER2TX:JR F2ERR
F2ERR3    ; no valid entries
          LD HL,F2ER3TX:JR F2ERR
F2ERR4    ; exceeded max count of entries
          LD HL,F2ER4TX:JR F2ERR
F2ERR5    ; no root/name found
          LD HL,F2ER5TX:JR F2ERR
F2ERR6    ; can't find file to execute
          LD HL,F2ER6TX:JR F2ERR
F2ERR7    ; wc.mnu too big
          LD HL,F2ER7TX:JR F2ERR

F2ERRX1   ; unknown extension
          LD HL,F2ERX1T:JR F2ERR
F2ERRX2   ; hobeta file size >= #A000 bytes
          LD HL,F2ERX2T:JR F2ERR
F2ERRX3   ; hobeta start address under #6000
          LD HL,F2ERX3T:JR F2ERR
F2ERRX4   ; SPG v1.0 not #10
          LD HL,F2ERX4T:JR F2ERR
F2ERRX5   ; SPG header corrupted
          LD HL,F2ERX5T:JR F2ERR
;---------------------------------------
F2MENU    ;blah-blah
          LD D,#FD:CALL STREAM:JR NZ,F2ERR1

          LD HL,F2FILE:CALL FENTRY:JR Z,F2ERR2
          LD (DAHL),HL,(DADE),DE
          LD A,D:OR E:JR NZ,F2ERR7
          LD A,H:CP WCMNUSZ*2:JR NC,F2ERR7
          CALL GFILE

          LD HL,LOBU,B,WCMNUSZ:CALL LOAD512
          LD HL,(DAHL),DE,LOBU:ADD HL,DE
          LD (HL),0

          CALL PARSMNU:XOR A:LD (DE),A
          LD A,B
          OR A:JR Z,F2ERR3
          CP F2HMAX+1:JR NC,F2ERR4
          LD (F2H),A:INC A,A
          LD (F2WH),A

          LD IX,F2WND:CALL MENU2:JP NZ,PLEXIT
          LD A,(IX+12)

          LD HL,F2BUEX-1
          LD (HL),0
          DEC A:JR Z,EXZERO

          INC HL
          LD B,A:CALL SER13D:INC HL:DJNZ $-4
          DEC HL
EXZERO    INC HL:LD A,(HL):OR A:JP Z,F2ERR5
          LD (EXTCHK),HL
          DEC HL

          CALL FENTRY:JP Z,F2ERR6
          LD (DAHL),HL,(DADE),DE
          CALL GFILE

          CALL RUNFOR
          DEC A:JP Z,F2ERRX1
          DEC A:JP Z,F2ERRX2
          DEC A:JP Z,F2ERRX3
          DEC A:JP Z,F2ERRX4
          DEC A:JP Z,F2ERRX5
          JP PLEXIT

;---------------------------------------
;i:   LOBU - loaded WC.MNU
;o:   F2BU - hot key + comment ("D: Mega Uber DEMO")
;   F2BUEX - root + file name ("..\demos\megademo.spg")
;        B - count of ENTRYS

PARSMNU   LD DE,F2BUEX
          EXX
          LD HL,LOBU
          LD DE,F2BU

          LD B,0
LINE      LD A,(HL):INC HL
          OR A:RET Z
          CP 13:JR Z,LINE

          LD (DE),A:INC DE
          LD A,(HL):CP ":":RET NZ:INC HL
          LD (DE),A:INC DE

          LD C,F2WIDTH
STRING    LD A,(HL)
          OR A:JR Z,NEXT_LINE:INC HL
          CP 13:JR Z,NEXT_LINE
          CP #20:RET C
          DEC C
          INC C:JR Z,STRING
          LD (DE),A:INC DE
          DEC C
          JR STRING
NEXT_LINE LD (DE),A:INC DE,B
          OR A:JR Z,LINE
          PUSH HL:CALL SER13D
          CP 13:JR NZ,$+3:DEC HL
          PUSH HL
          EXX
          POP HL
          POP BC
          XOR A:SBC HL,BC:JR Z,LEL
          LD A,B,B,H,H,A
          LD A,C,C,L,L,A
          LDIR
          XOR A:LD (DE),A:INC DE
LEL       EXX
          JR LINE
;---------
SER13D    LD C,13
SER       LD A,(HL)
          OR A:RET Z:INC HL
          CP C:RET Z
          JP SER
;---------------------------------------
CREATETXT CALL INIT
          CALL INAME:RET NZ

          CALL MESHOW
          CALL MAKETXT
          JP MEHIDE

MAKETXT   LD HL,SIZETXT,DE,SIZE,BC,4:LDIR
          LD DE,TXTEXT:CALL ADDEXT:RET NZ
          LD HL,NAME:CALL MKFILE:RET NZ

          XOR A:CALL MNGCVPL
          LD HL,#C000,DE,HL,(HL),0:INC DE:LD BC,512-2:LDIR

          LD HL,#C000,B,1:CALL SAVE512
          LD A,3,(ESTAT),A
          XOR A
          RET
;---------------------------------------
CREATETRD LD A,(IX+12)
          DEC A:JR Z,TRDEMPT
          DEC A:JR Z,TRDBOOT
          RET
;-------
TRDEMPT CALL SIZEMN:RET NZ

        CALL INIT
        CALL INAME:RET NZ

        CALL MESHOW
        CALL EMPTY
        CALL MAKETRD
        JP MEHIDE
;-------
MAKETRD LD HL,(SZVA),DE,SIZE,BC,4:LDIR
        LD DE,TRDEXT:CALL ADDEXT:RET NZ
        LD HL,NAME:CALL MKFILE:RET NZ

        XOR A:CALL MNGCVPL
        LD HL,#C000,B,8:CALL SAVE512

        LD A,3,(ESTAT),A
        XOR A
        RET
;---------------------------------------
TRDBOOT CALL SIZEMN:RET NZ

        CALL INIT
        CALL INAME:RET NZ

        CALL MESHOW

        CALL ADDBTHE
        CALL HAUDEH,CAT9C

        CALL MAKETRD:JP NZ,MEHIDE

        LD A,1:CALL MNGC_PL
        LD HL,#C000+17,B,32:CALL SAVE512

        JP MEHIDE
;-------
ADDBTHE LD A,1:CALL MNGC_PL
        LD HL,#C000,DE,BOOTHE,BC,13:LDIR
        INC HL:LDI

        XOR A:CALL MNGCVPL
        LD HL,BOOTHE,DE,#C000,BC,16:LDIR
        RET
;-------
SIZEMN  LD IX,P2WND:CALL MENU:RET NZ

        LD A,(IX+12)
        DEC A:JR Z,TRD640
        DEC A:JR Z,TRD800
        RET
;-------
TRD640  LD HL,2544,(SECZ),HL
        LD HL,SIZE1,(SZVA),HL
        XOR A
        RET
TRD800  LD HL,3184,(SECZ),HL
        LD HL,SIZE2,(SZVA),HL
        XOR A
        RET
;---------------------------------------
INIT    LD HL,(SECZ),(TRDSPC+1),HL

        XOR A:CALL MNGCVPL
        LD HL,#C000,DE,HL:INC DE
        LD BC,#1000-1
        LD (HL),L:LDIR
        RET
;---------------------------------------
F2_HOT_KEY CP "0":JR C,F2_HOT_NOK
           CP "9"+1:JR C,F2_HOT_OK
           CP "a":JR C,F2_HOT_NOK
           CP "z"+1:JR NC,F2_HOT_NOK
F2_HOT_OK  LD B,A
           LD HL,F2BU,E,1

F2_HOT_CQ  LD A,(HL):OR A:RET Z
           CP "A":JR C,F2_NO_CAPS
           CP "Z"+1:JR NC,F2_NO_CAPS
           SET 5,A
F2_NO_CAPS CP B:JR Z,F2_BINGO
           CALL SER13D:INC E
           JR F2_HOT_CQ

F2_BINGO   LD (IX+12),E,A,1:OR A:RET
F2_HOT_NOK XOR A:RET
;---------------------------------------
;       i: IX - SOW

MENU2   CALL PRWOW
MAIN2   EI:HALT:CALL CURSOR

        CALL UPPP,NZ,UPC
        CALL DWWW,NZ,DNC

        CALL ESC:JR NZ,AIN
        CALL ENKE:JR NZ,MAJ

        LD A,1:CALL KBSCN,NZ,F2_HOT_KEY:JR NZ,MAJ
        JR MAIN2

;---------------------------------------
;i:  IX - SOW

MENU    CALL PRWOW

        LD A,1:CALL YN
MAIN    EI:HALT:XOR A:CALL YN,CURSOR

        CALL UPPP,NZ,UPC
        CALL DWWW,NZ,DNC

        CALL ESC:JR NZ,AIN
        CALL ENKE:JR Z,MAIN

        LD A,#FF:CALL YN:JR NZ,AIN

MAJ     CALL RRESB:XOR A:RET
;-------
AIN     CALL MAJ:INC A:RET
;-------
UPC     LD A,(IX+12):CP 1:RET Z
        CALL CURSER
        DEC (IX+12)
        JP CURSOR
DNC     LD A,(IX+12):CP (IX+13):RET NC
        CALL CURSER
        INC (IX+12)
        JP CURSOR
;---------------------------------------
;Input name
INAME   LD IX,NMWND:CALL PRWOW

        LD HL,NAME1,DE,NAME1+1,BC,MAX_NAME_SIZE-1,(HL)," ":LDIR

        LD HL,TXT2,DE,#0000:CALL TXTPR
        LD HL,TCT0,DE,#0101:CALL TXTPR

        LD DE,#0106:CALL GADRW
        LD (BMKD+1),HL
        LD DE,256*MAX_NAME_SIZE+#00,A,#FF:CALL ISTR
MKD     EI:HALT
        CALL ESC:JR NZ,EMKD
        CALL ENKE:JR NZ,BMKD

        XOR A:CALL ISTR
        JR MKD
;-------
EMKD    CALL RRESB
        LD A,1:OR A
        RET
;-------
BMKD    LD HL,0
        LD DE,NAME1,BC,MAX_NAME_SIZE:LDIR
        CALL RRESB
        XOR A
        RET
;---------------------------------------
MESHOW  LD IX,MEWND:CALL PRWOW
        XOR A:JP MNGCVPL

MEHIDE  LD IX,MEWND:JP RRESB
;---------------------------------------
NFS     INC A:CP 16:JR C,JEKTOR:INC D
        XOR A
JEKTOR  DJNZ NFS
        RET

ADDSUM  LD HL,0,DE,0
        EXX
        LD HL,#C000,DE,13,B,128
DSU     LD A,(HL):OR A:RET Z
        ADD HL,DE
        LD A,(HL)
        EXX
        LD E,A
        ADD HL,DE
        EXX
        INC HL,HL,HL
        DJNZ DSU
        RET

CAT9C   EXX
        LD HL,#C8EA,DE,HL:INC DE
        LD BC,9-1,(HL),32:LDIR
        LD A,#10,(#C000+#08E7),A
        EXX

        LD A,129:SUB B
        LD (#C000+#08E4),A
        LD A,C,(#C000+#08F4),A
        DEC HL:LD D,(HL)
        DEC HL:LD A,(HL)
        DEC HL:LD B,(HL):CALL NFS
        LD E,A,(#C000+#08E1),DE
        CALL ADDSUM:EXX
        EX DE,HL
TRDSPC  LD HL,2544
        OR A:SBC HL,DE:RET C
        LD (#C000+#08E5),HL
        XOR A
        RET
; _
HAUDEH  LD HL,#C000,DE,16,BC,#8100
HEHA    LD A,(HL):OR A:RET Z
        CP 1:JR NZ,$+3:INC C
        ADD HL,DE
        DJNZ HEHA
        OR A
        RET

EMPTY   LD HL,#C8EA,DE,HL:INC DE
        LD BC,9-1,(HL),32:LDIR
        LD A,#10,(#C000+#08E7),A

        XOR A
        LD (#C000+#08E4),A
        LD (#C000+#08F4),A

        LD HL,#0100
        LD (#C000+#08E1),HL
        LD HL,(TRDSPC+1)
        LD (#C000+#08E5),HL

        XOR A
        RET
;---------------------------------------
ADDEXT    ;i:DE - EXT to ADD (5 bytes)
;                 DB ".TRD",0 or somthing
;          o: Z - OK
;            NZ - ERROR (Empty name)

          LD HL,NAME1+MAX_NAME_SIZE
          LD A," ",B,MAX_NAME_SIZE
NAME_SCAN DEC HL:CP (HL):JR NZ,ADDGO
          DJNZ NAME_SCAN
          INC B
          RET

ADDGO     INC HL:EX DE,HL:LD BC,5:LDIR
          XOR A
          RET
;---------------------------------------
        INCL "runners.asm"
DEHR1M  INCB "DEHR1M.CDB"
MLZ40   INCB "MLZ50F.CDB"
;---------------------------------------
INT_PL  EXA:LD A,86:JP WLD

MNGC_PL EXA:LD A,0:JP WLD
PRWOW   LD A,1:JP WLD
RRESB   LD A,2:JP WLD
PRSRW   LD A,3:JP WLD
PRIAT   EXA:LD A,4:JP WLD
GADRW   LD A,5:JP WLD
CURSOR  LD A,6:JP WLD
CURSER  LD A,7:JP WLD
YN      EXA:LD A,8:JP WLD
ISTR    EXA:LD A,9:JP WLD
TXTPR   LD A,11:JP WLD
;-------
UPPP    LD A,17:JP WLD
DWWW    LD A,18:JP WLD

ENKE    LD A,22:JP WLD
ESC     LD A,23:JP WLD
KBSCN   EXA:LD A,42:JP WLD
USPO    LD A,46:JP WLD
NUSP    LD A,47:JP WLD
;-------
LOAD512 LD A,48:JP WLD
SAVE512 LD A,49:JP WLD
STREAM  LD A,57:JP WLD
FENTRY  LD A,59:JP WLD
GFILE   LD A,62:JP WLD
MKFILE  LD A,72:JP WLD
;-------
MNGCVPL EXA:LD A,65:JP WLD
GVmod   EXA:LD A,66:JP WLD
;---------------------------------------
;MAKE FILE
PLWND   DB 5+128,0
        DB 27,10;    X,Y
        DB 24+2,4+2; W,H
        DB %01111111;PAPER+INK
        DB 0
        DW #0000;    BUFFER
        DB 2,0;      LINES

        DB 1,2
        DB %11110001,0

        DW PLTOP; TOP
        DW 0;     BOTTOM
        DW MS00;  BODY

PLTOP   DB #E,9,"Select Option:",0
MS00    DB " Create TRD image...",13
        DB " Create empty TXT File",0
;-------
;MAKE TRD MENU
P1WND   DB 5+128,0
        DB 30,10;    X,Y
        DB 18+2,4+2; W,H
        DB %01111111;PAPER+INK
        DB 0
        DW #0000;    BUFFER
        DB 2,0;      LINES

        DB 1,2
        DB %11110001,0

        DW P1TOP; TOP
        DW 0;     BOTTOM
        DW MS01;  BODY

P1TOP   DB #9,#E,"Create TRD image",0
MS01    DB #E,"Empty TRD File",13
        DB #E,"TRD With Boot!",0
;-------
;TRD SIZE MENU
P2WND   DB 5+128,0
        DB 30,10;    X,Y
        DB 18+2,4+2; W,H
        DB %01111111;PAPER+INK
        DB 0
        DW #0000;    BUFFER
        DB 2,0;      LINES

        DB 1,2
        DB %11110001,0

        DW P2TOP; TOP
        DW 0;     BOTTOM
        DW MS02;  BODY

P2TOP   DB #9,#E,"Select Size:",0
MS02    DB #E,"640 KB",13
        DB #E,"800 KB",0
;---------------------------------------
;F2 Menu
F2WND   DB 5+64+128,0
        DB F2X,F2Y;  X,Y
        DB F2WIDTH+2;W
F2WH    DB 2+2;      H
        DB %01001111;PAPER+INK
        DB 0
        DW #0000;    BUFFER
        DB 0,0;      LINES

        DB 1;curNOW
F2H     DB 2;curMAX
        DB %11110000,0

        DW F2TOP; TOP
        DW 0;     BOTTOM
        DW F2BU;  BODY

F2TOP   DB #E,9,"User menu:",0

F2ERWND DB 7+64+128,0
        DB 19,12;    X,Y
        DB 40+2,1+2; W,H
        DB %00101111;PAPER+INK
        DB 0
        DW #0000;    BUFFER
        DB 0,0;      LINES

        DW 0;        TOP
        DW 0;        BOTTOM
F2ERRME DW F2ER1TX;  BODY

F2ER1TX DB #E,"can't find device or FAT32 partition!",0
F2ER11T DB #E,"can't find WC folder on boot-device!",0
F2ER2TX DB #E,"can't find WC.MNU on boot-device!",0
F2ER3TX DB #E,"no valid entries!",0
F2ER4TX DB #E,"exceeded maximum count of entries!",0
F2ER5TX DB #E,"no root or file name found!",0
F2ER6TX DB #E,"can't find file to execute!",0
F2ER7TX DB #E,"WC.MNU too big!",0

F2ERX1T DB #E,"unknown extension! (not SPG/$C)",0
F2ERX2T DB #E,"hobeta file too big!",0
F2ERX3T DB #E,"hobeta file start address unsupported!",0
F2ERX4T DB #E,"SPG header corrupted!",0
F2ERX5T DB #E,"unsupported SPG version!",0

F2FILE  DB 0,"WC.MNU",0
;---------------------------------------
MEWND   DB 7+128,0
        DB 23,13;    X,Y
        DB 32+2,1+2; W,H
        DB %01111111;PAPER+INK
        DB 0
        DW #0000;    BUFFER
        DB 0,0;      LINES

        DW 0;    TOP
        DW 0;    BOTTOM
        DW METXT;BODY

METXT   DB #E,"Creating File...",0
;-------
NMWND   DB 3+128,0
        DB 23,13;    X,Y
        DB 31+2,1+2; W,H
        DB %01011111;PAPER+INK
        DB 0
        DW #0000;    BUFFER
        DB 0,0;      LINES
;-------
TXT2    DB #9,#E,"Creating File:",0

TCT0    DB "Name:",0
;-------
BOOTHE  DB "boot    B"
        DB #00,#00;Start Addres
        DB #00,#00;Size in Bytes
        DB #00;    Size in Sectors
        DB #00,#01;Sec, Track
;-------
NAME    DB #00
SIZE    DS 4
NAME1   DS MAX_NAME_SIZE+5
;-------
SIZE1   DW #0000,#000A;640Kb
SIZE2   DW #8000,#000C;800Kb
SIZETXT DW #0001,#0000;1b
;-------
TRDEXT  DB ".trd",0
TXTEXT  DB ".txt",0
;---------------------------------------
SECZ    DW 2544
SZVA    DW SIZE1

DAHL    DS 2
DADE    DS 2

ESTAT   NOP
PLUGEND
;---------------------------------------
MAINLN  EQU ((PLUGEND-PLUGIN)/512+1)*512
;-------
        ORG MAINMDL+MAINLN
        INCB "QC_3_11.COD"
