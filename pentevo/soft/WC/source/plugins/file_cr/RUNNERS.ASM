SYC     EQU #20AF
CYC     EQU #2BAF
PE0     EQU #21AF

Vmod    EQU #00AF
Vpag    EQU #01AF

DMA_T   EQU #28AF;WTF? Y YA NEED DAT... ;P

PW0     EQU #10AF
PW1     EQU #11AF
PW2     EQU #12AF
PW4     EQU #13AF
;-------
D2PG    EQU #F6
D5PG    EQU #F5
DBPG    EQU #F4
BASIC48 EQU %11

L0AD512 EQU #4015; KERNEL
;-------
BUFERX  EQU #0200
;----------------------------------------
;----------------------------------------
DINT    EI:HALT:DI
        LD HL,#5BFF+2,(#5BFF),HL
        RET
;-------
RAZ     LD A,(DE):CP (HL):RET NZ
        INC HL,DE
        DJNZ RAZ
        RET
;-------
MNG0FE  LD A,(FEP)
        LD (#6000),A,BC,PW0:OUT A:RET
MNG0D   LD BC,PE0,A,%00000001:OUT A
        LD BC,PW0,A,%00000000:OUT A
        RET
;----------------------------------------------------
MNG8    LD (#6002),A,BC,PW2:OUT A:RET;               \
MNGC    PUSH BC:LD (#6003),A,BC,PW4:OUT A:POP BC:RET;|
TURBOof LD BC,#EFF7:XOR A:OUT A                   ;  /
        LD A,0                                   ;  /
BOF     EQU $-1                                 ;  /
        AND %11                                ;  /
        LD BC,SYC:OUT A                       ;  /
        LD A,0;CACHE                         ;  /
        LD BC,CYC:OUT A                     ;  /
        RET                                ;  /
RERE    ;                                    /
;--------------------------------------------
RUNFOR  LD HL,#2020
        LD (EXTC),HL,(EXTC+1),HL

        LD HL,(EXTCHK)
        LD DE,EXTZ
        PUSH HL:CALL SER13D
        POP BC
        OR A:SBC HL,BC:RET Z
        LD A,H:OR A:RET NZ
        ADD HL,BC

        CALL DOTCHE:RET NZ:INC HL
        CALL EXTCOPY

        CALL EXT2PRO:LD A,1:RET Z
        JP (HL)
;-------
EXT2PRO ;i: EXTC(3) - input ext ("SPG"/"$C")
;           EXTZ(X) - EXT1(3),PROC ADDR1(2),EXT2(3),PROC ADDR2(2),...,0
;
;        o: Z - Fail
;          NZ - OK
;          HL - Proc address

        LD DE,EXTZ
EXTPRO  LD HL,EXTC
        LD A,(DE):OR A:RET Z

        LD B,3
YOKO    CP (HL):INC HL,DE:JR NZ,NEXTEXT
        LD A,(DE)
        DJNZ YOKO
        LD A,(DE),L,A:INC DE
        LD A,(DE),H,A
        LD A,1:OR A
        RET

NEXTEXT INC B
        LD C,B,B,0
        EX DE,HL:ADD HL,BC:EX DE,HL
        JR EXTPRO

;#61-#7A -> #41-#5A
EXTCOPY LD DE,EXTC
        LD B,3
EC      LD A,(HL):OR A:RET Z
        CP #61:JR C,ECOK
        CP #7A+1:JR NC,ECOK
        RES 5,A
ECOK    LD (DE),A:INC HL,DE
        DJNZ EC
        RET

DOTCHE  LD A,"."
        LD B,4
ASOBOU  DEC HL:CP (HL):RET Z
        DJNZ ASOBOU
        OR A
        RET
;----------------------------------------
RUNHOB  ;CALL FSM:RET Z

        LD HL,LOBU,B,1:CALL LOAD512
        LD HL,(LOBU+#B),A,H:CP #A0:LD A,2:RET NC
        LD DE,(LOBU+#9),A,D:CP #60:LD A,3:RET C

        CALL DINT
        LD A,%00110000,BC,Vmod:OUT A
        LD SP,#6000

        EXX
        CALL MNG0FE
        XOR A:CALL MNGC,TURBOof
        LD HL,HOBAT,DE,#5B00,BC,HOBATE-HOBAT:LDIR
        LD HL,LOBU,DE,BUFERX,BC,512:LDIR
        EXX

        LD HL,512-17:ADD HL,DE
        PUSH DE
        JP #5B00
;-------
HOBAT   LD A,2,(#6002),A,BC,PW2:OUT A

        PUSH DE
THG     LD A,H:CP #60:JR C,THg
        LD B,1:CALL L0AD512
        CP #0F:JR NZ,THG
THg     POP DE
        LD HL,BUFERX+17,BC,512-17:LDIR

        DI
        LD A,63,I,A:IM 1
        LD IY,#5C3A

        LD HL,#5800,DE,HL:INC DE
        LD BC,#0300-1,(HL),L:LDIR

        LD BC,Vmod:XOR A:OUT A
        LD BC,PE0,A,%00000001:OUT A
        LD BC,PW0,A,%00000000:OUT A
        LD BC,#7FFD,A,16:OUT A
        RET
HOBATE
;----------------------------------------
K         EQU #0000
MLZP      EQU #0D00
HRSP      EQU #0E00
LOB3      EQU #1000
MNG8RE    EQU #1800
MNGCRE    EQU MNG8RE+(MNGC-MNG8)
TURBOofRE EQU MNG8RE+(TURBOof-MNG8)
;-------
SPG1    ;SPGv1.0
        CP #10:LD A,4:RET NZ

        CALL DINT
        CALL MNG0FE
        LD A,%00110000,BC,Vmod:OUT A

        LD A,D5PG:CALL MNGC
        LD HL,#C000,DE,HL:INC DE
        LD (HL),L,BC,#4000-1:LDIR

        LD HL,(LOB2+#30),(SPG_SA+1),HL
        LD HL,(LOB2+#32),(SPG_SP+1),HL
        LD HL,(LOB2+#38),(SPG_RZ+1),HL

        LD A,(LOB2+#34),(SPG_PG+1),A
        LD A,(LOB2+#35)
        LD C,A
        AND %00000011:LD (BOF),A

        LD A,C:AND %00000100
        LD A,#F3:JR Z,$+4:LD A,#FB;EI
        LD (SPG_IT),A

        LD HL,MNG8,DE,MNG8RE,BC,RERE-MNG8:LDIR
        LD HL,LOB2,DE,LOB3,BC,1024:LDIR
        LD HL,SPGRZ,DE,K,BC,Y-SPGRZ:LDIR

        LD HL,MLZ40,DE,MLZP,BC,256:LDIR
        LD HL,DEHR1M,DE,HRSP,BC,512:LDIR
        JP K
;-------
SPGRZ   LD IX,LOB3+256
        LD A,DBPG:CALL MNG8RE

        LD B,0
KOVR    LD A,(IX):INC IX
        LD C,A
        AND %00011111:ADD A,A,A,#C0
        LD H,A
        LD L,0
        INC IX
        LD A,(IX):INC IX
        CP #02:JR NZ,$+4:LD A,D2PG
        CP #05:JR NZ,$+4:LD A,D5PG
        CALL MNGCRE

        LD A,(IX-2)
        LD E,A:AND %11000000
.2      RLCA
        LD D,A

        LD A,E:AND %00011111:INC A
        PUSH BC,IX
        LD B,A
        LD A,D:OR A:JR NZ,SPGPKD
        CALL L0AD512
PKDE    POP IX,BC
        LD A,C
        AND %10000000:JR NZ,ARBLKZ
        DJNZ KOVR
        JR ARBLKZ
;-------
SPGPKD  DEC A:JR Z,SPGMLZ
SPGHRS  PUSH HL:LD HL,#8000:CALL L0AD512
        POP DE
        DI
        LD IX,#8000
        CALL HRSP
        JR PKDE

SPGMLZ  PUSH HL:LD HL,#8000:CALL L0AD512
        POP DE
        DI
        LD HL,#8000
        CALL MLZP
        JR PKDE
;-------
ARBLKZ  LD A,D2PG:CALL MNG8RE
        LD A,2:CALL MNGCRE
        LD HL,#8000,DE,#C000
        LD BC,#4000:LDIR

        DI:CALL TURBOofRE

        LD A,D5PG:CALL MNG8RE
        LD A,5:CALL MNGCRE
        LD HL,#8000,DE,#C000
        LD BC,#4000:LDIR

        LD BC,Vpag,A,5:OUT A
        LD BC,Vmod:XOR A:OUT A

        LD A,63,I,A:IM 1
SPG_PG  LD A,0,BC,PW4:OUT A
        LD A,2,B,PW2[:OUT A
        LD A,5,B,PW1[:OUT A

        LD HL,SPGRZD-SPGRZ+K
        LD DE,(SPG_RZ+1-SPGRZ+K)
        LD BC,16:LDIR

        LD HL,#2758:EXX
        LD IY,#5C3A
        LD BC,DMA_T:XOR A:OUT A

SPG_SA  LD HL,0
SPG_SP  LD SP,#6000
SPG_RZ  JP 0
;-------
SPGRZD  LD BC,PE0,A,%00000001:OUT A
        LD B,PW0[,A,BASIC48:OUT A
SPG_IT  DI
        JP (HL)
Y
;---------------------------------------
PAGER   EQU #5300
LOB2    EQU #B000
;-------
RUNSPG  LD HL,LOB2,B,2:CALL LOAD512
        LD HL,LOB2+32,DE,IDNT,B,12
        CALL RAZ:LD A,5:RET NZ

        LD A,(HL):CP 3:JP NC,SPG1
        CP 2:JR C,OF4
;SPGv0.2:
        LD A,15,(VrS+1),A
        LD A,16,(V2A+1),A,(V2F+1),A
        LD A,4,(V2B+1),A
        LD A,15,(V2C+1),A
;SPGv0.0/0.1:
OF4     ;HL,SPGLOG:CALL SPGLOG

        ;CALL FSM:RET Z

        CALL DINT,TURBOof
        CALL MNG0FE
        LD A,%00110000,BC,Vmod:OUT A

        LD HL,LOB2+1024,B,2:CALL L0AD512
        LD HL,LOB2,DE,PAGER,BC,#0800
        LDIR

        LD HL,MANAG0,DE,PAGER,BC,32:LDIR
        XOR A:CALL MNGC
;-------
V2A     LD A,8,(STUS),A;        COUNTER!
        LD HL,(PAGER+64),(SAR+1),HL

        LD A,(PAGER+66),(SPA+1),A
        LD HL,(PAGER+74)
        LD A,H:CP #40:JR NC,NSPZ
        LD HL,#6000;(SPBU)
NSPZ    LD (SSPA+1),HL

        LD HL,(PAGER+68),(V2E+1),HL

        LD HL,(PAGER+76)
        LD A,H:OR L:JR Z,V2Di
        LD (V2D+1),HL
V2Di    LD BC,(PAGER+78)
        LD A,B:OR C:JR Z,MAA
        LD A,B:OR A:JR Z,MAA:LD B,1
        LD A,C:CP #41:JR C,MAA:LD C,0
MAA     LD (LAA+1),BC

        LD IX,PAGER+128
GROP    LD A,(IX+2):CP 14:JR C,NSPL
        LD A,13
NSPL    LD (SPGL+1),A

        LD A,(IX+3)
VrS     AND 7
        CALL MNGC

        LD HL,PAGER+512,E,(IX),D,(IX+1)
        LD BC,#0600
        CALL LC
        EX DE,HL
        LD A,H:CP #A0:JR C,DIPL
        PUSH IX
SPGL    LD B,1:SLA B,B
        LD A,B:OR A:CALL NZ,L0AD512
        POP IX

V2B     LD DE,8:ADD IX,DE

        LD A,(STUS):DEC A
        LD (STUS),A:JR NZ,GROP
;-------
DIPL    DI
        LD A,63,I,A:IM 1
        LD IY,#5C3A

        LD BC,Vmod:XOR A:OUT A
        CALL MNG0D
        LD BC,#7FFD,A,16:OUT A
   LD HL,#5800,DE,#5801,BC,#02FF
   LD (HL),L
   LDIR

        LD HL,PAGER
V2E     LD DE,0
        LD BC,32
        LDIR

LAA     LD BC,0,A,B:OR C:JR Z,SPA
        LD HL,PAGER+192
V2D     LD DE,#5B00
        LDIR

SPA     LD A,0
V2C     AND 7
        CALL PAGER

;LD A,(PAGER+67)
;CP 1:JR NZ,NNx
;LD A,(DRVE),(#5CF6),A

NNx     LD A,(V2C+1):CP 7:JR Z,SSPACLS
        LD HL,PAGER+49,E,5
OUTZ    LD C,(HL):INC HL
        LD B,(HL):INC HL
        LD A,B:OR C:JR Z,OUTz
        LD A,(HL)
        OUT A
OUTz    INC HL
        DEC E:JR NZ,OUTZ

SSPACLS LD HL,#4000,DE,HL,(HL),L,BC,#1800-1:INC DE:LDIR

SSPA    LD SP,0
SAR     JP 0
;-------
LC      LD A,(STUS)
V2F     CP 8:RET NZ
        LD A,D:CP #A0:JR NC,V01

        LD (SREZ+4),DE
        ADD A,6:LD D,A
        PUSH DE
        LD HL,(SAR+1),(SR1+1),HL
        LD DE,PAGER+#20,(SAR+1),DE
        LD HL,SREZ,BC,16:LDIR
        POP DE
        RET

V01     LDIR
        RET

SREZ    LD HL,PAGER+512
        LD DE,0
        LD BC,#0600
        LDIR
SR1     JP 0
;-------
MANAG0  ;I:A - num of PAGE (VALID: 0-15)
        PUSH BC
        LD BC,PW4:OUT A
        POP BC
        RET
;----------------------------------------
EXTCHK  DS 2
EXTC    DB "   "
EXTZ    DB "$C ":DW RUNHOB
        DB "SPG":DW RUNSPG
        DB 0

IDNT    DB "SpectrumProg"
STUS    NOP
;----------------------------------------
