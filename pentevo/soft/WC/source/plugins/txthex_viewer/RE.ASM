;Text & HEX Viewer
;(C) KOSHI/MGN 2024
;---------------------------------------
        SAVEBIN "re.wmf"

        ORG #0
;-------
WLD     EQU #6006; Plugin System Call Point
TMN     EQU #6009; Timer
HEI     EQU #600E

LOBU    EQU #B000

TVBPG   EQU 0
TVEPG   EQU TVBPG+63
;---------------------------------------
;Plug-in Header:
        DS      16;  reserved
        DB      "WildCommanderMDL";
        DB      #E; version of Plug-in system
        DB      0;   reserved
;-------
        DB      1; Pages
        DB      0; Page to #8000
;-------
        DB      0,1+(ENDPL-RE)/512
.5      DB      0,0
;-------
        DS      15;  reserved
;-------ExtExeType:
        DB      %11; F3 Only
;-------Exts:
        DB      "TXT";0
        DB      "WRD";1
        DB      "INI";2
        DB      "INF";3
        DB      "HTM";4
        DB      "A80";5
        DB      "ASM";6
        DB      "DIZ";7
        DB      "NF0";8

        DB      "BIN";9
BINEXT  EQU     9
.22     DS      3
        DB      0
;-------
        DW      #0000,#FFFF; max file size
;-------
        DB      "Text&HEX Viewer v0.22           "
        DB      5; by Extension & by F3 or by F10 menu
;-------
        DS      6
;-------
        DB      "View as Text or BIN     "
;-------
        DS      284
;---------------------------------------
        ORG #8000,$
RE      LD (BUX),BC
        LD (DAHL),HL,(DADE),DE

        ;OR A:JR Z,BYEXT
        CP 3:JP Z,BYF10
        CP 4:JR NZ,BYEXT
BYGREEN CALL LOADnPR
        CALL ANALYZE:JP Z,VBIN
BYEXT   EXA
        CALL LOADnPR:CP BINEXT:JP Z,VBIN

RERE    CALL CHEBUREK
        CALL PGPR
REMAIN  EI:HALT

        CALL TABK:JP NZ,VBIN

        CALL UPPP,NZ,TVUP
        CALL DWWW,NZ,TVDN
        CALL PGU,NZ,TVPGUP
        CALL PGD,NZ,TVPGDN

        CALL SPKE:JR NZ,REEX
        CALL ESC:JR Z,REMAIN

REEX    CALL RRESB
        XOR A
        RET
;-------
LOADnPR PUSH AF
        CALL REK
        LD IX,TVWND:CALL PRWOW
        CALL TVHEAD
        POP AF
        RET
;---------------------------------------
BYF10   PUSH AF
        LD HL,DIRDIR
        CALL FENTRY;if root dir - need to reset CRRR(4) (but how?)
        CALL GFILE
        CALL REK
        LD IX,TVWND:CALL PRWOW
        POP AF
        JP VBIN
;---------------------------------------
TVHEAD  LD HL,LOBU
        PUSH HL
        LD (HL),#8:INC HL
        LD (HL),#1:INC HL:LD DE,HL
        LD A," ",B,(IX+4):CALL NOPING+1
        LD (HL),#00

        LD HL,(BUX),B,(IX+4)
TVNML   LD A,(HL):CP #20:JR C,TVHBB
        LD (DE),A:INC HL,DE
        DJNZ TVNML
TVHBB   POP HL
        LD DE,#0000:JP TXTPR
;-------
TVPGUP  LD HL,(CURU)
        LD B,(IX+5):DEC B
PUP     PUSH BC:LD BC,CUPU:CALL SERUP
        POP BC:JR C,TVup
        DJNZ PUP
        LD (CURU),HL
        JP PGPR

TVPGDN  CALL DWNF:RET Z

        LD (CURU),HL
        LD A,(CUPG),(CUPU),A
        JP PGPR
;-------
TVup    LD HL,#C000,(CURU),HL:JP PGPR
TVUP    LD HL,(CURU),BC,CUPU
        CALL SERUP:JR C,TVup
        LD (CURU),HL

        LD HL,EDFL,A,(HL)
        OR A:JR Z,$+5:DEC (HL):JR NZ,M3

        LD HL,(CURD),BC,CUPG
        CALL SERUP
        LD (CURD),HL

M3      LD B,(IX+5):DEC B
        LD C,80
        LD DE,#0100
        LD A,%00000000:CALL SCRLWOW

        LD DE,#0100
        LD HL,(CURU),(THL),HL:JP LNPRU
;-------
DWNF    LD A,(CUPG):CALL MNGCVPLX
        LD HL,(CURD),A,(HL):OR A
        RET

TVDN    CALL DWNF:RET Z

        LD B,(IX+5):DEC B
        LD C,80
        LD DE,#0100
        LD A,%00000001:CALL SCRLWOW

        LD E,0
        LD D,(IX+5):DEC D
        LD HL,(CURD),(THL),HL:CALL LNPR
        LD HL,(THL),(CURD),HL

        LD A,(CUPG)
        PUSH AF
        LD A,(CUPU),(CUPG),A:CALL MNGCVPLX
        LD HL,(CURU):CALL SERDN
        LD (CURU),HL
        LD A,(CUPG),(CUPU),A
        POP AF
        LD (CUPG),A
        RET
;-------
PGPR    XOR A:LD (EDFL),A

        LD A,(CUPU),(CUPG),A
        LD HL,(CURU),(THL),HL

        LD B,(IX+5):DEC B
        LD DE,#0100
MNC     PUSH DE,BC
        CALL LNPR

        LD A,(CUPG):CALL MNGCVPLX
        LD HL,(THL),A,(HL)
        OR A:CALL Z,ZERL

        POP BC,DE:INC D:DJNZ MNC
        LD HL,(THL),(CURD),HL
        RET

ZERL    LD HL,EDFL:INC (HL):RET
;-------
LNPRU   LD A,(CUPG)
        PUSH AF
        LD A,(CUPU),(CUPG),A:CALL LNPR
        POP AF
        LD (CUPG),A
        RET

LNPR    LD A,(CUPG)
        CALL MNGCVPLX

        EXX
        LD HL,(THL)
        LD DE,LOBU:CALL LIGEN
        LD (THL),HL:CALL LIFIL
        EXX
        LD HL,LOBU,B,0,C,(IX+4):JP PRSRW

LIGEN   LD BC,#0D0A
        LD A,H:OR A:CALL Z,A440
        LD A,(HL):OR A:RET Z
        CP B:JR NZ,$+3:INC HL
        LD A,H:OR A:CALL Z,A440
        LD A,(HL)
        CP C:JR NZ,$+3:INC HL

LILI    LD A,H:OR A:CALL Z,A440
        LD A,D:CP LOBU[+4:RET NC
        LD A,(HL):OR A:RET Z
        CP B:RET Z
        CP C:RET Z:INC HL
        LD (DE),A:INC DE
        JP LILI

LIFIL   LD A,D:CP LOBU[+1:RET NC
        LD A,E:SUB (IX+4):RET NC
        EX DE,HL
        NEG:LD B,A:JP NOPING

CRPR    RET
;-------
SERDN   LD BC,#0D0A
        LD A,H:OR A:CALL Z,A440
        LD A,(HL):OR A:RET Z
        CP B:JR NZ,$+3:INC HL
        LD A,H:OR A:CALL Z,A440
        LD A,(HL)
        CP C:JR NZ,$+3:INC HL

LILI2   LD A,H:OR A:CALL Z,A440
        LD A,(HL):OR A:RET Z
        CP B:RET Z
        CP C:RET Z:INC HL
        JP LILI2
;-------
SERUP   LD (A440U+1),BC,A,(BC)
        CALL MNGCVPLX
        
        LD BC,#0D0A
SERup   DEC HL
        LD A,H:CP #C0
        CALL C,A440U:RET C

        LD A,(HL)
        CP B:RET Z
        CP C:JR NZ,SERup
        DEC HL
        LD A,H:CP #C0
        CALL C,A440U:RET C

        LD A,(HL):CP B:RET Z
        INC HL
        LD A,H:OR A:CALL Z,A440D
        RET
;-------
A440D   LD HL,(A440U+1):JR $+5
A440    LD HL,CUPG:INC (HL)
        LD A,(HL):CALL MNGCVPLX
        LD HL,#C000
        RET

A440U   LD HL,0
        LD A,(HL):SUB 1:RET C;TVBPG=0
        LD (HL),A:CALL MNGCVPLX
        LD HL,#FFFF
        XOR A
        RET
;-------
SER13D  LD C,13
SER     LD A,(HL)
        OR A:RET Z:INC HL
        CP C:RET Z
        JP SER
;---------------------------------------
CHEBUREK LD A,TVBPG
         LD (CUPG),A
         LD (CUPU),A
         LD HL,#C000,(CURU),HL
         RET

REK     LD A,TVBPG
        LD (CUPG),A
        LD (CUPU),A
        LD HL,#C000,(CURU),HL

        CALL TLOAD:LD A,TVBPG,(CUPG),A
        RET
;-------
TLOAD   LD A,(CUPG):CP TVEPG+1:RET NC
        CALL MNGCVPL
        LD HL,#C000,B,32:CALL LOAD512
        CP #0F:RET Z
        LD HL,CUPG:INC (HL)
        JR TLOAD
;---------------------------------------
;---------------------------------------
VBIN    CALL CHEBUREK
        CALL COLORING
        CALL PGPRB

MBI     EI:HALT

        CALL TABK:JP NZ,RERE

        CALL UPPP,NZ,CRBUP:JR NZ,BREFR
        CALL DWWW,NZ,CRBDN:JR NZ,BREFR
        CALL PGU,NZ,CRBPGUP:JR NZ,BREFR
        CALL PGD,NZ,CRBPGDN:JR NZ,BREFR

        CALL SPKE:JP NZ,REEX
        CALL ESC:JR Z,MBI
        JP REEX

BREFR   CALL PGPRB
        JR MBI
;-------
PGPRB   LD HL,(CURU),(CURD),HL
        LD A,(CUPU),(CUPG),A     
        LD BC,(HEI-1)
        LD DE,#0100; Y+X
        LD A,B:DEC B:CP 36:JR NZ,BCD
        LD E,5
BCD     PUSH BC
        PUSH DE        
        PUSH DE:CALL ZBUB
        POP DE:LD HL,HEXLINE,BC,HEXLINEL:CALL PRSRW
        POP DE:INC D
        POP BC:DJNZ BCD
        RET

ZBUB    LD HL,(CURD)
        LD A,(CUPG):CALL MNGCVPLX
        LD A,H:CP #C0:JR NC,BUB
        LD A,(CUPG):INC A
        CP TVEPG+1:JR NC,BuB
        LD (CUPG),A:CALL MNGCVPL
        LD HL,#C000

BUB     PUSH HL
        LD DE,BTEXT,BC,16:LDIR
        POP DE
        LD B,16,HL,BHEX
B_B     PUSH BC
        LD A,(DE):INC DE
        INC HL
        LD C,A
        AND %00001111:CP 10:JR C,$+4:ADD A,7,A,#30
        LD (HL),A:DEC HL
        LD (HL),C
        XOR A
        RLD:CP 10:JR C,$+4:ADD A,7,A,#30
        LD (HL),A
        LD BC,BHEXSTEP:ADD HL,BC
        POP BC
        DJNZ B_B

        PUSH DE
        LD HL,BADDRESS+2,A,(CUPG):SRL A,A:CALL NORK8BIT
        LD A,(CURD+1):SUB #C0:JR NC,$+4:ADD A,#C0:LD C,A
        LD A,(CUPG):AND %11:RRCA:RRCA:ADD A,C:CALL NORK8BIT
        LD A,(CURD):CALL NORK8BIT
        POP HL
        LD (CURD),HL
BuB     RET
;--------
CRBUP    LD HL,(CURU)
         LD BC,16:OR A:SBC HL,BC
         LD A,H:CP #C0:JR NC,CARBON
         LD A,(CUPU):SUB 1;TVBPG=0
         JR C,CRUPDNER
         LD (CUPU),A
         LD HL,0-16
         JR CARBON

CRBDN    LD HL,(CURU)
         LD BC,16:ADD HL,BC
         LD A,H:CP #C0:JR NC,CARBON
         LD A,(CUPU):INC A
         CP TVEPG+1:JR NC,CRUPDNER
         LD (CUPU),A
         LD HL,#C000
CARBON   LD (CURU),HL
         XOR A:INC A
         RET

CRUPDNER XOR A
         RET

COLORING LD BC,(HEI-1)
         LD DE,#0100; Y+X
         LD A,B:DEC B:CP 36:JR NZ,$+4:LD E,5
         PUSH BC:LD HL,#8000,BC,80:CALL PRSRW
         POP BC
COLORI   PUSH BC
         LD B,C
         PUSH HL:LD B,80,A,%00010111:CALL PRIAT
         POP HL:INC H
         POP BC:DJNZ COLORI
         RET
;--------
CRBCALC  LD HL,(HEI),H,0:DEC L
.4       ADD HL,HL
         LD BC,HL
         LD HL,(CURU)
         RET

CRBPGUP  CALL CRBCALC
         OR A:SBC HL,BC
         LD A,H:CP #C0:JR NC,CARBON
         LD A,(CUPU):OR A:JR NZ,CRBPGUPC
         LD HL,#C000
         JR CARBON
CRBPGUPC DEC A:LD (CUPU),A
         LD BC,#4000:ADD HL,BC
         JR CARBON
;--------
CRBPGDN  CALL CRBCALC
         ADD HL,BC:JP NC,CARBON
         LD A,(CUPU):INC A
         CP TVEPG+1:JR NC,CRUPDNER
         LD (CUPU),A
         LD BC,0-#4000:ADD HL,BC
         JP CARBON
;---------------------------------------
ANALYZE  LD A,TVBPG:CALL MNGCVPL
         LD HL,(DADE)
         LD A,L:OR H
         LD BC,(DAHL):JR Z,LYZE
         LD BC,#0FFF
LYZE     LD A,C:OR B:RET Z
         LD A,B:OR A:JR Z,LyZ
.2       SRL B:RR C
LyZ      LD HL,#C000
LYZ      LD A,(HL):INC HL
         CP #0A:JR Z,NXTLYZ
         CP #0D:JR Z,NXTLYZ
         CP #20:JR C,LYZFAIL
NXTLYZ   DEC BC:LD A,C:OR B:JR NZ,LYZ
         XOR A:INC A
         RET
LYZFAIL  XOR A
         RET
;---------------------------------------
NOPING   XOR A:LD (HL),A:INC HL:DJNZ $-2
         RET

MNGCVPLX PUSH HL,DE,BC
         CALL MNGCVPL
         POP BC,DE,HL
         RET
;---------------------------------------
NORK8BIT ;i:HL - Address
;            A - value

         INC HL:LD C,A:AND %00001111:CP 10:JR C,$+4:ADD A,7,A,#30
         LD (HL),A:DEC HL:LD (HL),C
         XOR A:RLD:CP 10:JR C,$+4:ADD A,7,A,#30:LD (HL),A:INC HL,HL
         RET
;---------------------------------------
INT_PL  EXA:LD A,86:JP WLD

MNGC_PL EXA:LD A,0:JP WLD
PRWOW   LD A,1:JP WLD
RRESB   LD A,2:JP WLD
PRSRW   LD A,3:JP WLD
PRIAT   EXA:LD A,4:JP WLD
GADRW   LD A,5:JP WLD
CURSOR  LD A,6:JP WLD
CURSER  LD A,7:JP WLD
YN      EXA:LD A,8:JP WLD
ISTR    EXA:LD A,9:JP WLD
NORK    EXA:LD A,10:JP WLD
TXTPR   LD A,11:JP WLD
SCRLWOW EXA:LD A,84:JP WLD
;-------
SPKE    LD A,16:JP WLD
UPPP    LD A,17:JP WLD
DWWW    LD A,18:JP WLD
LFFF    LD A,19:JP WLD
RGGG    LD A,20:JP WLD
TABK    LD A,21:JP WLD
ENKE    LD A,22:JP WLD
ESC     LD A,23:JP WLD
BSPC    LD A,24:JP WLD
PGU     LD A,25:JP WLD
PGD     LD A,26:JP WLD
HOME    LD A,27:JP WLD
END     LD A,28:JP WLD
F1      LD A,29:JP WLD
KBSCN   EXA:LD A,42:JP WLD
USPO    LD A,46:JP WLD
NUSP    LD A,47:JP WLD
;-------
LOAD512 LD A,48:JP WLD
SAVE512 LD A,49:JP WLD
STREAM  LD A,57:JP WLD
FENTRY  LD A,59:JP WLD
GFILE   LD A,62:JP WLD
MKFILE  LD A,72:JP WLD
;-------
MNGCVPL EXA:LD A,65:JP WLD
GVmod   EXA:LD A,66:JP WLD
;---------------------------------------
DAHL    DW 0
DADE    DW 0

BUX     DS 2; File name

;-------TXTvw:
CUPU    NOP
CUPG    NOP

CURU    DW 0
CURD    DW 0

EDFL    NOP
;-------
THL     DW 0

DIRDIR    DB #10,".",0
;---------------------------------------
TVWND     DB 3,0
          DB 0,0;      X,Y
          DB 0,0;      W,H (MAX)
          DB %00000000;color
          DB 0
          DW #0000
          DB 0,0

HEXLINE   DB #BA," #"
BADDRESS  DB "00000000 ",#B3
BTEXT     DB "                ",#B3
BHEX      EQU $+1
BHEXSTEP  EQU 3
          DB " 00 00 00 00 00 00 00 00 00 00 00 00 00 00 00 00 ",#BA
HEXLINEL  EQU $-HEXLINE
;---------------------------------------
ENDPL
