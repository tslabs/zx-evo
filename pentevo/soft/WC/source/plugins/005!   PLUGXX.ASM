;Video Player v0.4
;(C) BUDDER/MGN/2012
;---------------------------------------
        ORG #6000
;-------
WLD     EQU #6006
TMN     EQU #6009;Timer

Vfm     EQU #15AF
;---------------------------------------
;HEADER:
        DS 16
        DB "WildCommanderMDL";    Header
        DB #02;                  Version
        DB 0;                       Type
        DB 1; Pages
        DB 0; Page to #8000
;-------
        DB 0,8; CODE

.5      DB 0,0
;-------
        DS 16
;-------
        DB "TGV"
        DS 31*3
;-------
        DB 0
;-------
        DW #FFFF,#FFFF; MAX SIZE
;-------
        DB "Video Player v0."
        DB "4               "
;-------
        DB 0
;---------------------------------------
        ORG #8000,#6200
;-------
LOBU    EQU #B000
;---------------------------------------
PLUGIN  LD (DAHL),HL,(DADE),DE

        CALL GEDPL
        XOR A:LD (ESTAT),A

        LD IX,PLWND:CALL PRWOW

_LD HL,TXT0,DE,#000B,BC,12:CALL PRSRW
_LD A,%11110111:CALL PRIAT
_LD HL,TXT00,DE,#010A,BC,14:CALL PRSRW
_LD A,%01110000:CALL PRIAT

        CALL CLEAR
        CALL HEADER
;-------
MAIN    CALL SHOW:JR Z,NXFL
        CALL SHOW2:JR Z,NXFL
        CALL ESC:JR Z,MAIN

EXIT    CALL GEDPL

        LD IX,PLWND:CALL RRESB
        LD A,(ESTAT)
        RET
;-------
NXFL    LD A,2,(ESTAT),A:JR EXIT
;---------------------------------------
HEADER  LD HL,LOBU,B,1:CALL LOAD512

        LD HL,(LOBU+32)
        SRL H:RR L
        LD (LNZ),HL
        RET
;---------------------------------------
SHOW    XOR A:LD (PGNA),A
        LD HL,(LNZ),(LINES),HL
        LD HL,0,(TMN),HL

        LD HL,#0200,B,1:CALL LOAD512

NAG     LD A,(PGNA):CALL MNGCVPL

        LD HL,#C000
GABU    LD B,1:CALL LOAD256:CP #0F:RET Z

        EXX
        LD HL,(LINES):DEC HL
        LD A,H:OR L:JR Z,EOF
        LD (LINES),HL
        EXX

        LD A,H:OR A:JP NZ,GABU

        LD HL,PGNA:INC (HL)
        LD HL,#C000
        JP NAG
;-------
EOF     LD A,(TMN):SUB 3:CALL C,HALD

        LD A,%00000010:CALL GVmod
        LD A,1:CALL MNGV_PL
        EI:HALT
        LD BC,Vfm,A,%00010000:OUT A
        LD HL,#0200,DE,#0000
.128    LDI:LDI:LDI:LDI
        LD BC,Vfm:XOR A:OUT A
        INC A
        RET
;---------------------------------------
SHOW2   LD A,16,(PGNA),A
        LD HL,(LNZ),(LINES),HL
        LD HL,0,(TMN),HL

        LD HL,#0200,B,1:CALL LOAD512

NAG2    LD A,(PGNA):CALL MNGCVPL

        LD HL,#C000
GABU2   LD B,1:CALL LOAD256:CP #0F:RET Z

        EXX
        LD HL,(LINES):DEC HL
        LD A,H:OR L:JR Z,EOF2
        LD (LINES),HL
        EXX

        LD A,H:OR A:JP NZ,GABU2

        LD HL,PGNA:INC (HL)
        LD HL,#C000
        JP NAG2
;-------
EOF2    LD A,(TMN):SUB 3:CALL C,HALD

        LD A,%00000010:CALL GVmod
        LD A,2:CALL MNGV_PL
        EI:HALT
        LD BC,Vfm,A,%00010000:OUT A
        LD HL,#0200,DE,#0000
.128    LDI:LDI:LDI:LDI
        LD BC,Vfm:XOR A:OUT A
        INC A
        RET
;---------------------------------------
HALD    ADD A,3
        EI:HALT:DEC A:JR NZ,$-2
        RET
;---------------------------------------
CLEAR   DI
        LD (SPBU),SP
        XOR A:LD (PGNA),A

YUHU    LD A,(PGNA):CALL MNGCVPL

        LD HL,0
        LD SP,0

        LD B,128
.64     PUSH HL
        DJNZ $-64

        LD HL,PGNA:INC (HL)
        LD A,(HL):CP 28:JR C,YUHU

        LD SP,(SPBU)
        EI
        RET
;---------------------------------------
PRWOW   LD A,1:JP WLD
RRESB   LD A,2:JP WLD
PRSRW   LD A,3:JP WLD
PRIAT   EXA:LD A,4:JP WLD

GEDPL   LD A,15:JP WLD
;-------
ESC     LD A,23:JP WLD
;-------
LOAD512 LD A,48:JP WLD
LOAD256 LD A,60:JP WLD
;-------
MNGV_PL EXA:LD A,64:JP WLD
MNGCVPL EXA:LD A,65:JP WLD
GVmod   EXA:LD A,66:JP WLD
;---------------------------------------
PLWND   DB 0,0
        DB 23,13;    X,Y
        DB 32+2,2+2; W,H
        DB %01111111;PAPER+INK
        DB 0
        DW #0000;    BUFFER
        DB 0,0;      LINES
;-------
TXT0    DB "Video Player"
TXT00   DB "Please Wait..."
;---------------------------------------
SPBU    DS 2
LINES   DS 2
LNZ     DS 2

DAHL    DS 2
DADE    DS 2

PGNA    NOP

ESTAT   NOP
;---------------------------------------
