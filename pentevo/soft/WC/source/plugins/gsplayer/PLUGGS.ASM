;GS Player v0.94
;(C) KOSHI/MGN/2024
;---------------------------------------
        SAVEBIN "gsplayer.wmf"
;---------------------------------------
INTpSEC  EQU 49

MODPLAY  EQU #31
MODSTOP  EQU #32
MODCONT  EQU #33
VOLUME   EQU #35
MODPOZ   EQU #60
PATPOZ   EQU #61

GS_SOFTRESET    EQU #F3
GS_GETRAMINFO   EQU #23

GS_LOAD_MODULE  EQU #30;__
GS_OPEN_STREAM  EQU #D1; /
GS_CLOSE_STREAM EQU #D2;/

VSINTL  EQU #23AF;VintPOSlow
CYC     EQU #2BAF;Cache
CACHE   EQU %0000 0100;#8000-#BFFF Only
;---------------------------------------
        ORG #6000
;-------
        INCL "prtgs.asm"
;-------
ABT     EQU #6004
ENT     EQU #6005
WLD     EQU #6006
;---------------------------------------
;HEADER:
        DS 16
        DB "WildCommanderMDL";    Header
        DB #0F;                  Version
        DB 0;                       Type
        DB 1; Pages
        DB 0; Page to #8000
;-------
        DB 0,16; CODE

.5      DB 0,0
;-------
        DS 16
;-------
        DB "MOD"
        DB "WAV"
        DB "MP3"
        DB "MID"
        DS 28*3
;-------
        DB 0
;-------
        DW #FFFF,#FFFF; MAX SIZE
;-------
        DB "GS Player v0.94 "
        DB "                "
;-------
        DB 0
;---------------------------------------
        ORG #8000,#6200
;-------
PG0     EQU 0;start page
PGS     EQU 5;pages total
TIMEOUT EQU INTpSEC*4

LOBU3   EQU #B000
LOBU2   EQU #1000
LOBU    EQU #C000
;---------------------------------------
PLUGIN  LD (DAHL),HL,(DADE),DE
        LD (FILENAME),BC
        EXA:LD (EXTnow+1),A

        LD L,H,H,E
.3      SRL D:RR H,L
        INC L:JR NZ,$+3:INC H
        LD (BLKZ),HL

        XOR A
        LD (ESTAT),A
        LD (ANFNT+1),A
        INC A
        LD (MODSTATE),A

        LD A,(EXTnow+1):CP 3:JP Z,MIDIMUZ

        CALL DEVCHE:RET Z

        LD A,(GSENA):CP #FF:CALL Z,GSFET
        LD A,(GSENA):OR A:JP NZ,NOGS

        CALL GLOBAL_INITS
EXTnow  LD A,0
        OR A:JR Z,MODMUZ
        DEC A:JP Z,WAVMUZ
        DEC A:JP Z,MP3MUZ
        JP MIDIMUZ

GLOBAL_INITS
        LD HL,#FFFF,(TMM),HL
        LD HL,TMMI,A,#FF:CALL INT_PL

        LD A,#DF
        LD (SPR+MAINWW+8),A
        LD (SPR+MAINWW+18),A
        LD (SPR+MAINWW*2+8),A
        LD (SPR+MAINWW*2+18),A

        CALL GEDPL
        CALL TENTRY
        JP ANFNT
;-------
MODMUZ  LD BC,CYC,A,CACHE:OUT A;Change cache page

        LD IX,MNWND:CALL PRWOW
        LD A,(IX+3):ADD A,(IX+5):SUB MAINAH+1:LD (MODWND+3),A

        CALL GOGS
        CALL PBCLC

        XOR A
        LD (POZA),A
        LD (POZP),A
        LD (POZoPAT),A
        LD (CMDWAIT),A
        LD HL,#FFFF,(TMM),HL:INC HL:LD (TMMOUT),HL

        PUSH IX
        LD IX,MODWND:CALL PRWOW
        LD HL,MODUND,DE,MODH*256+1,BC,MODW-2:CALL PRSRW
        LD A,%00001111:CALL PRIAT
        POP IX

MAIN    EI:HALT:CALL GWC,NC,PTCC:JR NC,NEXTnMUTE

        CALL SPKE:JR NZ,GAFF
        CALL ESC:JR NZ,MGAFF
        CALL ENKE:JR NZ,NEXTnMUTE

        LD A,(CMDWAIT):OR A:JR NZ,NYA
        LD A,1:CALL KBSCN:CP "m":CALL Z,PLAYMUTE

NYA     CALL GWC,NC,PTC:JR NC,NEXTnMUTE
        CALL PRINT_PATTERN_WIND
        JR MAIN

NEXTnMUTE CALL MUTEGS
NEXT    LD A,2,(ESTAT),A
GAFF    PUSH IX:LD A,(EXTnow+1),IX,MODWND:OR A:CALL Z,RRESB
        POP IX:CALL RRESB
        CALL DEFNT
GAF     LD A,(ESTAT)
        RET
;-------
MGAFF   CALL MUTEGS:JR GAFF
;-------
NOGS    LD A,1,(ESTAT),A:JR GAF
;---------------------------------------
TMMI     LD HL,(MIDItimer),DE,(TICKPI):ADD HL,DE:LD (MIDItimer),HL:JR NC,MMNN
         LD HL,(MIDItimer+2):INC HL:LD (MIDItimer+2),HL

MMNN     LD HL,(TMM):INC HL:LD A,L:OR H:RET Z
         LD A,(MODSTATE):OR A:RET Z
         LD (TMM),HL

         LD HL,(TMMOUT):INC HL
         LD (TMMOUT),HL
         RET
;---------------------------------------
PTCC    LD A,(MODSTATE):OR A:JR Z,POF
        CALL CLOCK,PBPRINT
PTC     LD A,(MODSTATE):OR A:JR Z,POF
        CALL PBLNE,PATTERN
        LD HL,TIMEOUT,DE,(TMMOUT):SBC HL,DE:JR C,NNC

        LD A,(CMDWAIT):XOR 1:LD (CMDWAIT),A:JR Z,POZREAD
        LD A,PATPOZ:CALL SNDCOM
        JR POF
POZREAD CALL GTDAT
        LD HL,POZP,DE,0
        CP (HL):JR Z,POZR:LD (TMMOUT),DE
POZR    LD (HL),A:OR A:JR NZ,PROF
        LD A,(POZoPAT):OR A:JR Z,POF
        LD HL,POZA:INC (HL)
        LD A,(POZS):CP (HL):JR C,NNC,Z,NNC
        XOR A
        JR PROF+2
PROF    LD A,1,(POZoPAT),A
POF     SCF
        RET
NNC     XOR A
        RET
;---------------------------------------
PLAYMUTE LD A,(MODSTATE):XOR 1:LD (MODSTATE),A:JR Z,MODPAUSE
         LD A,MODCONT:CALL SNDCOM
         XOR A
         RET
MODPAUSE LD A,MODSTOP:CALL SNDCOM
         XOR A
         RET
;---------------------------------------
PATTERN PUSH HL,DE,BC
        LD HL,PATTERNN,A,(PAT1):CALL NORK8BIT
        LD HL,POSITIONN,A,(POZA):INC A:CALL NORK8BIT
        LD HL,SONGLENGTHN,A,(POZS):CALL NORK8BIT
        LD HL,PATTERN_NUMBER,DE,#0501:CALL TXTPR
        POP BC,DE,HL
        RET

MOD_SONG_LENGTH    EQU LOBU+950
MOD_SONG_POSITIONS EQU LOBU+952;0-127 positions: 0-63 patterns (128 bytes)
MOD_PATTERNS       EQU LOBU+1084;(1024 bytes/pattern)
;------------------
PATTERN_TO_START   ;i:  A - Song Position
;                   o: HL - Pattern Address (#C000-#FFFF)
;                       A - Pattern Page (at #C000)

                   LD HL,MOD_PATTERNS:OR A:RET Z
.2                 ADD A,A
                   LD B,#40
                   SUB B:LD C,0:JR C,PTS
                   SUB B:LD C,1:JR C,PTS
                   SUB B:LD C,2:JR C,PTS
                   SUB B
                   LD C,3
PTS                ADD A,B:LD B,A,A,C
                   LD C,0:ADD HL,BC
                   RET
;------------------
PRINT_PATTERN_WIND PUSH IX
                   LD A,PG0:CALL MNGCVPL
                   LD IX,MODWND
                   LD A,(POZA),BC,MOD_SONG_POSITIONS,H,0,L,A:ADD HL,BC
                   LD A,(HL):INC HL
                   LD (PAT1),A
         EXA:LD A,(HL):CALL PATTERN_TO_START:LD (PATTERN_NOW2),HL,(PATTERN_NOW2_PG),A
         EXA:CALL PATTERN_TO_START:LD (PATTERN_NOW),HL,(PATTERN_NOW_PG),A,(PGC),A

                   LD A,(POZP),(POZP2),A:OR A:JR Z,PPW
                   LD BC,HL
                   LD H,0,L,A
.4                 ADD HL,HL
                   ADD HL,BC
PPW                LD DE,#0101
                   LD B,7
PWIND              PUSH BC
                   CALL PATTERN_POSITION_UPDATE
                   CALL PRINT_PATTERN_LINE
                   POP BC:DJNZ PWIND
                   POP IX
                   RET

PRINT_PATTERN_LINE ;i:HL - data
;                     DE - YX
;                   o:HL - next
;                     DE - next

                   PUSH DE
                   CALL READ_CHANNEL;CHA
                   PUSH HL:LD HL,CHA_SAMPLE:CALL DECODE_SAMPLEFFECT
                   POP HL
                   CALL READ_CHANNEL;CHB
                   PUSH HL:LD HL,CHB_SAMPLE:CALL DECODE_SAMPLEFFECT
                   POP HL
                   CALL READ_CHANNEL;CHC
                   PUSH HL:LD HL,CHC_SAMPLE:CALL DECODE_SAMPLEFFECT
                   POP HL
                   CALL READ_CHANNEL;CHD
                   PUSH HL:LD HL,CHD_SAMPLE:CALL DECODE_SAMPLEFFECT
                   POP HL
                   POP DE
                   PUSH HL:LD HL,PATTERNLINEPATTERN:CALL TXTPR
                   POP HL
                   RET
;------------------
READ_CHANNEL       ;i:HL - data in pattern
;                   o:HL - next poz
;                     DE - Effect command 12 bits
;                     BC - Note 12 bits period
;                      A - Sample number

                   LD A,(HL):AND #F0:LD (PATTERN_SAMPLE),A
                   LD A,(HL):INC HL:AND #0F:LD B,A;Note upper 4 bits
                   LD C,(HL):INC HL;Note lower 8 bits
                   LD A,(HL):SRL A,A,A,A:OR 0;Sample number
PATTERN_SAMPLE     EQU $-1
                   PUSH AF
                   LD A,(HL):INC HL:AND #0F:LD D,A;Effect command upper 4 bits
                   LD E,(HL):INC HL;Effect command lower 8 bits
                   POP AF
                   RET
;------------------
NOTE_FND           DEC HL
                   EX DE,HL:LD BC,0-PERIOD_TABLE_FT_LN:ADD HL,BC
                   EX DE,HL:OR A:SBC HL,DE:ADD HL,HL
                   LD BC,NOTES:ADD HL,BC
                   LD DE,(NOTESTO+1)
                   JP NOTE_NOTE

DECODE_SAMPLEFFECT ;i: HL - Offset in TXT Buffer
;                      DE - Effect command 12 bits
;                      BC - Note 12 bits
;                       A - Sample number
;                   o: HL - New value

                   PUSH AF,DE
                   EX DE,HL:LD A,B:OR C:JR Z,NONOTE
                   LD (NOTESTO+1),DE
                   LD HL,PERIOD_TABLE
NEXT_FINETUNE      EX DE,HL:LD HL,PERIOD_TABLE_FT_LN:ADD HL,DE
                   EX DE,HL
NEXT_NOT2          LD A,C:CP (HL):INC HL:JR NZ,NEXT_NOTE
                   LD A,B:CP (HL):JR Z,NOTE_FND
NEXT_NOTE          INC HL
                   LD A,H:CP D:JR C,NEXT_NOT2
                   LD A,L:CP E:JR C,NEXT_NOT2
               ;LD A,H:CP PERIOD_TABLE_END[:JR C,NEXT_FINETUNE
               ;LD A,L:CP PERIOD_TABLE_END]:JR C,NEXT_FINETUNE
                   LD HL,NOTE_MISS
                   LD A,B:CALL NORK4BIT
                   LD A,C:CALL NORK8BIT
                   LD HL,NOTE_MISS,DE,(NOTESTO+1):JR NOTE_NOTE
NOTESTO            LD DE,0
NONOTE             LD HL,NOTE_ZERO
NOTE_NOTE          LD BC,3:LDIR
                   EX DE,HL
SAMPLEFFECT        POP DE,AF
.3                 INC HL

                   CALL NORK8BIT:INC HL
.2                 INC HL
                   LD A,D:CALL NORK4BIT
                   LD A,E:CALL NORK8BIT
                   RET

NORK8BIT           ;i:HL - Address
;                      A - value

                   INC HL:LD C,A:AND %00001111:CP 10:JR C,$+4:ADD A,7,A,#30
                   LD (HL),A:DEC HL:LD (HL),C
                   XOR A:RLD:CP 10:JR C,$+4:ADD A,7,A,#30:LD (HL),A:INC HL,HL
                   RET

NORK4BIT           ;i:HL - Address
;                      A - value

                   AND %00001111:CP 10:JR C,$+4:ADD A,7,A,#30
                   LD (HL),A:INC HL
                   RET
;------------------
PATTERN_POSITION_UPDATE PUSH HL
                        LD HL,POZP2,A,(HL):CP #40:JR C,PPU
                        POP BC:LD BC,(PATTERN_NOW2)
                        PUSH BC
                        LD A,(PATTERN_NOW2_PG),(PGC),A
                        XOR A:LD (HL),A
PPU                     INC (HL)
                        LD HL,PATTERN_POZ:CALL NORK8BIT
                        LD A,(PGC):CALL PATTERN_PAGES
                        POP HL
                        RET
;------------------
PATTERN_PAGES      ;i: A - Page

                   PUSH DE
                   PUSH AF:CALL MNGCVPL
                   POP AF:INC A
                   CALL MNG0VPL
                   POP DE
                   RET
;------------------
PATTERNLINEPATTERN DB 7,7
PATTERN_POZ        DB "00",7,7,#DD
                   DB 1
CHA_SAMPLE         DB "--- ",6,6
                   DB "00 ",4,4,"000",7,7,#DD
                   DB 1
CHB_SAMPLE         DB "--- ",6,6
                   DB "00 ",4,4,"000",7,7,#DD
                   DB 1
CHC_SAMPLE         DB "--- ",6,6
                   DB "00 ",4,4,"000",7,7,#DD
                   DB 1
CHD_SAMPLE         DB "--- ",6,6
                   DB "00 ",4,4,"000",0

PATTERN_NUMBER     DB #E,"Pattern:",6,6,"#"
PATTERNN           DB "00  "
                   DB 7,7,"Position:",6,6,"#"
POSITIONN          DB "00  ",7,7,"Length:",6,6,"#"
SONGLENGTHN        DB "00",#D
                   DB 0
;------------------
NOTES
 DB "C-0 ","C#0 ","D-0 ","D#0 ","E-0 ","F-0 ","F#0 ","G-0 ","G#0 ","A-0 ","A#0 ","B-0 "
 DB "C-1 ","C#1 ","D-1 ","D#1 ","E-1 ","F-1 ","F#1 ","G-1 ","G#1 ","A-1 ","A#1 ","B-1 "
 DB "C-2 ","C#2 ","D-2 ","D#2 ","E-2 ","F-2 ","F#2 ","G-2 ","G#2 ","A-2 ","A#2 ","B-2 "
 DB "C-3 ","C#3 ","D-3 ","D#3 ","E-3 ","F-3 ","F#3 ","G-3 ","G#3 ","A-3 ","A#3 ","B-3 "
 DB "C-4 ","C#4 ","D-4 ","D#4 ","E-4 ","F-4 ","F#4 ","G-4 ","G#4 ","A-4 ","A#4 ","B-4 "
NOTE_ZERO          DB "---"
NOTE_MISS          DB "***"
PERIOD_TABLE       DW 1712,1616,1524,1440,1356,1280,1208,1140,1076,1016,960,906
                   DW 856,808,762,720,678,640,604,570,538,508,480,453
                   DW 428,404,381,360,339,320,302,285,269,254,240,226
                   DW 214,202,190,180,170,160,151,143,135,127,120,113
                   DW 107,101,95,90,85,80,75,71,67,63,60,56
PERIOD_TABLE_FT0E
;FTp01 DW 1700,1604,1514,1430,1348,1274,1202,1134,1070,1010,954,900
;      DW 850,802,757,715,674,637,601,567,535,505,477,450
;      DW 425,401,379,357,337,318,300,284,268,253,239,225
;      DW 213,201,189,179,169,159,150,142,134,126,119,113
;      DW 106,100,94,89,84,79,75,71,67,63,59,56
;FTp02 DW 1688,1592,1504,1418,1340,1264,1194,1126,1064,1004,948,894
;      DW 844,796,752,709,670,632,597,563,532,502,474,447
;      DW 422,398,376,355,335,316,298,282,266,251,237,224
;      DW 211,199,188,177,167,158,149,141,133,125,118,112
;      DW 105,99,94,88,83,79,74,70,66,62,59,56
;FTp03 DW 1676,1582,1492,1408,1330,1256,1184,1118,1056,996,940,888
;      DW 838,791,746,704,665,628,592,559,528,498,470,444
;      DW 419,395,373,352,332,314,296,280,264,249,235,222
;      DW 209,198,187,176,166,157,148,140,132,125,118,111
;      DW 104,99,93,88,83,78,74,70,66,62,59,55
;FTp04 DW 1664,1570,1482,1398,1320,1246,1176,1110,1048,990,934,882
;      DW 832,785,741,699,660,623,588,555,524,495,467,441
;      DW 416,392,370,350,330,312,294,278,262,247,233,220
;      DW 208,196,185,175,165,156,147,139,131,124,117,110
;      DW 104,98,92,87,82,78,73,69,65,62,58,55
;FTp05 DW 1652,1558,1472,1388,1310,1238,1168,1102,1040,982,926,874
;      DW 826,779,736,694,655,619,584,551,520,491,463,437
;      DW 413,390,368,347,328,309,292,276,260,245,232,219
;      DW 206,195,184,174,164,155,146,138,130,123,116,109
;      DW 103,97,92,87,82,77,73,69,65,61,58,54
;FTp06 DW 1640,1548,1460,1378,1302,1228,1160,1094,1032,974,920,868
;      DW 820,774,730,689,651,614,580,547,516,487,460,434
;      DW 410,387,365,345,325,307,290,274,258,244,230,217
;      DW 205,193,183,172,163,154,145,137,129,122,115,109
;      DW 102,96,91,86,81,77,72,68,64,61,57,54
;FTp07 DW 1628,1536,1450,1368,1292,1220,1150,1086,1026,968,914,862
;      DW 814,768,725,684,646,610,575,543,513,484,457,431
;      DW 407,384,363,342,323,305,288,272,256,242,228,216
;      DW 204,192,181,171,161,152,144,136,128,121,114,108
;      DW 102,96,90,85,80,76,72,68,64,60,57,54
;FTm08 DW 1814,1712,1616,1524,1440,1356,1280,1208,1140,1076,1016,960
;      DW 907,856,808,762,720,678,640,604 ,570,538,508,480
;      DW 453,428,404,381,360,339,320,302,285,269,254,240
;      DW 226,214,202,190,180,170,160,151,143,135,127,120
;      DW 113,107,101,95,90,85,80,75,71,67,63,60
;FTm07 DW 1800,1700,1604,1514,1430,1350,1272,1202,1134,1070,1010,954
;      DW 900,850,802,757,715,675,636,601,567,535,505,477
;      DW 450,425,401,379,357,337,318,300,284,268,253,238
;      DW 225,212,200,189,179,169,159,150,142,134,126,119
;      DW 112,106,100,94,89,84,79,75,71,67,63,59
;FTm06 DW 1788,1688,1592,1504,1418,1340,1264,1194,1126,1064,1004,948
;      DW 894,844,796,752,709,670,632,597,563,532,502,474
;      DW 447,422,398,376,355,335,316,298,282,266,251,237
;      DW 223,211,199,188,177,167,158,149,141,133,125,118
;      DW 111,105,99,94,88,83,79,74,70,66,62,59
;FTm05 DW 1774,1676,1582,1492,1408,1330,1256,1184,1118,1056,996,940
;      DW 887,838,791,746,704,665,628,592,559,528,498,470
;      DW 444,419,395,373,352,332,314,296,280,264,249,235
;      DW 222,209,198,187,176,166,157,148,140,132,125,118
;      DW 111,104,99,93,88,83,78,74,70,66,62,59
;FTm04 DW 1762,1664,1570,1482,1398,1320,1246,1176,1110,1048,988,934
;      DW 881,832,785,741,699,660,623,588,555,524,494,467
;      DW 441,416,392,370,350,330,312,294,278,262,247,233
;      DW 220,208,196,185,175,165,156,147,139,131,123,117
;      DW 110,104,98,92,87,82,78,73,69,65,61,58
;FTm03 DW 1750,1652,1558,1472,1388,1310,1238,1168,1102,1040,982,926
;      DW 875,826,779,736,694,655,619,584,551,520,491,463
;      DW 437,413,390,368,347,328,309,292,276,260,245,232
;      DW 219,206,195,184,174,164,155,146,138,130,123,116
;      DW 109,103,97,92,87,82,77,73,69,65,61,58
;FTm02 DW 1736,1640,1548,1460,1378,1302,1228,1160,1094,1032,974,920
;      DW 868,820,774,730,689,651,614,580,547,516,487,460
;      DW 434,410,387,365,345,325,307,290,274,258,244,230
;      DW 217,205,193,183,172,163,154,145,137,129,122,115
;      DW 108,102,96,91,86,81,77,72,68,64,61,57
;FTm01 DW 1724,1628,1536,1450,1368,1292,1220,1150,1086,1026,968,914
;      DW 862,814,768,725,684,646,610,575,543,513,484,457
;      DW 431,407,384,363,342,323,305,288,272,256,242,228
;      DW 216,203,192,181,171,161,152,144,136,128,121,114
;      DW 108,101,96,90,85,80,76,72,68,64,60,57
PERIOD_TABLE_END
PERIOD_TABLE_FT_LN EQU PERIOD_TABLE_FT0E-PERIOD_TABLE
;------------------
PGC                NOP
PATTERN_NOW_PG     NOP
PATTERN_NOW2_PG    NOP

PATTERN_NOW        DW 0
PATTERN_NOW2       DW 0
;---------------------------------------
GOGS    CALL PBSHW
LSL     EQU 28
_LD HL,LOADING_SPRITE,DE,#0101+(MAINWW-LSL)/2,BC,LSL:CALL PRSRW;Loading...
_LD A,%01111110:CALL PRIAT
_LD HL,LOADING_SPRITE+LSL,DE,#0201+(MAINWW-LSL)/2,BC,LSL:CALL PRSRW
_LD A,%01111110:CALL PRIAT
_LD HL,LOADING_SPRITE+LSL*2,DE,#0301+(MAINWW-LSL)/2,BC,LSL:CALL PRSRW
_LD A,%01111110:CALL PRIAT

_LD HL,LOADING_SPRITE,DE,#0F01+(MAINWW-LSL)/2,BC,LSL:CALL PRSRW;Loading...
_LD A,%01111110:CALL PRIAT
_LD HL,LOADING_SPRITE+LSL,DE,#1001+(MAINWW-LSL)/2,BC,LSL:CALL PRSRW
_LD A,%01111110:CALL PRIAT
_LD HL,LOADING_SPRITE+LSL*2,DE,#1101+(MAINWW-LSL)/2,BC,LSL:CALL PRSRW
_LD A,%01111110:CALL PRIAT

        XOR A:CALL SENDCOM;RESET FLAGS (DATAandCOMMAND)
        LD A,GS_SOFTRESET:CALL SENDCOM;REini
        LD A,GS_GETRAMINFO:CALL SENDCOM,GETDAT

        EXA
        LD A,GS_LOAD_MODULE:CALL SENDCOM;sndMOD
        LD A,GS_OPEN_STREAM:CALL SENDCOM;opnSTRM
        EXA

        LD DE,6,H,D,L,A
.4      ADD HL,HL
        ADD HL,DE

        LD A,(BLKZ+1):CP H
        JR NZ,ZEM
        LD B,A:LD A,(BLKZ):CP L:LD A,B
        JR Z,NOI
ZEM     JP NC,BRKA
NOI     OR A:JR Z,NA

NOIR    PUSH AF
        LD B,0:CALL GSLOAD
        POP AF
        DEC A:JR NZ,NOIR

NA      LD A,(BLKZ),B,A
        CALL GSLOAD

        LD A,GS_CLOSE_STREAM:CALL SENDCOM
        IN A,(#B3):OUT (#B3),A;MODULE NUMBER
        LD A,MODPLAY:CALL SNDCOM
;-------
        CALL GIPAGPL;poz file at start

              LD C,PG0
LOAD_PATTERNS PUSH BC:LD A,C:CALL MNGCVPL:LD HL,LOBU,B,32:CALL LOAD512
              POP BC:CP #0F:JR Z,LPE:INC C:LD A,C:CP PG0+PGS:JR C,LOAD_PATTERNS
LPE           LD A,PG0:CALL MNGCVPL

          LD A,(MOD_SONG_LENGTH),(POZS),A

          LD HL,LOBU,DE,TXT2,B,CONTLNG
          CALL FLLNAME

          LD HL,TXT2,DE,#0C01+TITLELNG,BC,20:CALL PRSRW
          ;LD A,%01111110:CALL PRIAT

          LD HL,MODE1,DE,EDITOR0
FILE_INFO PUSH DE,HL
          LD HL,(FILENAME),DE,TXT2,B,CONTLNG:CALL FLLNAME

          LD HL,TXT2,DE,#0B01+TITLELNG,BC,CONTLNG:CALL PRSRW
          ;LD A,%01111110:CALL PRIAT
          POP HL:LD DE,#0901+TITLElng:CALL TXTPR
          POP HL:LD DE,#0801+TITLElng:CALL TXTPR
          RET

FLLNAME LD A,(HL):OR A:JR NZ,$+5:LD A," ":DEC HL
        INC HL:LD (DE),A:INC DE
        DJNZ FLLNAME
        RET

BRKA    LD A,#D2:CALL SENDCOM
        RET
;---------------------------------------
GSLOAD  PUSH BC

        CALL PBPR
        LD HL,LOBU2,B,4:CALL LOAD512

        LD HL,LOBU2
        LD BC,#00B3,E,B
TE0     IN A,(#BB):RLCA:JR C,TE0:OUTI
TE1     IN A,(#BB):RLCA:JR C,TE1:OUTI
TE2     IN A,(#BB):RLCA:JR C,TE2:OUTI
TE3     IN A,(#BB):RLCA:JR C,TE3:OUTI
TE4     IN A,(#BB):RLCA:JR C,TE4:OUTI
TE5     IN A,(#BB):RLCA:JR C,TE5:OUTI
TE6     IN A,(#BB):RLCA:JR C,TE6:OUTI
TE7     IN A,(#BB):RLCA:JR C,TE7:OUTI
        DEC E:JP NZ,TE0

        POP BC:DJNZ GSLOAD
        RET
;-------
SNDCOM  OUT (#BB),A:RET
SENDCOM OUT (#BB),A
GSWC    IN A,(#BB)
        RRCA
        JR C,GSWC
        RET
GWC     IN A,(#BB):RRCA:RET
;-------
SENDDAT OUT (#B3),A
GSWD    IN A,(#BB):RLCA:JR C,GSWD:RET
;-------
GETDAT  IN A,(#BB):RLCA:JR NC,GETDAT
GTDAT   IN A,(#B3)
        RET
GWD     IN A,(#BB):RLCA:RET
;---------------------------------------
GSFET   LD A,#80:OUT (#33);NGS Hard Reset

        IN A,(#B3)
        LD B,0,C,A
STAB    IN A,(#B3):CP C:JR NZ,WSE:DJNZ STAB

STA     LD A,#23:CALL SNDCOM,COMWAIT:JR Z,WSE
        IN A,(#B3):CP 3:JR C,WSE

WNE     LD A,1:OUT (#B3),A:LD A,#6A:CALL SENDCOM
        XOR A:OUT (#B3),A:LD A,#6B:CALL SENDCOM
        XOR A
;-------
WZE     LD (GSENA),A
        PUSH AF:LD A,#F3:CALL SNDCOM
        POP AF
        RET
WSE     LD A,1:OR A:JR WZE

COMWAIT  PUSH IX
         LD IX,WAITWND:CALL PRWOW
         LD BC,49*8
DIK      EI:HALT:DEC BC:LD A,B:OR C:JR Z,TIME_OUT
         LD HL,BC,DE,49
         XOR A
         LD A,"0"
SUB      SBC HL,DE:INC A:JR NC,SUB
         DEC A:LD (WAITSEC),A
         PUSH HL,DE,BC:LD HL,WAITING_GS,DE,#0101:CALL TXTPR
         POP BC,DE,HL
         IN A,(#BB):RRCA:JR C,DIK
         INC B
TIME_OUT PUSH AF:CALL RRESB
         POP AF
         POP IX
         RET
;-------
MUTEGS  LD A,#F3:JP SNDCOM
;---------------------------------------
;---------------------------------------
MIDIminPG     EQU 0; - 1 MB Buffer
MIDImaxPG     EQU 63;/
MIDImaxTRAX   EQU 64

DEFAULT_TEMPo EQU #0007
DEFAULT_TEMPO EQU #A120
;---------
MIDIMUZ   CALL GLOBAL_INITS

          LD IX,MN2WND:CALL PRWOW
          LD HL,MODE4,DE,EDITOR0:CALL FILE_INFO,AYchipPR

          CALL MIDI_LOAD:CP #FF:JP Z,GAFF
          LD HL,0,(MIDIfileLN),HL,(MIDIfileLN+2),HL
          PUSH IX:CALL HEADSKIP
          POP IX:OR A:JP NZ,GAFF

          LD HL,MIDIfileLN+2,B,0-1
PBPREP    INC B:LD A,(HL):OR A:JR Z,PBprep:SRL (HL):DEC HL:RR (HL):INC HL:JR PBPREP
PBprep    DEC HL:LD A,B,(PBcn+1),A
          LD A,(HL),(POZS),A:CALL PBCLC,PBPRINT

          CALL MIDI_INIT

          XOR A:LD (MIDIfnFLG),A,(POZA),A
          INC A:LD (MIDItsNOW),A
          LD HL,0,(MIDItimer),HL,(MIDItimer+2),HL,(PBNOW),HL,(PBNOW+2),HL
          LD (TMM),HL,(TMM2),HL
;---------
MIDIMAIN  LD HL,(TMM2),DE,(TMM):OR A:SBC HL,DE:JR Z,MM
          ;EI:HALT
          LD IX,MN2WND:CALL CLOCK,MIDIinfo
          CALL ENKE:JR NZ,MIDInEXIT
          CALL SPKE:JR NZ,MIDInEXIT
          CALL ESC:JR NZ,MIDI_EXIT
          CALL F1,NZ,MIDI_CHIP
          LD A,(MIDItsNOW):OR A:JR Z,MIDInEXIT
PBcn      LD A,0,B,A,DE,(PBNOW+1):OR A:JR Z,PBca
PBcalculon OR A:RR D,E:DJNZ PBcalculon
PBca      LD BC,(POZA),A,E:CP C:JR Z,MM:LD (POZA),A:CALL PBLNE,PBPRINT

MM        LD HL,(TMM),(TMM2),HL
          XOR A:LD (MIDItsNOW),A
          LD IY,TRACKS
DOINtrax  CALL INCTIME,Z,TRACKGO
          LD DE,TSTRUCTSIZE:ADD IY,DE
          LD A,(IY+TPOS+2):INC A:JR NZ,DOINtrax
          JP MIDIMAIN

MIDI_EXIT CALL MIDI_INIT:LD IX,MN2WND:JP GAFF
MIDInEXIT CALL MIDI_INIT:LD IX,MN2WND:JP NEXT

MIDIinfo  LD HL,MTTEMPO
          LD A,(MIDITEMPO+2):CALL NORK8BIT
          LD A,(MIDITEMPO+1):CALL NORK8BIT
          LD A,(MIDITEMPO+0):CALL NORK8BIT
          LD HL,MTPPQN
          LD A,(PPQN+1):CALL NORK8BIT
          LD A,(PPQN+0):CALL NORK8BIT
          LD HL,MTTICKPI
          LD A,(TICKPI+1):CALL NORK8BIT
          LD A,(TICKPI+0):CALL NORK8BIT
          LD HL,MIDITEXT,DE,#0501:JP TXTPR
;---------
HEADSKIP  XOR A:CALL MNGCVPL
          LD HL,LOBU,DE,MIDIHEAD,B,8:CALL SRHSTR:RET NZ
          LD A,(HL):INC HL:OR A:RET NZ; format v0/1 big endian
          LD A,(HL):INC HL:CP 2:RET NC;

          LD A,(HL):INC HL:OR A:RET NZ; tracks big endian
          LD A,(HL):INC HL:CP MIDImaxTRAX+1:RET NC
          LD (MIDITRACKS),A

          LD DE,DEFAULT_TEMPO,(MIDITEMPO),DE
          LD A,DEFAULT_TEMPo,(MIDITEMPO+2),A
          LD A,(HL):INC HL:LD (PPQN+1),A;PPQN big endian
          LD A,(HL):INC HL:LD (PPQN),A;
          
          CALL MIDI_TRACKS:LD A,(TRACKS+2):CP #FF:RET Z
          CALL TICKS
          RET
;---------
INCTIME   LD A,(IY+TEOT):OR A:RET NZ
          LD HL,MIDItsNOW:INC (HL)
          LD A,(IY+TWAITflg):OR A:RET Z

          LD A,(MIDItimer+3):CP (IY+TDELTAtime+3):JR C,Texit,NZ,Tyo
          LD A,(MIDItimer+2):CP (IY+TDELTAtime+2):JR C,Texit,NZ,Tyo
          LD A,(MIDItimer+1):CP (IY+TDELTAtime+1):JR C,Texit,NZ,Tyo
          LD A,(MIDItimer+0):CP (IY+TDELTAtime+0):JR C,Texit,NZ,Tyo
Tyo       XOR A
          RET
Texit     OR 1
          RET
;---------
TRACKGO   LD A,(IY+TEOT):OR A:RET NZ
          LD L,(IY+TPOS+0)
          LD H,(IY+TPOS+1)
          LD A,(IY+TPOS+2):CALL MIDIpgUP
          PUSH HL:CALL MIDI
          POP DE
          PUSH HL:OR A:SBC HL,DE:JR Z,PBinc
          LD DE,(PBNOW):ADD HL,DE:LD (PBNOW),HL:JR NC,PBinc
          LD HL,(PBNOW+2):INC HL:LD (PBNOW+2),HL
PBinc     POP HL
          LD A,H:CP #C0:JR NC,POSok
          OR %1100 0000:LD H,A:INC (IY+TPOS+2)
POSok     LD (IY+TPOS+0),L
          LD (IY+TPOS+1),H
          LD A,(IY+TWAITflg):OR A:JR Z,TRACKGO
          RET
;---------
MIDI      CALL DELTAH:RET NZ

          LD A,(HL):INC HL:BIT 7,A:JR NZ,PREV
          LD A,(IY+TRUN):DEC HL
PREV      CP #FF:JR Z,SKIP
          CP #F0:JR Z,MUGEN

          CP #F2:JR Z,THREEByTE
          CP #F3:JR Z,TWOByTE
          CP #F7:JR Z,MUGENno
          LD B,A:AND #F0
          LD (IY+TRUN),B
          CP %1101 0000:JR Z,TWOBYTE;#D0
          CP %1100 0000:JR Z,TWOBYTE;#C0
          CP %1000 0000:JR Z,THREEBYTE;#80
          CP %1001 0000:JR Z,THREEBYTE;#90
          CP %1010 0000:JR Z,THREEBYTE;#A0
          CP %1011 0000:JR Z,THREEBYTE;#B0
          CP %1110 0000:JR Z,THREEBYTE;#E0
          JP THREEbyte
THREEBYTE LD A,B
THREEByTE CALL MIDI_OUT
          LD A,(HL):INC HL:CALL MIDI_OUT
          LD A,(HL):INC HL:JP MIDI_OUT
TWOBYTE   LD A,B
TWOByTE   CALL MIDI_OUT
          LD A,(HL):INC HL:JP MIDI_OUT
THREEbyte LD A,(HL):INC HL
TWObyte   LD A,(HL):INC HL:RET
MUGEN     CALL MIDI_OUT
          LD A,(HL):INC HL:CP #40:JR C,MUGENnO
          CALL MIDI_OUT
MUGENL    LD A,(HL):INC HL
          PUSH AF:CALL MIDI_OUT
          POP AF:CP #F7:RET Z
          JR MUGENL
SKIP      LD A,(HL):INC HL
          LD C,(HL):INC HL
          CP #03:JR Z,TNAME
          CP #51:JR Z,TEMPO
          CP #2F:JR Z,ENDofTRACK
          JR MUGENoo
MUGENnO   LD C,A:JR MUGENoo
MUGENno   LD C,(HL):INC HL
MUGENoo   LD B,0:ADD HL,BC
          RET
TEMPO     LD A,(HL):INC HL:LD (MIDITEMPO+2),A;say no to big endian
          LD A,(HL):INC HL:LD (MIDITEMPO+1),A
          LD A,(HL):INC HL:LD (MIDITEMPO+0),A
          JP TICKS
ENDofTRACK LD (IY+TEOT),#FF:RET
TNAME     LD A,(MIDIfnFLG):OR A:JR NZ,MUGENoo:INC A:LD (MIDIfnFLG),A
          LD A,C:SUB MAINWW:JR C,$+2+2:LD C,MAINWW
          PUSH AF
          LD DE,TXT2,B,0:LDIR
          PUSH HL:LD IX,MN2WND,HL,TXT2,DE,#0C01+TITLELNG,BC,MAINWW-TITLELNG:CALL PRSRW
          POP HL
          LD A,(IY+TPOS+2):CALL MIDIpgUP
          POP AF:LD C,A:RET Z:JR NC,MUGENoo
          RET
;---------
FLAGOFF   XOR A:LD (IY+TWAITflg),A:RET
DELTAH    LD A,(IY+TWAITflg):OR A:JR NZ,FLAGOFF

          LD A,(HL):INC HL
          LD DE,0,B,D,C,A:RLCA:JR NC,DHL
          RES 7,C
CCC       SRL D:LD D,E
          RR D:LD E,B
          RR E:LD B,C
          RR B:LD C,0
          RR C
          LD A,(HL):INC HL
          BIT 7,A:JR Z,SLAST
          RES 7,A:OR C:LD C,A
          JP CCC
SLAST     OR C:LD C,A
DHL       LD A,D:OR E,B,C
          LD (IY+TWAITflg),A:RET Z
          LD A,(IY+TDELTAtime+0):ADD A,C:LD (IY+TDELTAtime+0),A
          LD A,(IY+TDELTAtime+1):ADC A,B:LD (IY+TDELTAtime+1),A
          LD A,(IY+TDELTAtime+2):ADC A,E:LD (IY+TDELTAtime+2),A
          LD A,(IY+TDELTAtime+3):ADC A,D:LD (IY+TDELTAtime+3),A
          OR 1
          RET
;------------
;71680=Pent t/int
;------------
TICKS     PUSH HL
          LD BC,(MIDITEMPO+2),IX,(MIDITEMPO)
          LD A,B,DE,(PPQN):CALL DIVacixDE
          OR C:LD HL,#5400
          PUSH IX
          POP DE:JR Z,NOTC
          LD E,D,D,C,C,H:XOR A
          JR TICKNEXT
NOTC      LD A,H,C,L
TICKNEXT  CALL DIVacDE
          LD (TICKPI+1),A,A,C
          LD (TICKPI+0),A
          POP HL
          XOR A
          RET
;-----------
AYchipPR  LD A,(AYTXTB),HL,AYTXT1:OR A:JR Z,AYPR
          LD BC,(AYTXTB+1),B,0:ADD HL,BC
AYPR      LD (CHIPNOW),HL,HL,F1CHIP,DE,#060A:JP TXTPR
MIDI_CHIP LD A,(AYTXTB):XOR 1:LD (AYTXTB),A:CALL AYchipPR
          LD BC,#FFFD
AYCHIP    LD A,#FE:XOR 1:LD (AYCHIP+1),A,(AYCHIPI+1),A:OUT A:LD A,#7:OUT A
          LD BC,#BFFD,A,#FC:OUT A
          EI:HALT
          RET
MIDI_INIT LD BC,#FFFD
AYCHIPI   LD A,#FE:OUT A:LD A,#7:OUT A;AY-RS232/MIDI
          LD BC,#BFFD,A,#FC:OUT A
MIDI_RES  EI:HALT
          LD A,#FF
MIDI_OUT  PUSH AF
          LD BC,0+%01:CALL TURBOPL;7 MHz no waits
          LD DE,#FAFE;D=0, E=1
          LD BC,#FFFD,A,#E:OUT A
          LD BC,#BFFD
          POP AF
          DI
          OUT D:DS 19+(28+1);START
          JP $+3
.8        RRA:JP C,$+3+2+3:OUT D:JP $+3+2+3:OUT E:JP $+3:DS 19+(28+1)
          OUT E:DS 19+22;END
          EI
          LD BC,0+%10:CALL TURBOPL;14 MHz waits
          XOR A
          RET

MIDI_LOAD   LD A,(DADE):CP 16:LD A,#FF:RET NC; 1MB MAX

            LD A,MIDIminPG,(MIDIL+1),A
MIDIL       LD A,0:CALL MNGCVPL:LD HL,LOBU,B,32:CALL LOAD512:CP #0F:RET Z
            LD A,(MIDIL+1):INC A:CP MIDImaxPG+1:RET NC
            LD (MIDIL+1),A:JR MIDIL

MIDI_TRACKS LD IY,TRACKS
            LD A,MIDIminPG,(MIDIpgNOW),A:CALL MIDIpgUP

            LD A,(MIDITRACKS),C,A
TRACKSparse LD DE,MIDITRACK,B,4:CALL SRHSTR:JP NZ,MTEND
            LD A,(HL),(IY+TLEN+3),A:INC HL
            LD A,(HL),(IY+TLEN+2),A,B,A:INC HL
            LD A,(HL),(IY+TLEN+1),A,D,A:INC HL
            LD A,(HL),(IY+TLEN+0),A,E,A:INC HL
            PUSH HL,DE
            LD HL,(MIDIfileLN):ADD HL,DE:LD (MIDIfileLN),HL
            LD HL,(MIDIfileLN+2),D,0,E,B:ADC HL,DE:LD (MIDIfileLN+2),HL
            POP DE,HL
            LD (IY+TPOS+0),L
            LD (IY+TPOS+1),H,A,(MIDIpgNOW)
            LD (IY+TPOS+2),A
            XOR A
            LD (IY+TWAITflg),A
            LD (IY+TRUN),A
            LD (IY+TEOT),A
            LD (IY+TDELTAtime+0),A
            LD (IY+TDELTAtime+1),A
            LD (IY+TDELTAtime+2),A
            LD (IY+TDELTAtime+3),A

            ADD HL,DE:JR C,PAGEADD
            LD A,B:OR A:JR Z,PAGEnoCHANGE
            LD A,(MIDIpgNOW)
.4          ADD A,B:JR C,MTEND
            JR PAGEadd
PAGEADD     LD A,(MIDIpgNOW)
.4          ADD A,B:JR C,MTEND
            LD B,A,A,H
.2          RLCA:RL B
            LD A,H:OR %1100 0000:LD H,A,A,B
PAGEadd     CP MIDImaxPG+1:JR NC,MTEND
            LD (MIDIpgNOW),A:CALL MIDIpgUP
PAGEnoCHANGE
            LD DE,TSTRUCTSIZE:ADD IY,DE
            DEC C:JP NZ,TRACKSparse
MTEND       LD A,#FF
            LD (IY+0),A
            LD (IY+1),A
            LD (IY+2),A
            RET

MIDIpgUP    PUSH HL,AF:CALL MNGCVPL
            POP AF:INC A:CALL MNG0VPL
            POP HL
            RET

MIDITEXT    DB "Tempo: #",6,6
MTTEMPO     DB "000000",7,7,"  PPQN: #",6,6
MTPPQN      DB "0000",7,7,"  Ticks/INT: #",6,6
MTTICKPI    DB "0000",0
;---------------------------------------
SRHSTR      LD A,(DE):CP (HL):RET NZ:INC HL,DE:DJNZ SRHSTR:RET
;---------------------------------------
MIDIpgNOW   NOP
MIDItsNOW   NOP
MIDItimer   DS 4
;-----------
MIDITEMPO   DS 4;Quarter-note duration in us
PPQN        DS 2;Pulses per quarter-note
TICKPI      DS 2;ticks/int
;-----------
MIDIfnFLG   NOP
MIDITRACKS  NOP
MIDIfileLN  DS 4
;-----------
;Track STRUCT:
TSTRUCTSIZE EQU 16;(14)

TPOS        EQU 0
TLEN        EQU TPOS+3
TDELTAtime  EQU TLEN+4
TWAITflg    EQU TDELTAtime+4
TRUN        EQU TWAITflg+1
TEOT        EQU TRUN+1
;-----------
TRACKS      EQU LOBU3; 4Kb
TRACKSEND   EQU TRACKS+MIDImaxTRAX*TSTRUCTSIZE
;-----------
MIDIHEAD    DB "MThd",0,0,0,6
MIDITRACK   DB "MTrk"
;---------------------------------------
WAVMUZ  LD IX,MN2WND:CALL PRWOW
        LD HL,LOBU2,B,1:CALL LOAD512

        LD BC,(LOBU2+24);4 BYTES!
;-------
        EXX:LD HL,WAV_8000:EXX:LD HL,8000,DE,#0504:OR A:SBC HL,BC:JR Z,GC
        EXX:LD HL,WAV_11025:EXX:LD HL,11025,DE,#0403:OR A:SBC HL,BC:JR Z,GC
        EXX:LD HL,WAV_16000:EXX:LD HL,16000,DE,#0302:OR A:SBC HL,BC:JR Z,GC;TMP
        EXX:LD HL,WAV_22050:EXX:LD HL,22050,DE,#0102:OR A:SBC HL,BC:JR Z,GC
        EXX:LD HL,WAV_44100:EXX:LD HL,44100,DE,#0101:OR A:SBC HL,BC:JR Z,GC;37.5KHz!
;-------
GC      LD A,(LOBU2+22)
        LD BC,WAV_MONO
        LD HL,#0000:CP 1:JR Z,CHANLZ
        LD BC,WAV_STEREO
        LD HL,#7E23:CP 2:JR Z,CHANLZ

CHANLZ  LD (TOGS+5),HL;STEREO
        LD (TOGS+3),DE;FREQ

        LD (WAV_CHAN),BC:EXX:LD (WAV_FREQ),HL
        LD HL,MODE2,DE,EDITOR0:CALL FILE_INFO
        LD HL,WAV_MODE,DE,#050A:CALL TXTPR

        CALL PBSHW

        XOR A
        OUT (#B3),A
        OUT (#BB),A
        IN A,(#BB)

        LD A,#F3:CALL SENDCOM

        LD A,#00:OUT (#B3),A
        LD A,#14:CALL SENDCOM,GSWD
        LD A,#02:CALL SENDDAT

        LD A,#00:CALL SENDDAT
        LD A,#40:CALL SENDDAT

        LD HL,TOGS,BC,#0200
WAV2    PUSH BC
        LD A,(HL):CALL SENDDAT:INC HL
        POP BC
        DEC BC:LD A,B:OR C:JR NZ,WAV2

        XOR A:OUT (#B3)
        LD A,#13:CALL SENDCOM,GSWD
        LD A,#40:CALL SENDDAT

        XOR A:OUT (#BB),A
        IN A,(#B3)

        XOR A
        LD (WVMD),A
        LD A,32
        LD (MINB),A

        LD A,(BLKZ+1):OR A:JR Z,MNI
        LD B,A
BIG     LD C,0:CALL BG:JR NZ,NX
        DJNZ BIG

MNI     LD A,(BLKZ):OR A:JR Z,EDWV
        LD C,A:CALL BG:JR NZ,NX

        LD A,1,(WVMD),A

EDWV    LD A,#FF:CALL SENDCOM

        CALL ENKE
        LD A,(WVMD):OR A:JP Z,GAFF
        JP NEXT
;-------
NX      DEC A:JR NZ,EXWV
NXWV    LD A,1,(WVMD),A
EXWV    LD A,#FE
        JR EDWV+2
;-------
BG      PUSH BC:LD B,1:CALL GSLOAD
        CALL CLOCK
        POP BC

        LD HL,MINB
        LD A,(HL):OR A:JR Z,FFF
        DEC (HL)

        XOR A
        LD (ABT),A
        LD (ENT),A
        JR HHH
FFF     LD A,(ENT):OR A:JR NZ,NXF
        LD A,(ABT):OR A:JR NZ,EXF
HHH     DEC C:JR NZ,BG
        XOR A
        RET
;-------
NXF     LD A,1:OR A:RET
EXF     LD A,2:OR A:RET
;---------------------------------------
MP3MUZ  LD IX,MN2WND:CALL PRWOW

        CALL PBSHW
        LD HL,MODE3,DE,EDITOR0:CALL FILE_INFO
;-------
        LD HL,MP3HR,A,(HL):OR A:JR Z,DAK
        XOR A:LD (MP3TOGS),A
DAK     LD (HL),1
;-------
        XOR A
        OUT (#B3),A
        OUT (#BB),A
        IN A,(#BB)

        LD A,#F3:CALL SENDCOM

        LD A,#00:OUT (#B3),A
        LD A,#14:CALL SENDCOM,GSWD
        LD A,#04:CALL SENDDAT

        LD A,#00:CALL SENDDAT
        LD A,#40:CALL SENDDAT

        LD HL,MP3TOGS,BC,#0400
        JP WAV2

;---------------------------------------
PBSHW   LD HL,(DAHL)
        LD DE,(DADE)
.5      SRL D:RR E,H,L
        LD (PBSTL+1),HL
        LD (PBSTH+1),DE
        LD HL,0,(PBNOW),HL,(PBNOW+2),HL
        RET
;-------
PBPR    LD HL,(PBNOW)
        LD DE,(PBNOW+2)
        LD BC,2048
        ADD HL,BC:JR NC,$+3:INC DE
        LD (PBNOW),HL
        LD (PBNOW+2),DE

        PUSH IX:CALL DELIT4P
        POP IX

        LD HL,TXTBU
        LD C,32
        OR A:JR NZ,$+5:LD A,C:JR DoL
        CP C:JR C,$+3:LD A,C
        LD B,A
        LD A,C:SUB B

        LD C,11,(HL),C:INC HL:DJNZ $-2

        OR A:RET Z
DoL     LD B,A,C,19,(HL),C:INC HL:DJNZ $-2

        LD A,(TXTBU+32),(TXTBU+31),A
        LD HL,LOADPB,DE,#0401+(MAINWW-34)/2,BC,33:CALL PRSRW
        RET
;---------------------------------------
PBLNE   LD A,(POZA):OR A:CALL Z,PBCLR
        INC A
        LD H,0,L,A,A,H
.3      ADD HL,HL;*8
;-------
.2      ADD HL,HL;*4
        LD DE,HL
        ADD HL,HL;*8
        LD BC,HL
.2      ADD HL,HL;*32
        ADD HL,DE:JR NC,$+2+1:INC A
        ADD HL,BC:JR NC,$+2+1:INC A;*44
;LD B,PBWIDTH=44 MNOGA ADD HL,DE:DJNZ MNOGA
PBSTP   LD DE,0,C,A,A,D:OR E:JR Z,PBCLR
        XOR A
        PUSH IX
        PUSH HL
        POP IX:CALL DIVacixDE
        PUSH IX
        POP BC
        POP IX

PBstp   LD HL,PBWIDTH*8:OR A:SBC HL,BC:JR NC,$+5:LD BC,PBWIDTH*8

        LD HL,PBLINE
        LD A,C
.3      SRL B:RR C
        JR Z,PBL
        LD B,C
FLPB    LD (HL),19:INC HL:DJNZ FLPB

PBL     AND 7:RET Z
        LD DE,PBTBL-1
        LD B,A:INC DE:DJNZ $-1
        LD A,(DE),(HL),A
        RET

PBCLR   LD HL,PBLINE
        PUSH AF
        LD B,PBWIDTH,A,11
CFPB    LD (HL),A:INC HL:DJNZ CFPB
        POP AF
        RET

PBTBL   DB 12,13,14,15,16,17,18
;-------
PBCLC   CALL PBCLR
        LD A,(POZS),(PBSTP+1),A
        RET

;---------------------------------------
DELIT4P LD IX,0-1
NAZE    OR A
PBSTH   LD BC,0:INC IX
        EX DE,HL:SBC HL,BC:JR C,ND
PBSTL   LD BC,0
        EX DE,HL:SBC HL,BC:JR NC,PBSTH
        DEC DE
        LD A,D:INC A:JR NZ,NAZE
        LD A,E:INC A:JR NZ,NAZE
        INC DE

        ADD HL,BC
        EX DE,HL
        LD BC,(PBSTH+1)
ND      ADD HL,BC
        EX DE,HL
        PUSH IX
        POP BC
        LD A,C
        RET
;---------------------------------------
DIVacixDE LD HL,0,B,32
DIV       ADD IX,IX:RL C:RLA:ADC HL,HL:JR C,DIVOVER
          SBC HL,DE:JR NC,DIVSET
          ADD HL,DE:DJNZ DIV
          RET
DIVOVER   OR A:SBC HL,DE
DIVSET    INC IX:DJNZ DIV
          RET

DIVacDE   LD HL,0,B,16
DIVa      SLL C:RLA:ADC HL,HL:SBC HL,DE:JR NC,$+4:ADD HL,DE
          DEC C:DJNZ DIVa
          RET
;---------------------------------------
;---------------------------------------
DEVCHE  LD A,(IX+29):CP 2:RET NZ

        CALL GEDPL

        LD IX,ERWND:CALL PRWOW
_LD HL,TXTER,DE,#0103,BC,26:CALL PRSRW

        CALL USPO
        CALL NUSP

        CALL RRESB

        XOR A
        RET

;---------------------------------------
CLOCK   LD HL,(TMM):INC HL
        LD A,L:OR H:DEC HL:JR NZ,Clock
        INC HL:LD (TMM),HL
Clock   LD DE,CLOK
        LD BC,49*60,A,255
        OR A:INC A:SBC HL,BC:JP NC,$-3
        LD (DE),A:INC DE
        ADD HL,BC
        LD BC,49,A,255
        OR A:INC A:SBC HL,BC:JP NC,$-3
        LD (DE),A:INC DE
        ADD HL,BC
        LD A,L:ADD A,A
        LD (DE),A

        LD DE,SPR,A,(CLOK+0):CALL DEC0,PRDIS
        LD DE,SPR+10,A,(CLOK+1):CALL DEC0,PRDIS
        LD DE,SPR+20,A,(CLOK+2):CALL DEC0,PRDIS

      LD HL,SPR+#00,DE,#0101+(MAINWW-28)/2,BC,28:CALL PRSRW:LD A,%01111111:CALL PRIAT
      LD HL,SPR+MAINWW,DE,#0201+(MAINWW-28)/2,BC,28:CALL PRSRW:LD A,%01111111:CALL PRIAT
      LD HL,SPR+MAINWW*2,DE,#0301+(MAINWW-28)/2,BC,28:CALL PRSRW:LD A,%01111111:CALL PRIAT
        RET

PBPRINT LD HL,SLINE,DE,#0401,BC,MAINWW:CALL PRSRW
;LD HL,MODES,DE,#021F:CALL TXTPR
        RET

DEC0    LD C,#FF
        INC C:SUB 10:JR NC,$-3
        ADD A,10
        RET
;-------
;Print Digits
PRDIS   ;i: DE - Dest Address
;            C - Digit1
;            A - Digit2
  
        PUSH AF,DE
        CALL GDF
        POP DE,BC
        LD C,B
.4      INC DE

GDF     LD H,0,L,C
        PUSH HL
.3      ADD HL,HL
        POP BC
        ADD HL,BC;*9

        LD BC,DIGITS:ADD HL,BC
        LD A,3
DDF
.3      LDI
        EX DE,HL:LD BC,MAINWW-3:ADD HL,BC
        EX DE,HL
        DEC A:JR NZ,DDF
        RET

;---------------------------------------
ANFNT   LD A,0:OR A:RET NZ
        INC A:LD (ANFNT+1),A

        LD A,#FF:EXA:XOR A:CALL WLD
        LD HL,#C000,DE,#C800,BC,8*20
        LDIR

        LD HL,#C000,DE,#C001,BC,8*9-1
        LD (HL),L
        LDIR

        LD HL,#C000+8+7,DE,8
        LD C,%01111110
        LD A,1
AFN     PUSH HL
        LD B,A,(HL),C:DEC HL:DJNZ $-2
        POP HL
        ADD HL,DE
        INC A:CP 9:JR C,AFN
;-------
        LD HL,PBRMK,DE,#C000+8*9,BC,8*3:LDIR
        LD HL,DE,BC,0-8:ADD HL,BC
        LD BC,8*8:LDIR

        LD A,%10000000
        LD B,8,HL,#C000+8*12+3,DE,8-1
BUR     LD C,A
        OR (HL):LD (HL),A:INC L
        LD A,C
        OR (HL):LD (HL),A
        LD A,C
        ADD HL,DE
        SCF:RRA
        DJNZ BUR
        RET

DEFNT   LD A,#FF:CALL MNGC_PL
        LD HL,#C800,DE,#C000,BC,8*20
        LDIR
        RET

;---------------------------------------
MNGC_PL EXA:XOR A:JP WLD
PRWOW   LD A,1:JP WLD
RRESB   LD A,2:JP WLD
PRSRW   LD A,3:JP WLD
PRIAT   EXA:LD A,4:JP WLD
GADRW   LD A,5:JP WLD
TXTPR   LD A,11:JP WLD
;-------
TURBOPL LD A,14:JP WLD
GEDPL   LD A,15:JP WLD
;-------
SPKE    LD A,16:JP WLD
ENKE    LD A,22:JP WLD
ESC     LD A,23:JP WLD
F1      LD A,29:JP WLD

KBSCN   EXA:LD A,42:JP WLD
USPO    LD A,46:JP WLD
NUSP    LD A,47:JP WLD
;-------
LOAD512 LD A,48:JP WLD
GIPAGPL LD A,50:JP WLD
TENTRY  LD DE,ENTRY,A,51:JP WLD
;-------
MNGCVPL EXA:LD A,65:JP WLD
MNG0VPL EXA:LD A,80:JP WLD
;-------
GYoff   LD A,67:JP WLD
;-------
INT_PL  EXA:LD A,86:JP WLD
;---------------------------------------
MAINWW  EQU 46
MAINY   EQU 255
MAINW   EQU MAINWW+2
MAINAH  EQU MODH-1
MAINHH  EQU 12+2
MAINH   EQU MAINAH+MAINHH
MODW    EQU 46+2
MODH    EQU 6+2

MNWND   DB 4+16+128,0
        DB 255,MAINY;   X,Y
        DB MAINW,MAINH; W,H
        DB %01111111;   PAPER+INK
        DB 0
        DW #0000;            BUFFER
        DB MAINAH+3,MAINAH+6;LINES

        DW MNTXTHEAD
        DW 0
        DW MNTXTBODY

MN2WND  DB 4+16+128,0
        DB 255,MAINY;    X,Y
        DB MAINW,MAINHH; W,H
        DB %01111111;    PAPER+INK
        DB 0
        DW #0000;        BUFFER
        DB 3,6;          LINES

        DW MNTXTHEAD
        DW 0
        DW MNTXTBODY

MNTXTHEAD DB #E,9,"Sound Player",0
MNTXTBODY DS 7,#D
          DB 2,"Editor:",#D
          DB 2
INFOTITLe DB "  Mode:"
ETITLe    DB #D,#D
          DB 1,"File:",#D
          DB 1
INFOTITLE DB "Name:"
ETITLE    NOP
TITLELNG  EQU ETITLE-INFOTITLE
TITLElng  EQU ETITLe-INFOTITLe
CONTLNG   EQU MAINWW-TITLELNG

F1CHIP    DB "F1 - Select output: ",#FE
CHIPNOW   DW AYTXT2
          DB 0
AYTXTB    DB 1,10; Now,Len
AYTXT1    DB "First AY ",0
AYTXT2    DB "Second AY",0

MODWND  DB 4+16+128,0
        DB 255,0;    X,Y
        DB MODW,MODH;W,H
        DB %01111111;PAPER+INK
        DB 0
        DW #0000;    BUFFER
        DB 0,0;      LINES

        DW TXTPAT
        DW 0
        DW 0

TXTPAT  DB 9," M - Pause  ENTER - Next File SPACE - Keep Play",0
MODUND  DS MODW-2,#F7
;-------
WAITWND DB 4+16+128,0
        DB 255,255;  X,Y
        DB 32+2,2+2; W,H
        DB %01001111;PAPER+INK
        DB 0
        DW #0000;    BUFFER
        DB 0,0;      LINES

        DW WAIT
        DW 0
        DW WAITING_GS

WAIT    DB 9,#E,"WAIT",0
WAITING_GS
        DB #E,"Waiting to GS response...",13
        DB #E,"("
WAITSEC DB "7",")",0
;-------
ERWND   DB 3+16+128,0
        DB 255,255;  X,Y
        DB 32+2,1+2; W,H
        DB %00101111;PAPER+INK
        DB 0
        DW #0000;    BUFFER
        DB 0,0;      LINES
;-------
TXT2    DS CONTLNG
TXTER   DB "CAN'T PLAY FROM SD(NGS)!!!"

MODE1   DB "MOD Player",0
MODE2   DB "WAV Player",0
MODE3   DB "MP3 Player",0
MODE4   DB "MIDI Player",0

WAV_MODE DB "8-bit WAV  "
         DB #FE
WAV_FREQ DW WAV_44100
         DB "  "
         DB #FE
WAV_CHAN DW WAV_MONO
         DB 0

WAV_STEREO DB "Stereo",0
WAV_MONO   DB "Mono",0

WAV_8000  DB " 8000 Hz",0
WAV_11025 DB "11025 Hz",0
WAV_16000 DB "16000 Hz",0
WAV_22050 DB "22050 Hz",0
WAV_44100 DB "44100 Hz",0

EDITOR0 DB "UNKNOWN",0

;---------------------------------------
DAHL    DS 2
DADE    DS 2

BLKZ    DS 2

PBNOW   DS 4

GSENA   DB #FF

MP3HR   NOP

MINB    NOP

CMDWAIT NOP
POZoPAT NOP

PAT1    NOP ;PATTERN NOW
POZP2   NOP
POZP    NOP ;POS in PATTERN
POZA    NOP ;POS NOW
POZS    NOP ;POSITIONS
WVMD    NOP
;-------
TMMOUT  DS 2 ;Pattern Position Time Out
TMM     DS 2 ;Timer
TMM2    DS 2 ;Prev Timer
CLOK    DS 3
TIME    DB "00:00.00"
;-------
ESTAT    NOP
MODSTATE NOP
FILENAME DW 0
;---------------------------------------
ENTRY   DS 32

TXT32   DS 32,32
LOADPB  DB 9
TXTBU   DS 32
        DB 10
PBWIDTH EQU MAINWW-2
SLINE   DB 9;       [
PBLINE  DS PBWIDTH; PB body
        DB 10;      ]

LOADING_SPRITE
 DB #DC,#20,#20,32,#DC,#DC,#DC,32,#DC,#DC,#DC,32,#DC,#DC,#20:DB 32,#DC,#DC,#DC,32
 DB #DC,#DC,#20,32,#DC,#DC,#DC,32
 DB #DB,#20,#20,32,#DB,#20,#DB,32,#DB,#DC,#DB,32,#DB,#20,#DB:DB 32,#20,#DB,#20,32
 DB #DB,#20,#DB,32,#DB,#20,#DC,32
 DB #DB,#DC,#DC,32,#DB,#DC,#DB,32,#DB,#20,#DB,32,#DB,#DC,#DF:DB 32,#DC,#DB,#DC,32
 DB #DB,#20,#DB,32,#DB,#DC,#DB,32

DIGITS  DB #DC,#DC,#DC;0
        DB #DB,#20,#DB
        DB #DB,#DC,#DB
        DB #20,#DC,#20;1
        DB #DF,#DB,#20
        DB #DC,#DB,#DC
        DB #DC,#DC,#DC;2
        DB #DC,#DC,#DB
        DB #DB,#DC,#DC
        DB #DC,#DC,#DC;3
        DB #20,#DC,#DB
        DB #DC,#DC,#DB
        DB #DC,#20,#DC;4
        DB #DB,#DC,#DB
        DB #20,#20,#DB
        DB #DC,#DC,#DC;5
        DB #DB,#DC,#DC
        DB #DC,#DC,#DB
        DB #DC,#DC,#DC;6
        DB #DB,#DC,#DC
        DB #DB,#DC,#DB
        DB #DC,#DC,#DC;7
        DB #20,#20,#DB
        DB #20,#20,#DB
        DB #DC,#DC,#DC;8
        DB #DB,#DC,#DB
        DB #DB,#DC,#DB
        DB #DC,#DC,#DC;9
        DB #DB,#DC,#DB
        DB #DC,#DC,#DB

PBRMK   DB %00000000
        DB %00000111
        DB %00000110
        DB %00000110
        DB %00000110
        DB %00000110
        DB %00000111
        DB %00000000

        DB %00000000
        DB %11100000
        DB %01100000
        DB %01100000
        DB %01100000
        DB %01100000
        DB %11100000
        DB %00000000

        DB %00000000
        DB %11111111
        DB %00000000
        DB %10101010
        DB %01010101
        DB %00000000
        DB %11111111
        DB %00000000


SPR     DS MAINWW*3
END
;---------------------------------------


TOGS    ORG #4000,#6200+END-PLUGIN
STRWAV  DI:JR GON
PEI     DB 2
        DB 1
STO     DB #00,#00
GON     LD HL,I_n_T,(#5EFF),HL
        LD A,#5E,I,A
        IM 2
;---------------------------------------
        LD D,C_24MHZ
        IN A,(GSCFG0)
        AND #CF
        OR D
        OUT (GSCFG0),A
;-------
        LD A,63
        OUT (#07),A
        OUT (#08),A;     6,7,8,9=A,B,C,D

        LD HL,PEI
        LD A,(HL),(PE1+1),A:INC HL
        LD A,(HL),(PE2+1),A
        LD HL,(STO),(STEREO),HL

        EXX:LD BC,#0100,HL,#8000,D,#61
        EXX
;---------------------------------------
LOADE   LD A,1,(PAGR+1),A
LDE     LD HL,PAGR+1:INC (HL)
        LD A,(HL),DE,(MXP)
        CP E:JR NC,TYU

        OUT (#00),A
        LD HL,#8000
        CALL PGLD
        JR LDE

TYU     OUT (#00),A
        LD A,2,(PAG+1),A

        EI
        LD HL,#8000
        LD BC,#02
WAITGS  IN A,(#01):OR A:JR NZ,EXIT
        IN A,(#04)
        RLCA:JR NC,WAITGS
        INI
        LD A,H:OR L:JR NZ,WAITGS
        LD H,#80;L=0

        LD A,(PAGR+1),DE,(MXPG)
        INC A:CP E:JR C,$+4:LD A,2
        LD (PAGR+1),A,E,A
KL      LD A,(PAG+1):CP E:JR Z,KL
        JP WAITGS
EXIT    INC A:JR NZ,FUCK
        IN A
NFIR    LD A,(PAGR+1),E,A
EXT     LD A,(PAG+1):CP E:JR Z,NXS
        LD A,H:CP #80:JR C,EXT
        LD (HL),0:INC HL
        JR EXT
NXS     LD A,(PAG+1):CP E:JP NZ,#0000
        JR NXS
;-------
FUCK    IN A
        JP #0000
;---------------------------------------
I_n_T   EXX:EXA
        DJNZ NOSND
        LD A,C:OR A:JR NZ,K1
PE2     LD B,4:INC C
        JR PAG
K1      CP 1:JR NZ,K2
        INC C
        JR $+4
K2      LD C,0
PE1     LD B,3
PAG     LD A,2:OUT (#00),A

        LD A,(HL)
        LD (DE),A:INC D
STEREO  NOP:NOP
        LD (DE),A
        LD A,(DE):DEC D
        LD A,(DE)
        INC L:JR Z,POZ
PAGR    LD A,2:OUT (#00),A
NOSND   EXX:EXA
        EI
        RET
;-------
POZ     INC H:JR NZ,PAGR

        LD A,(MXPG),E,A,A,(PAG+1)
        INC A:CP E:JR C,$+4:LD A,2
        LD (PAG+1),A

        LD H,#80
        JR PAGR
;---------------------------------------
PGLD    IN A,(#04):RLCA:JR NC,PGLD
        IN A,(#02)
        LD (HL),A
        INC HL:LD A,H:OR L:JR NZ,PGLD
        RET
;---------------------------------------
INDEX   DW 0
SND     DB 0

MXPG    DB 8
MXP     DB 4
;-------
END_WAV
;---------------------------------------

;---------------------------------------
;--------------MP3 Driver---------------
;---------------------------------------
ORGSWAV EQU #6200+END-PLUGIN
;-------
        ORG #4000,ORGSWAV+END_WAV-STRWAV
        DI
        DI
        LD SP,#5000
        LD HL,I_U_T,(#5EFF),HL
        LD A,#5E,I,A
        IM 2
;-------
        CALL MP3INIT
;-------
        LD A,BPGB:OUT (#00),A
        LD HL,#8000:CALL PGLD2
;-------
        EI
        LD HL,#8000
        LD DE,HL
WAITNGS IN A,(#01):OR A:JR NZ,EXIT2
        IN A,(#04)
        RLCA:JR NC,WAITNGS

        LD A,H:CP D:JR Z,$-2

        IN A,(#02)
        LD (HL),A
        INC L:JP NZ,WAITNGS
        INC H:JR NZ,WAITNGS
        LD H,#80;L=0
        JP WAITNGS
;-------
EXIT2   INC A:JR NZ,FUCK2
        IN A,(#02)

        LD A,H:DEC A
        CP #80:JR NC,$+4:LD A,#F0
        CP D:JR NZ,$-1

        JR EAH
;-------
FUCK2   IN A,(#02)
EAH     DI
        LD HL,#C9FB,(I_U_T),HL
        LD A,3:CALL FREQNC
        JP #0000
;---------------------------------------
PGLD2   IN A,(#04):RLCA:JR NC,PGLD2
        IN A,(#02)
        LD (HL),A
        INC L:JP NZ,PGLD2
        INC H:JR NZ,PGLD2
        RET

;---------------------------------------
I_U_T   EXA
;-------
        IN A,(SSTAT):RRA:JR NC,IUTE
        LD A,D:INC A:JR Z,HUITE
        CP H:JR Z,IUTE
JATT    LD B,#20
DATT    LD A,(DE):OUT (MD_SEND),A:INC DE
        DJNZ DATT
        LD A,D:OR E:JR Z,PZ2
;-------
IUTE    EXA
        EI
        RET
;-------
HUITE   ADD A,#80:CP H:JP NZ,JATT,IUTE
;-------
PZ2     LD DE,#8000:JP IUTE
;---------------------------------------
MP3INIT XOR A:CALL FREQNC;         10MHz

        CALL HARDMP3

;LD HL,#020B
;LD DE,#0000
;CALL COM_MP3

        CALL SOFTMP3
        RET

;=======================================
NOPER
.32     NOP
        RET

;---------------------------------------
FREQNC  LD D,C_10MHZ;#30
        AND 3:JR Z,FREQNCS

        LD D,C_12MHZ;#10
        DEC A:JR Z,FREQNCS

        LD D,C_20MHZ;#20
        DEC A:JR Z,FREQNCS

        LD D,C_24MHZ;0

FREQNCS IN A,(GSCFG0)
        AND #CF
        OR D
        OUT (GSCFG0),A
        RET
;---------------------------------------
;HARD RESET:
HARDMP3 LD A,(#4000):OR A:RET Z

        XOR A:CALL VOL_MOD

        LD BC,MC_SEND
        LD A,%10011100:OUT (SCTRL),A

        LD HL,#0301:CALL COM_MP3
        LD A,E:AND %01110000

        PUSH AF
        LD A,M_MPXRS
        OUT (SCTRL),A:CALL NOPER

        LD A,M_MPXRS+M_SNCLR
        OUT (SCTRL),A
        IN A,(SSTAT):RRA:JR NC,$-3

        LD HL,#0203;#8000+#9B58=7000
        LD DE,#9B58:CALL COM_MP3
        POP AF

        LD HL,#0202
        LD DE,#8008:CALL Z,COM_MP3

        LD A,1:CALL FREQNC;        12MHz
        RET
;---------------------------------------
;SOFT RESET:
SOFTMP3 LD BC,MC_SEND
        LD HL,#030B:CALL COM_MP3

        PUSH DE
        LD DE,#FEFE

        LD HL,#020B:CALL COM_MP3

        LD HL,#0301:CALL COM_MP3
        LD A,E
        AND %01110000
        PUSH AF
        LD HL,#0300:CALL COM_MP3

        LD A,E:XOR 4:LD E,A
        LD HL,#0200:CALL COM_MP3
        LD A,E:XOR 4:LD E,A
        LD HL,#0200:CALL COM_MP3

        IN A,(SSTAT):RRA:JR NC,$-3

        LD HL,#0203
        LD DE,#9B58
        CALL COM_MP3
        POP AF

        LD HL,#0202
        LD DE,#8008:CALL Z,COM_MP3

        POP DE
        LD HL,#020B
        JR COM_MP3

;---------------------------------------
VOL_MOD OUT (VOL1),A
        OUT (VOL2),A
        OUT (VOL3),A
        OUT (VOL4),A
        OUT (VOL5),A
        OUT (VOL6),A
        OUT (VOL7),A
        OUT (VOL8),A
        RET
;---------------------------------------
;i: H - Command (3-READ, 2-WRITE)
;   L - Register Address
;  DE - Value

COM_MP3 CALL NOPER

        IN A,(SSTAT):RRA:JR NC,$-3

        CALL NOPER

        LD A,M_MCNCS:OUT (SCTRL),A

        CALL NOPER

        LD BC,MC_SEND
        LD A,H
        OUT H:CALL NOPER
        OUT L:CALL NOPER
        CP 3:JR Z,MP3READ

        OUT D:CALL NOPER
        OUT E

MP3END  CALL NOPER

        LD A,M_MCNCS+M_SNCLR;#82
        OUT (SCTRL),A

        JP NOPER
;-------
MP3READ LD BC,MC_READ,A,#FF
        OUT (MC_SEND),A:CALL NOPER
        IN D:CALL NOPER
        OUT (MC_SEND),A:CALL NOPER
        IN E
        JR MP3END

;=======================================
MP3TOGS EQU ORGSWAV+END_WAV-STRWAV+#1E00
;---------------------------------------
BPGB    EQU 2
BPGE    EQU 2
;---------------------------------------
