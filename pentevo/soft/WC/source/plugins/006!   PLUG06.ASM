;File Creator v0.2a
;(C) BUDDER/MGN/2012
;---------------------------------------
        ORG #6000
;-------
WLD     EQU #6006
;---------------------------------------
;HEADER:
        DS 16
        DB "WildCommanderMDL";    Header
        DB #02;                  Version
        DB 0;                       Type
        DB 2; Pages
        DB 0; Page to #8000
;-------
        DB 0,2; CODE
        DB 1,32;QC in Hobeta

.4      DB 0,0
;-------
        DS 16
;-------
        DS 32*3
;-------
        DB 0
;-------
        DW #6000,#0000; MAX SIZE
;-------
        DB "File Creator v0."
        DB "2a              "
;-------
        DB 3;run from menu
;---------------------------------------
        ORG #8000,#6200
;-------
LOBU    EQU #A000
;---------------------------------------
PLUGIN  CP #03:RET NZ
        LD (DAHL),HL,(DADE),DE

        XOR A:LD (ESTAT),A

        LD HL,MS01:EXX
        LD IX,PLWND
        LD HL,TXT0
        LD DE,#0007
        LD BC,7:CALL MENU,Z,CREATE

        LD A,(ESTAT)
        RET
;---------------------------------------
CREATE  LD A,(IX+12)
        DEC A:JR Z,TRDEMPT
        DEC A:JR Z,TRDBOOT
        RET
;-------
TRDEMPT CALL SIZEMN:RET NZ

        CALL INIT,HAUDEH,CAT9C

        LD HL,(SZVA):CALL MAKETRD

        JP ENDI
;-------
MAKETRD LD DE,NAME1:CALL MKFILE

        XOR A:CALL MNGCVPL
        LD HL,#C000,B,8:CALL SAVE512

        LD A,3,(ESTAT),A
        RET
;-------
TRDBOOT CALL SIZEMN:RET NZ

        CALL INIT

        CALL ADDBTHE
        CALL HAUDEH,CAT9C

        LD HL,(SZVA):CALL MAKETRD

        LD A,1:CALL MNGC_PL
        LD HL,#C000+17,B,32:CALL SAVE512

        JP ENDI
;-------
ADDBTHE LD A,1:CALL MNGC_PL
        LD HL,#C000,DE,BOOTHE,BC,13:LDIR
        INC HL:LDI

        XOR A:CALL MNGCVPL
        LD HL,BOOTHE,DE,#C000,BC,16:LDIR
        RET
;-------
SIZEMN  LD HL,MS02:EXX
        LD IX,P2WND
        LD HL,TXT1
        LD DE,#0004
        LD BC,12
        CALL MENU:RET NZ

        LD A,(IX+12)
        DEC A:JR Z,TRD640
        DEC A:JR Z,TRD800
        RET
;-------
TRD640  LD HL,2544,(SECZ),HL
        LD HL,SIZE1,(SZVA),HL
        XOR A
        RET
TRD800  LD HL,3184,(SECZ),HL
        LD HL,SIZE2,(SZVA),HL
        XOR A
        RET
;---------------------------------------
INIT    LD HL,(SECZ),(TRDSPC+1),HL

        XOR A:CALL MNGCVPL
        LD HL,#C000,DE,HL:INC DE
        LD BC,#1000-1
        LD (HL),L:LDIR

        LD IX,NMWND:CALL INAME,MESHW
        XOR A:CALL MNGCVPL
        RET
;-------
ENDI    JP MEHD
;---------------------------------------
;i:  IX - SOW
;    HL - Text
;    DE - Y + X
;    BC - Lenght

;EXX HL - Content

MENU    EXX:LD (PRCONT+1),HL
        EXX

        PUSH HL,DE,BC:CALL PRWOW
        POP BC,DE,HL

        CALL PRSRW
        LD A,%11110111:CALL PRIAT

        CALL PRCONT

        LD A,1:CALL YN
MAIN    EI:HALT:XOR A:CALL YN,CURSOR

        CALL UPPP,NZ,UPC
        CALL DWWW,NZ,DNC

        CALL ESC:JR NZ,AIN
        CALL ENKE:JR Z,MAIN

        LD A,#FF:CALL YN:JR NZ,AIN

MAJ     CALL RRESB:XOR A:RET
;-------
AIN     CALL MAJ:INC A:RET
;-------
UPC     LD A,(IX+12):CP 1:RET Z
        CALL CURSER
        DEC (IX+12)
        JP CURSOR
DNC     LD A,(IX+12):CP (IX+13):RET NC
        CALL CURSER
        INC (IX+12)
        JP CURSOR
;-------
PRCONT  LD HL,0
        LD DE,#0102

RCON    PUSH HL,DE
        LD BC,16
        PUSH BC:CALL PRSRW
        POP BC
        POP DE,HL:INC D:ADD HL,BC

        LD A,(IX+13):CP D:RET C
        JR RCON
;---------------------------------------
INAME   CALL PRWOW

_LD HL,TXT2,DE,#0009,BC,14:CALL PRSRW
_LD A,%11110101:CALL PRIAT
_LD HL,TCT0,DE,#0101,BC,5:CALL PRSRW

        LD DE,#0106:CALL GADRW
        LD (BMKD+1),HL
        LD DE,#0800,A,#FF:CALL ISTR
MKD     EI:HALT
        CALL ESC:JR NZ,EMKD
        CALL ENKE:JR NZ,BMKD

        XOR A:CALL ISTR
        JR MKD
;-------
EMKD    CALL RRESB
        LD A,1:OR A
        RET
;-------
BMKD    LD HL,0,DE,NAME1,BC,8:LDIR
        CALL RRESB
        XOR A
        RET
;---------------------------------------
MESHW   LD IX,MEWND:CALL PRWOW
_LD HL,TXT3,DE,#0108,BC,15:CALL PRSRW
_LD A,%01110000:JP PRIAT

MEHD    LD IX,MEWND:JP RRESB
;---------------------------------------
NFS     INC A:CP 16:JR C,JEKTOR:INC D
        XOR A
JEKTOR  DJNZ NFS
        RET

ADDSUM  LD HL,0,DE,0
        EXX
        LD HL,#C000,DE,13,B,128
DSU     LD A,(HL):OR A:RET Z
        ADD HL,DE
        LD A,(HL)
        EXX
        LD E,A
        ADD HL,DE
        EXX
        INC HL,HL,HL
        DJNZ DSU
        RET

CAT9C   EXX
        LD HL,#C8EA,DE,HL:INC DE
        LD BC,9-1,(HL),32:LDIR
        LD A,#10,(#C000+#08E7),A
        EXX

        LD A,129:SUB B
        LD (#C000+#08E4),A
        LD A,C,(#C000+#08F4),A
        DEC HL:LD D,(HL)
        DEC HL:LD A,(HL)
        DEC HL:LD B,(HL):CALL NFS
        LD E,A,(#C000+#08E1),DE
        CALL ADDSUM:EXX
        EX DE,HL
TRDSPC  LD HL,2544
        OR A:SBC HL,DE:RET C
        LD (#C000+#08E5),HL
        XOR A
        RET
; _
HAUDEH  LD HL,#C000,DE,16,BC,#8100
HEHA    LD A,(HL):OR A:RET Z
        CP 1:JR NZ,$+3:INC C
        ADD HL,DE
        DJNZ HEHA
        OR A
        RET
;---------------------------------------
MNGC_PL EXA:LD A,0:JP WLD
PRWOW   LD A,1:JP WLD
RRESB   LD A,2:JP WLD
PRSRW   LD A,3:JP WLD
PRIAT   EXA:LD A,4:JP WLD
GADRW   LD A,5:JP WLD
CURSOR  LD A,6:JP WLD
CURSER  LD A,7:JP WLD
YN      EXA:LD A,8:JP WLD
ISTR    EXA:LD A,9:JP WLD
;-------
UPPP    LD A,17:JP WLD
DWWW    LD A,18:JP WLD

ENKE    LD A,22:JP WLD
ESC     LD A,23:JP WLD
;-------
LOAD512 LD A,48:JP WLD
SAVE512 LD A,49:JP WLD
MKFILE  LD A,58:JP WLD
;-------
MNGCVPL EXA:LD A,65:JP WLD
;---------------------------------------
PLWND   DB 0,0
        DB 30,10;    X,Y
        DB 18+2,4+2; W,H
        DB %01111111;PAPER+INK
        DB 0
        DW #0000;    BUFFER
        DB 2,0;      LINES

        DB 1,2
        DB %11110001,0
;-------
P2WND   DB 0,0
        DB 30,10;    X,Y
        DB 18+2,4+2; W,H
        DB %01111111;PAPER+INK
        DB 0
        DW #0000;    BUFFER
        DB 2,0;      LINES

        DB 1,2
        DB %11110001,0
;-------
MEWND   DB 0,0
        DB 23,13;    X,Y
        DB 32+2,1+2; W,H
        DB %01111111;PAPER+INK
        DB 0
        DW #0000;    BUFFER
        DB 0,0;      LINES
;-------
NMWND   DB 0,0
        DB 23,13;    X,Y
        DB 31+2,1+2; W,H
        DB %01011111;PAPER+INK
        DB 0
        DW #0000;    BUFFER
        DB 0,0;      LINES
;-------
MS01    DB " Empty TRD File "
        DB " TRD With Boot! "
MS02    DB "     640 KB     "
        DB "     800 KB     "

TXT0    DB "CREATE:"
TXT1    DB "Select Size:"
TXT2    DB "CREATING FILE:"

TXT3    DB "Creating TRD..."

TCT0    DB "Name:"
;-------
BOOTHE  DB "boot    B"
        DB #00,#00;Start Addres
        DB #00,#00;Size in Bytes
        DB #00;    Size in Sectors
        DB #00,#01;Sec, Track

NAME1   DB "12345678TRD",#00

SIZE1   DW #0000,#000A;640Kb
SIZE2   DW #8000,#000C;800Kb
;---------------------------------------
SECZ    DW 2544
SZVA    DW SIZE1

DAHL    DS 2
DADE    DS 2

ESTAT   NOP
;---------------------------------------
        ORG #6200+2*512
        INCB "QC_3_11"
