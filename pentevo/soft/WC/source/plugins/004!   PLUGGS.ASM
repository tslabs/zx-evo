;GS Player v0.6b
;(C) BUDDER/MGN/2012
;---------------------------------------
        ORG #6000
;-------
        INCL "PRTGS"
;-------
ABT     EQU #6004
ENT     EQU #6005
WLD     EQU #6006
;---------------------------------------
;HEADER:
        DS 16
        DB "WildCommanderMDL";    Header
        DB #01;                  Version
        DB 0;                       Type
        DB 1; Pages
        DB 0; Page to #8000
;-------
        DB 0,8; CODE

.5      DB 0,0
;-------
        DS 16
;-------
        DB "MOD"
        DB "WAV"
        DB "MP3"
        DS 29*3
;-------
        DB 0
;-------
        DW #FFFF,#FFFF; MAX SIZE
;-------
        DB "GS Player v0.6b "
        DB "                "
;-------
        DB 0
;---------------------------------------
        ORG #8000,#6200
;-------
LOBU    EQU #A000
;---------------------------------------
PLUGIN  LD (DAHL),HL,(DADE),DE

        LD L,H,H,E
.3      SRL D:RR H,L
        INC L:JR NZ,$+3:INC H
        LD (BLKZ),HL

        XOR A
        LD (ESTAT),A
        LD H,A,L,A
        LD (TMM),HL

        CALL DEVCHE:RET Z

        LD A,(GSENA):CP #FF:CALL Z,GSFET
        LD A,(GSENA):OR A:JP NZ,NOGS

        CALL GEDPL

        LD IX,PLWND:CALL PRWOW

        CALL EXTCHE:JR Z,MODMUZ
        DEC A:JP Z,WAVMUZ
        DEC A:JP Z,MP3MUZ

        LD A,2:OUT (254)
;-------
MODMUZ
_LD IX,PLWND
_LD HL,TXT01,DE,#000C,BC,10:CALL PRSRW
        LD A,%11110111:CALL PRIAT

        CALL GOGS
        CALL PBCLC

        XOR A:LD (ZNAK),A,(POZA),A
MAIN    EI:HALT
        CALL CLOCK
        CALL GWC,NC,PTC:JR NC,NEXT

        CALL SPKE:JR NZ,GAFF
        CALL ESC:JR NZ,MGAFF

        CALL ENKE:JR Z,MAIN

        CALL MUTEGS

NEXT    LD A,2,(ESTAT),A
GAFF    LD IX,PLWND:CALL RRESB
GAF     LD A,(ESTAT)
        RET
;-------
MGAFF   CALL MUTEGS:JR GAFF
;-------
NOGS    LD A,1,(ESTAT),A:JR GAF
;---------------------------------------
TMMI    LD HL,(TMM):INC HL:LD (TMM),HL
        RET
;---------------------------------------
PTC     CALL TMMI,PBPRI

        LD HL,ZNAK
        LD A,(HL):OR A:JR NZ,NNC
        LD A,#60:OUT (#BB),A
        LD (HL),A
POF     SCF
        RET
NNC     LD (HL),0
        IN A,(#B3)
        LD HL,POZA
        CP (HL):LD (HL),A:JR NC,POF
        XOR A
        RET
;---------------------------------------
GOGS    CALL PBSHW

_LD IX,PLWND
_LD HL,TXT4,DE,#0101,BC,10:CALL PRSRW
_LD A,%01110010:CALL PRIAT

        XOR A:CALL SENDCOM

        LD A,#F3:CALL SENDCOM;REini

        LD A,#23:CALL SENDCOM,GETDAT

        EXA
        LD A,#30:CALL SENDCOM;sndMOD
        LD A,#D1:CALL SENDCOM;opnSTRM
        EXA

        LD DE,6,H,D,L,A
.4      ADD HL,HL
        ADD HL,DE

        LD A,(BLKZ+1):CP H
        JR NZ,ZEM
        LD B,A:LD A,(BLKZ):CP L:LD A,B
        JR Z,NOI
ZEM     JR NC,BRKA
NOI     OR A:JR Z,NA

NOIR    PUSH AF
        LD B,0:CALL GSLOAD
        POP AF
        DEC A:JR NZ,NOIR

NA      LD A,(BLKZ),B,A
        CALL GSLOAD

        CALL PBHTW

        LD A,#D2:CALL SENDCOM
        IN A,(#B3):OUT (#B3),A
        LD A,#31:CALL SNDCOM
;-------
        CALL GIPAGPL
        LD HL,LOBU,B,2:CALL LOAD512

        LD A,(LOBU+950),(POZS),A

        LD HL,TXT2,DE,HL:INC DE
        LD (HL),32:LD BC,19:LDIR

        LD HL,LOBU,DE,TXT2,B,20
FLLNAME LD A,(HL):OR A:JR Z,EFF
        LD (DE),A:INC HL,DE
        DJNZ FLLNAME
EFF
_LD IX,PLWND
_LD HL,TXT1,DE,#0101,BC,5:CALL PRSRW
_LD A,%01110001:CALL PRIAT
_LD HL,TXT2,DE,#0106,BC,18:CALL PRSRW
_LD A,%01111110:CALL PRIAT
        RET

BRKA    LD A,#D2:CALL SENDCOM
        RET
;---------------------------------------
GSLOAD  PUSH BC

        CALL PBPR

        LD HL,LOBU,B,4:CALL LOAD512

        LD HL,LOBU
        LD BC,#00BB,E,2
TE1     IN A:RLCA:JR C,TE1

RDA     LD A,(HL):OUT (#B3),A:INC L

TE2     IN A:RLCA:JR C,TE2

RDB     LD A,(HL):OUT (#B3),A:INC L

TE3     IN A:RLCA:JR C,TE3

RDC     LD A,(HL):OUT (#B3),A:INC L

TE4     IN A:RLCA:JR C,TE4

RDD     LD A,(HL):OUT (#B3),A:INC HL
        DJNZ TE1

        DEC E:JR NZ,TE1

        POP BC
        DJNZ GSLOAD
        RET
;-------
SNDCOM  OUT (#BB),A:RET
SENDCOM OUT (#BB),A
GSWC    IN A,(#BB)
        RRCA
        JR C,GSWC
        RET
GWC     IN A,(#BB)
        RRCA
        RET
;-------
SENDDAT OUT (#B3),A
GSWD    IN A,(#BB):RLCA:JR C,GSWD
        RET
;-------
GETDAT  IN A,(#BB):RLCA:JR NC,GETDAT
        IN A,(#B3)
        RET
;---------------------------------------
GSFET   ;LD A,#80:OUT (#33)

        IN A,(#B3)
        LD B,0,C,A
STAB    IN A,(#B3):CP C:JR NZ,WSE
        DJNZ STAB

        LD A,#F3:OUT (#BB),A
        LD B,0:DJNZ $

        LD A,#23:OUT (#BB),A
        LD BC,#0F00
DIK     DEC BC:LD A,B:OR C:JR Z,WSE
        IN A,(#BB)
        RRCA
        JR C,DIK
        IN A,(#B3):CP 3:JR C,WSE
WNE     LD A,1:OUT (#B3),A
        LD A,#6A:CALL SENDCOM
        XOR A:OUT (#B3),A
        LD A,#6B:CALL SENDCOM
        XOR A
;-------
WZE     LD (GSENA),A
        PUSH AF:LD A,#F3:CALL SENDCOM
        POP AF
        RET
WSE     LD A,1:OR A
        JR WZE
;-------
MUTEGS  LD A,#F3:OUT (#BB):RET
;---------------------------------------
WAVMUZ
_LD IX,PLWND
_LD HL,TXT02,DE,#000C,BC,10:CALL PRSRW
        LD A,%11110111:CALL PRIAT

GOWAV   CALL PBSHW

        LD HL,ENTRY,DE,TXT2,BC,8:LDIR
        LD A,".",(DE),A:INC DE
        LD C,3:LDIR

_LD IX,PLWND
_LD HL,TXT3,DE,#0101,BC,10:CALL PRSRW
_LD A,%01110001:CALL PRIAT
_LD HL,TXT2,DE,#010B,BC,12:CALL PRSRW

        LD HL,LOBU,B,1:CALL LOAD512

        LD BC,(LOBU+24);4 BYTES!
;-------
        LD HL,8000,DE,#0504
        OR A:SBC HL,BC:JR Z,GC
;-------
        LD HL,11025,DE,#0403
        OR A:SBC HL,BC:JR Z,GC
;-------
        LD HL,16000,DE,#0302;TMP
        OR A:SBC HL,BC:JR Z,GC
;-------
        LD HL,22050,DE,#0102
        OR A:SBC HL,BC:JR Z,GC
;-------
        LD HL,44100,DE,#0101;   37.5KHz!
        OR A:SBC HL,BC:JR Z,GC
;-------
GC      LD A,(LOBU+22)
        LD HL,#0000:CP 1:JR Z,CHANLZ
        LD HL,#7E23:CP 2:JR Z,CHANLZ

CHANLZ  LD (TOGS+5),HL;STEREO
        LD (TOGS+3),DE;FREQ

KHZ     XOR A
        OUT (#B3),A
        OUT (#BB),A
        IN A,(#BB)

        LD A,#F3:CALL SENDCOM

        LD A,#00:OUT (#B3),A
        LD A,#14:CALL SENDCOM,GSWD
        LD A,#02:CALL SENDDAT

        LD A,#00:CALL SENDDAT
        LD A,#40:CALL SENDDAT

        LD HL,TOGS,BC,#0200
WAV2    PUSH BC
        LD A,(HL):CALL SENDDAT:INC HL
        POP BC
        DEC BC:LD A,B:OR C:JR NZ,WAV2

        XOR A:OUT (#B3)
        LD A,#13:CALL SENDCOM,GSWD
        LD A,#40:CALL SENDDAT

        XOR A:OUT (#BB),A
        IN A,(#B3)

        XOR A
        LD (WVMD),A
        LD A,32
        LD (MINB),A

        LD A,(BLKZ+1):OR A:JR Z,MNI
        LD B,A
BIG     LD C,0:CALL BG:JR NZ,NX
        DJNZ BIG

MNI     LD A,(BLKZ):OR A:JR Z,EDWV
        LD C,A:CALL BG:JR NZ,NX

        LD A,1,(WVMD),A

EDWV    LD A,#FF:CALL SENDCOM

        CALL PBHTW

        CALL ENKE
        LD A,(WVMD):OR A:JP Z,GAFF
        JP NEXT
;-------
NX      DEC A:JR NZ,EXWV
NXWV    LD A,1,(WVMD),A
EXWV    LD A,#FE
        JR EDWV+2
;-------
BG      PUSH BC:LD B,1:CALL GSLOAD
        POP BC

        LD HL,MINB
        LD A,(HL):OR A:JR Z,FFF
        DEC (HL)

        XOR A
        LD (ABT),A
        LD (ENT),A
        JR HHH
FFF     LD A,(ENT):OR A:JR NZ,NXF
        LD A,(ABT):OR A:JR NZ,EXF
HHH     DEC C:JR NZ,BG
        XOR A
        RET
;-------
NXF     LD A,1:OR A:RET
EXF     LD A,2:OR A:RET
;---------------------------------------
MP3MUZ
_LD IX,PLWND
_LD HL,TXT03,DE,#000C,BC,10:CALL PRSRW
        LD A,%11110111:CALL PRIAT

        CALL PBSHW

        LD HL,ENTRY,DE,TXT2,BC,8:LDIR
        LD A,".",(DE),A:INC DE
        LD C,3:LDIR

_LD IX,PLWND
_LD HL,TXT3,DE,#0101,BC,10:CALL PRSRW
_LD A,%01110001:CALL PRIAT
_LD HL,TXT2,DE,#010B,BC,12:CALL PRSRW

;-------
        LD HL,MP3HR,A,(HL):OR A:JR Z,DAK
        XOR A:LD (MP3TOGS),A
DAK     LD (HL),1
;-------
        XOR A
        OUT (#B3),A
        OUT (#BB),A
        IN A,(#BB)

        LD A,#F3:CALL SENDCOM

        LD A,#00:OUT (#B3),A
        LD A,#14:CALL SENDCOM,GSWD
        LD A,#04:CALL SENDDAT

        LD A,#00:CALL SENDDAT
        LD A,#40:CALL SENDDAT

        LD HL,MP3TOGS,BC,#0400
        JP WAV2

;---------------------------------------
PBSHW   LD HL,(DAHL)
        LD DE,(DADE)
        CALL DEL32
        LD (PBSTL+1),HL
        LD (PBSTH+1),DE
        LD HL,0,(PBNOW),HL,(PBNOW+2),HL
        RET
;-------
PBHTW   EI
.4      HALT
_LD IX,PLWND
_LD HL,TXT32,DE,#0201,BC,32:CALL PRSRW
        RET
;-------
PBPR    LD HL,(PBNOW)
        LD DE,(PBNOW+2)
        LD BC,2048
        ADD HL,BC:JR NC,$+3:INC DE
        LD (PBNOW),HL
        LD (PBNOW+2),DE

        CALL DELIT4P

        LD HL,TXTBU
        LD C,32
        OR A:JR NZ,$+5:LD A,C:JR DoL
        CP C:JR C,$+3:LD A,C
        LD B,A
        LD A,C:SUB B

        LD C,#DB
        LD (HL),C:INC HL:DJNZ $-2

        OR A:JR Z,DOL
DoL     LD B,A,C,#B1
        LD (HL),C:INC HL:DJNZ $-2
DOL
_LD IX,PLWND
_LD HL,TXTBU,DE,#0201,BC,32:CALL PRSRW
        RET
;---------------------------------------
PBPRI   CALL PBLNE
PBPRR
_LD IX,PLWND
_LD HL,PBLINE,DE,#0201,BC,32:CALL PRSRW
        RET
;-------
PBLNE   LD A,(POZA):OR A:CALL Z,PBCLR
        INC A
        LD H,A,L,0
;               *256

PBSTP   LD DE,0
        LD A,D:OR E:JR Z,PBCLR
        LD BC,0-1
        OR A:INC BC:SBC HL,DE:JP NC,$-3

        LD HL,32*8
        OR A:SBC HL,BC
        JR NC,$+5:LD BC,32*8

        LD HL,PBLINE
        LD A,C
.3      SRL B:RR C
        JR Z,PBL
        LD B,C
FLPB    LD (HL),#DB:INC HL:DJNZ FLPB

PBL     AND 7:RET Z
        LD DE,PBTBL-1
        LD B,A:INC DE:DJNZ $-1
        LD A,(DE),(HL),A
        RET

PBFCLR  LD HL,PBLINE
        PUSH AF
        LD B,32,A,#B1
CFPB    LD (HL),A:INC HL:DJNZ CFPB
        POP AF
        RET

PBCLR   LD HL,PBLINE
        LD B,32
CLPB    LD (HL),#B1:INC HL:DJNZ CLPB
        RET

PBTBL   DB #DB,#DB,#DB,#DB,#DB,#DB,#DB
;-------
PBCLC   CALL PBCLR,PBPRR
        LD A,(POZS),(PBSTP+1),A
        RET
;---------------------------------------
CLOCK   LD HL,(TMM),DE,CLOK
        LD BC,50*60,A,255
        OR A:INC A:SBC HL,BC:JP NC,$-3
        LD (DE),A:INC DE
        ADD HL,BC
        LD BC,50,A,255
        OR A:INC A:SBC HL,BC:JP NC,$-3
        LD (DE),A:INC DE
        ADD HL,BC
        LD A,L:ADD A,A
        LD (DE),A

        LD HL,TIME+0
_LD A,(CLOK+0):CALL DEC0
        LD (HL),C:INC HL:LD (HL),A

        LD HL,TIME+3
_LD A,(CLOK+1):CALL DEC0
        LD (HL),C:INC HL:LD (HL),A

        LD HL,TIME+6
_LD A,(CLOK+2):CALL DEC0
        LD (HL),C:INC HL:LD (HL),A

_LD IX,PLWND
_LD HL,TIME,DE,#0119,BC,8:CALL PRSRW
_LD A,%01110000:CALL PRIAT
        RET

DEC0    LD C,#2F
        INC C:SUB 10:JR NC,$-3
        ADD A,10+#30
        RET
;---------------------------------------
DEL32
.5      SRL D:RR E,H,L
        RET

DELIT4P LD IX,0-1
NAZE    OR A
PBSTH   LD BC,0:INC IX
        EX DE,HL:SBC HL,BC:JR C,ND
PBSTL   LD BC,0
        EX DE,HL:SBC HL,BC:JR NC,PBSTH
        DEC DE
        LD A,D:INC A:JR NZ,NAZE
        LD A,E:INC A:JR NZ,NAZE
        INC DE

        ADD HL,BC
        EX DE,HL
        LD BC,(PBSTH+1)
ND      ADD HL,BC
        EX DE,HL
        PUSH IX
        POP BC
        LD A,C
        RET
;---------------------------------------
EXTCHE  PUSH HL,DE
        CALL TENTRY
;-------
        LD HL,ENTRY+8,DE,MOD
        CALL TN:LD A,0:JR Z,YUKSEK

        LD HL,ENTRY+8,DE,WAV
        CALL TN:LD A,1:JR Z,YUKSEK

        LD HL,ENTRY+8,DE,MP3
        CALL TN:LD A,2:JR Z,YUKSEK

        LD A,#FF
;-------
YUKSEK  POP DE,HL
        OR A
        RET
;---------------------------------------
TN
_LD A,(DE):CP (HL):RET NZ:INC HL,DE
_LD A,(DE):CP (HL):RET NZ:INC HL,DE
_LD A,(DE):CP (HL)
        RET
;---------------------------------------
DEVCHE  LD A,(IX+29):CP 2:RET NZ

        CALL GEDPL

        LD IX,ERWND:CALL PRWOW
_LD HL,TXTER,DE,#0103,BC,26:CALL PRSRW

        CALL USPO
        CALL NUSP

        CALL RRESB

        XOR A
        RET
;---------------------------------------
PRWOW   LD A,1:JP WLD
RRESB   LD A,2:JP WLD
PRSRW   LD A,3:JP WLD
PRIAT   EXA:LD A,4:JP WLD
;-------
GEDPL   LD A,15:JP WLD
;-------
SPKE    LD A,16:JP WLD
ENKE    LD A,22:JP WLD
ESC     LD A,23:JP WLD

USPO    LD A,46:JP WLD
NUSP    LD A,47:JP WLD
;-------
LOAD512 LD A,48:JP WLD
GIPAGPL LD A,50:JP WLD
TENTRY  LD DE,ENTRY,A,51:JP WLD
;---------------------------------------
PLWND   DB 0,0
        DB 23,13;    X,Y
        DB 32+2,2+2; W,H
        DB %01111111;PAPER+INK
        DB 0
        DW #0000;    BUFFER
        DB 0,0;      LINES
;-------
ERWND   DB 0,0
        DB 23,13;    X,Y
        DB 32+2,1+2; W,H
        DB %00101111;PAPER+INK
        DB 0
        DW #0000;    BUFFER
        DB 0,0;      LINES
;-------
TXTER   DB "CAN'T PLAY FROM SD(NGS)!!!"

TXT01   DB "MOD Player"
TXT02   DB "WAV Player"
TXT03   DB "MP3 Player"

TXT1    DB "Name:"
TXT3    DB "File Name:"
TXT4    DB "Loading..."
TXT2    DS 32
;---------------------------------------
MOD     DB "MOD"
WAV     DB "WAV"
MP3     DB "MP3"
;-------
DAHL    DS 2
DADE    DS 2

BLKZ    DS 2

PBNOW   DS 4

GSENA   DB #FF

MP3HR   NOP

MINB    NOP

ZNAK    NOP
POZA    NOP ;POS NOW
POZS    NOP ;POSITIONS
WVMD    NOP
;-------
TMM     DS 2
CLOK    DS 3
TIME    DB "00:00.00"
;-------
ESTAT   NOP
;---------------------------------------
ENTRY   DS 32

TXT32   DS 32,32
TXTBU   DS 32
PBLINE  DS 64
END
;---------------------------------------


TOGS    ORG #4000,#6200+END-PLUGIN
STRWAV  DI:JR GON
PEI     DB 2
        DB 1
STO     DB #00,#00
GON     LD HL,I_n_T,(#5EFF),HL
        LD A,#5E,I,A
        IM 2
;---------------------------------------
        LD D,C_24MHZ
        IN A,(GSCFG0)
        AND #CF
        OR D
        OUT (GSCFG0),A
;-------
        LD A,63
        OUT (#07),A
        OUT (#08),A;     6,7,8,9=A,B,C,D

        LD HL,PEI
        LD A,(HL),(PE1+1),A:INC HL
        LD A,(HL),(PE2+1),A
        LD HL,(STO),(STEREO),HL

        EXX:LD BC,#0100,HL,#8000,D,#61
        EXX
;---------------------------------------
LOADE   LD A,1,(PAGR+1),A
LDE     LD HL,PAGR+1:INC (HL)
        LD A,(HL),DE,(MXP)
        CP E:JR NC,TYU

        OUT (#00),A
        LD HL,#8000
        CALL PGLD
        JR LDE

TYU     OUT (#00),A
        LD A,2,(PAG+1),A

        EI
        LD HL,#8000
        LD BC,#02
WAITGS  IN A,(#01):OR A:JR NZ,EXIT
        IN A,(#04)
        RLCA:JR NC,WAITGS
        INI
        LD A,H:OR L:JR NZ,WAITGS
        LD H,#80;L=0

        LD A,(PAGR+1),DE,(MXPG)
        INC A:CP E:JR C,$+4:LD A,2
        LD (PAGR+1),A,E,A
KL      LD A,(PAG+1):CP E:JR Z,KL
        JP WAITGS
EXIT    INC A:JR NZ,FUCK
        IN A
NFIR    LD A,(PAGR+1),E,A
EXT     LD A,(PAG+1):CP E:JR Z,NXS
        LD A,H:CP #80:JR C,EXT
        LD (HL),0:INC HL
        JR EXT
NXS     LD A,(PAG+1):CP E:JP NZ,#0000
        JR NXS
;-------
FUCK    IN A
        JP #0000
;---------------------------------------
I_n_T   EXX:EXA
        DJNZ NOSND
        LD A,C:OR A:JR NZ,K1
PE2     LD B,4:INC C
        JR PAG
K1      CP 1:JR NZ,K2
        INC C
        JR $+4
K2      LD C,0
PE1     LD B,3
PAG     LD A,2:OUT (#00),A

        LD A,(HL)
        LD (DE),A:INC D
STEREO  NOP:NOP
        LD (DE),A
        LD A,(DE):DEC D
        LD A,(DE)
        INC L:JR Z,POZ
PAGR    LD A,2:OUT (#00),A
NOSND   EXX:EXA
        EI
        RET
;-------
POZ     INC H:JR NZ,PAGR

        LD A,(MXPG),E,A,A,(PAG+1)
        INC A:CP E:JR C,$+4:LD A,2
        LD (PAG+1),A

        LD H,#80
        JR PAGR
;---------------------------------------
PGLD    IN A,(#04):RLCA:JR NC,PGLD
        IN A,(#02)
        LD (HL),A
        INC HL:LD A,H:OR L:JR NZ,PGLD
        RET
;---------------------------------------
INDEX   DW 0
SND     DB 0

MXPG    DB 8
MXP     DB 4
;-------
END_WAV
;---------------------------------------

;---------------------------------------
;--------------MP3 Driver---------------
;---------------------------------------
ORGSWAV EQU #6200+END-PLUGIN
;-------
        ORG #4000,ORGSWAV+END_WAV-STRWAV
        DI
        DI
        LD SP,#5000
        LD HL,I_U_T,(#5EFF),HL
        LD A,#5E,I,A
        IM 2
;-------
        CALL MP3INIT
;-------
        EXX:LD HL,#8000
        EXX
;-------
        LD A,1,(PAGR2+1),A
LDE2    LD HL,PAGR2+1:INC (HL)
        LD A,(HL),DE,(MXP2)
        CP E:JR NC,TYU2

        OUT (#00),A
        LD HL,#8000
        CALL PGLD2
        JR LDE2

TYU2    OUT (#00),A
        LD A,2,(PAG2+1),A
;-------
        EI
        LD HL,#8000
        LD BC,#02
WAITNGS IN A,(#01):OR A:JR NZ,EXIT2
        IN A,(#04)
        RLCA:JR NC,WAITNGS
        INI
        LD A,H:OR L:JR NZ,WAITNGS
        LD H,#80;L=0

        LD A,(PAGR2+1),DE,(MXPG2)
        INC A:CP E:JR C,$+4:LD A,2
        LD (PAGR2+1),A,E,A
KL2     LD A,(PAG2+1):CP E:JR Z,KL2
        JP WAITNGS
;-------
EXIT2   INC A:JR NZ,FUCK2
        IN A
        LD A,(PAGR2+1),E,A
EXT2    LD A,(PAG2+1):CP E:JR Z,NXS2
        LD A,H:CP #80:JR C,EXT2
        LD (HL),0:INC HL
        JR EXT2
NXS2    LD A,(PAG2+1):CP E:JR NZ,EAH
        JR NXS2
;-------
FUCK2   IN A
EAH     DI
        LD HL,#C9FB,(I_U_T),HL
        LD A,3:CALL FREQNC
        JP #0000
;---------------------------------------
PGLD2   IN A,(#04):RLCA:JR NC,PGLD2
        IN A,(#02)
        LD (HL),A
        INC HL:LD A,H:OR L:JR NZ,PGLD2
        RET

;---------------------------------------
I_U_T   EXX:EXA
;-------
PAG2    LD A,2:OUT (#00),A

        IN A,(SSTAT):RRA:JR NC,PAGR2
        LD B,#20
DATT    LD A,(HL):OUT (MD_SEND),A:INC HL
        DJNZ DATT
        LD A,H:OR L:JR Z,POZ2

PAGR2   LD A,2:OUT (#00),A
;-------
        EXX:EXA
        EI
        RET
;-------
POZ2    LD A,(MXPG2),E,A,A,(PAG2+1)
        INC A:CP E:JR C,$+4:LD A,2
        LD (PAG2+1),A

        LD H,#80
        JP PAGR2
;---------------------------------------
MP3INIT XOR A:CALL FREQNC;         10MHz

        CALL HARDMP3

;LD HL,#020B
;LD DE,#0000
;CALL COM_MP3

        CALL SOFTMP3
        RET

;=======================================
NOPER
.32     NOP
        RET

;---------------------------------------
FREQNC  LD D,C_10MHZ;#30
        AND 3:JR Z,FREQNCS

        LD D,C_12MHZ;#10
        DEC A:JR Z,FREQNCS

        LD D,C_20MHZ;#20
        DEC A:JR Z,FREQNCS

        LD D,C_24MHZ;0

FREQNCS IN A,(GSCFG0)
        AND #CF
        OR D
        OUT (GSCFG0),A
        RET
;---------------------------------------
;HARD RESET:
HARDMP3 LD A,(#4000):OR A:RET Z

        XOR A:CALL VOL_MOD

        LD BC,MC_SEND
        LD A,%10011100:OUT (SCTRL),A

        LD HL,#0301:CALL COM_MP3
        LD A,E:AND %01110000

        PUSH AF
        LD A,M_MPXRS
        OUT (SCTRL),A:CALL NOPER

        LD A,M_MPXRS+M_SNCLR
        OUT (SCTRL),A
        IN A,(SSTAT):RRA:JR NC,$-3

        LD HL,#0203;#8000+#9B58=7000
        LD DE,#9B58:CALL COM_MP3
        POP AF

        LD HL,#0202
        LD DE,#8008:CALL Z,COM_MP3

        LD A,1:CALL FREQNC;        12MHz
        RET
;---------------------------------------
;SOFT RESET:
SOFTMP3 LD BC,MC_SEND
        LD HL,#030B:CALL COM_MP3

        PUSH DE
        LD DE,#FEFE

        LD HL,#020B:CALL COM_MP3

        LD HL,#0301:CALL COM_MP3
        LD A,E
        AND %01110000
        PUSH AF
        LD HL,#0300:CALL COM_MP3

        LD A,E:XOR 4:LD E,A
        LD HL,#0200:CALL COM_MP3
        LD A,E:XOR 4:LD E,A
        LD HL,#0200:CALL COM_MP3

        IN A,(SSTAT):RRA:JR NC,$-3

        LD HL,#0203
        LD DE,#9B58
        CALL COM_MP3
        POP AF

        LD HL,#0202
        LD DE,#8008:CALL Z,COM_MP3

        POP DE
        LD HL,#020B
        JR COM_MP3

;---------------------------------------
VOL_MOD OUT (VOL1),A
        OUT (VOL2),A
        OUT (VOL3),A
        OUT (VOL4),A
        OUT (VOL5),A
        OUT (VOL6),A
        OUT (VOL7),A
        OUT (VOL8),A
        RET
;---------------------------------------
;i: H - Command (3-READ, 2-WRITE)
;   L - Register Address
;  DE - Value

COM_MP3 CALL NOPER

        IN A,(SSTAT):RRA:JR NC,$-3

        CALL NOPER

        LD A,M_MCNCS:OUT (SCTRL),A

        CALL NOPER

        LD BC,MC_SEND
        LD A,H
        OUT H:CALL NOPER
        OUT L:CALL NOPER
        CP 3:JR Z,MP3READ

        OUT D:CALL NOPER
        OUT E

MP3END  CALL NOPER

        LD A,M_MCNCS+M_SNCLR;#82
        OUT (SCTRL),A

        JP NOPER
;-------
MP3READ LD BC,MC_READ,A,#FF
        OUT (MC_SEND),A:CALL NOPER
        IN D:CALL NOPER
        OUT (MC_SEND),A:CALL NOPER
        IN E
        JR MP3END

;=======================================
MP3TOGS EQU ORGSWAV+END_WAV-STRWAV+#1E00
;---------------------------------------
MXPG2   DB 5
MXP2    DB 4
;---------------------------------------
