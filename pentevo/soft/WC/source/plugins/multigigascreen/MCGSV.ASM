;Multi-Gigascreen Viewer
;(C) KOSHI/MGN/2018
;---------------------------------------
        ORG #6000
;-------
WLD     EQU #6006
;-------
SCR1    EQU #00
SCR2    EQU #10
SCR3    EQU #20
SCR4    EQU #30
;---------------------------------------
;HEADER:
        DS 16
        DB "WildCommanderMDL";    Header
        DB #0A;                  Version
        DB 0;                       Type
        DB 1; Pages
        DB 0; Page to #8000
;-------
        DB 0,4; CODE

.5      DB 0,0
;-------
        DS 16
;-------
        DB "IMG"
        DB "SCR"
        DB "GSC"

        DB "MC "

        DB "MG1"
        DB "MG2"
        DB "MG4"
        DB "MG8"

        DB "$S "

        DS 23*3
;-------
        DB 0
;-------
        DW #4D00,#0000; MAX SIZE
;-------
        DB "Multi-Gigascreen"
        DB "Viewer v0.31    "
;-------
        DB 4; EXT/Green menu Only!
        DS 6
;-------
        DB "View as SCR/MC/Gigascr  "
;---------------------------------------
        ORG #8000,#6200
;-------
LOBU    EQU #9000
LOBH    EQU LOBU+#0100
;---------------------------------------
PLUGIN  LD (DAHL),HL,(DADE),DE

        CALL INIT
        CALL EXTCHE:JP Z,MGX

        LD HL,DADE+1
        LD A,(HL):DEC HL
        OR (HL):DEC HL:JP NZ,X1
        LD C,(HL):DEC HL
        OR (HL):JR NZ,VSC2
        LD A,C
        CP #1B:JP Z,VSCR
        CP #30:JP Z,MC
        CP #1B*2:JP NZ,X1

;Dual Screen File (Gigascreen)
        CALL NOGFX

        LD A,SCR1:CALL MNGCVPL
        LD HL,#C000,B,#0E:CALL LOAD512
        LD HL,#C000+#1B00,DE,LOBU
        LD BC,#0100:LDIR

        LD A,SCR2:CALL MNGCVPL
        LD HL,#C100,B,#0E-1:CALL LOAD512
        LD HL,LOBU,DE,#C000
        LD BC,#0100:LDIR

DUAL    LD A,1,(FLG+1),A
        JP SCC

VSC2    CP #11:JP NZ,X1:LD A,C
        CP #1B:JP NZ,X1

;One Screen Hobeta File
        CALL NOGFX

        LD A,SCR1:CALL MNGCVPL
        LD HL,#BFEF,B,#0E:CALL LOAD512
        JR SC2
VSCR
;One Screen File
        CALL NOGFX

        LD A,SCR1:CALL MNGCVPL
        LD HL,#C000,B,#0E:CALL LOAD512
SC2     XOR A:LD (FLG+1),A

SCC     LD A,%00000000
SGG     PUSH AF
        LD HL,0:CALL GYoff
        LD HL,0:CALL GXoff
        LD A,1,(YAYA+1),A:CALL MNGV_PL
        CALL GOPAL
        POP AF:CALL GVmod
;-------
MAIN    EI:HALT
FLG     LD A,0:OR A:CALL NZ,YAYA

        CALL ENKE:JR NZ,NXT
        CALL ESC:JR Z,MAIN

        XOR A
        RET
;-------
NXT     EI:HALT

        LD A,2
        RET
;---------------------------------------
MC      CALL NOGFX

        LD A,SCR4:CALL MNGCVPL
        LD HL,LOBU,B,#60:CALL LOAD512

        LD A,SCR1:CALL MNG0VPL
        LD HL,LOBU
        LD DE,LOBU+#1800
        CALL TETRA5
        LD A,SCR1+1:CALL MNG0VPL
        LD HL,LOBU+#0800
        CALL TETRA5
        LD A,SCR1+2:CALL MNG0VPL
        LD HL,LOBU+#1000
        CALL TETRA5

        XOR A:LD (FLG+1),A
        LD A,%00000001
        JP SGG
;-------
TETRA5  EXX:LD HL,0
        EXX

        LD B,8
ZZTT5   PUSH BC
        CALL LINE
        LD BC,32
        EX DE,HL:ADD HL,BC
        EX DE,HL:ADD HL,BC
        CALL LINE
        LD BC,32
        EX DE,HL:ADD HL,BC
        EX DE,HL:ADD HL,BC
        CALL LINE
        LD BC,32
        EX DE,HL:ADD HL,BC
        EX DE,HL:ADD HL,BC
        CALL LINE
        LD BC,32
        EX DE,HL:ADD HL,BC
        EX DE,HL:ADD HL,BC
        CALL LINE
        LD BC,32
        EX DE,HL:ADD HL,BC
        EX DE,HL:ADD HL,BC
        CALL LINE
        LD BC,32
        EX DE,HL:ADD HL,BC
        EX DE,HL:ADD HL,BC
        CALL LINE
        LD BC,32
        EX DE,HL:ADD HL,BC
        EX DE,HL:ADD HL,BC
        CALL LINE
        LD BC,32
        EX DE,HL:ADD HL,BC
        EX DE,HL:ADD HL,BC

        POP BC
        DJNZ ZZTT5
        RET

;---------------------------------------
MGX     CALL NOGFX

        LD A,SCR4:CALL MNGCVPL
        LD HL,LOBU,B,#27:CALL LOAD512
        LD A,(LOBU+4)
        CP 1:JP Z,MG1
        CP 2:JP Z,MG2
        CP 4:JP Z,MG4
        CP 8:JP NZ,X1

MG8     ;Just Gigascreen
        LD A,SCR1:CALL MNG0VPL
        LD HL,LOBH,DE,0
        LD BC,#1800:LDIR
        LD HL,LOBH+#1800*2
        LD BC,#0300:LDIR

        LD A,SCR2:CALL MNG0VPL
        LD HL,LOBH+#1800,DE,0
        LD BC,#1800:LDIR
        LD HL,LOBH+#1800*2+#0300
        LD BC,#0300:LDIR
        JP DUAL

MG4     ;MultiGigascreen

        LD A,SCR1:CALL MNG0VPL
        LD HL,LOBH
        LD DE,LOBH+#1800*2
        CALL TETRA
        LD A,SCR1+1:CALL MNG0VPL
        LD HL,LOBH+#0800
        CALL TETRA
        LD A,SCR1+2:CALL MNG0VPL
        LD HL,LOBH+#1000
        CALL TETRA

        LD A,SCR2:CALL MNG0VPL
        LD HL,LOBH+#1800
        LD DE,LOBH+#1800*2+#0600
        CALL TETRA
        LD A,SCR2+1:CALL MNG0VPL
        LD HL,LOBH+#1800+#0800
        CALL TETRA
        LD A,SCR2+2:CALL MNG0VPL
        LD HL,LOBH+#1800+#1000
        CALL TETRA

DUAL2   LD A,1,(FLG+1),A
        LD A,%00000001; 16c
        JP SGG

MG2     ;MultiGigascreen

        LD A,SCR1:CALL MNG0VPL
        LD HL,LOBH
        LD DE,LOBH+#1800*2
        CALL TETRA2
        LD A,SCR1+1:CALL MNG0VPL
        LD HL,LOBH+#0800
        CALL TETRA2
        LD A,SCR1+2:CALL MNG0VPL
        LD HL,LOBH+#1000
        CALL TETRA2

        LD A,SCR2:CALL MNG0VPL
        LD HL,LOBH+#1800
        LD DE,LOBH+#1800*2+#0C00
        CALL TETRA2
        LD A,SCR2+1:CALL MNG0VPL
        LD HL,LOBH+#1800+#0800
        CALL TETRA2
        LD A,SCR2+2:CALL MNG0VPL
        LD HL,LOBH+#1800+#1000
        CALL TETRA2
        JP DUAL2

MG1     ;
        LD A,SCR1:CALL MNG0VPL
        LD HL,LOBH
        LD DE,LOBH+#1800*3
        CALL TETRA3
        LD A,SCR1+1:CALL MNG0VPL
        LD HL,LOBH+#0800
        CALL TETRA3
        LD A,SCR1+2:CALL MNG0VPL
        LD HL,LOBH+#1000
        CALL TETRA3

        LD A,SCR2:CALL MNG0VPL
        LD HL,LOBH+#1800
        LD DE,LOBH+#1800*3+#0180
        CALL TETRA3
        LD A,SCR2+1:CALL MNG0VPL
        LD HL,LOBH+#1800+#0800
        CALL TETRA3
        LD A,SCR2+2:CALL MNG0VPL
        LD HL,LOBH+#1800+#1000
        CALL TETRA3
;-------
        LD A,SCR1:CALL MNG0VPL
        LD HL,LOBH+8
        LD DE,LOBH+#1800*2
        CALL TETRA4
        LD A,SCR1+1:CALL MNG0VPL
        LD HL,LOBH+#0800+8
        CALL TETRA4
        LD A,SCR1+2:CALL MNG0VPL
        LD HL,LOBH+#1000+8
        CALL TETRA4

        LD A,SCR2:CALL MNG0VPL
        LD HL,LOBH+#1800+8
        LD DE,LOBH+#1800*2+#0300*4
        CALL TETRA4
        LD A,SCR2+1:CALL MNG0VPL
        LD HL,LOBH+#1800+#0800+8
        CALL TETRA4
        LD A,SCR2+2:CALL MNG0VPL
        LD HL,LOBH+#1800+#1000+8
        CALL TETRA4

        JP DUAL2
;---------------------------------------
TETRA3  EXX:LD HL,0
        EXX

        LD B,8
ZZTT3   PUSH BC
        PUSH HL
.8      CALL LINE1:INC H
        EX DE,HL:LD BC,16:ADD HL,BC
        EX DE,HL
        POP HL

        LD BC,32:ADD HL,BC
        POP BC
        DJNZ ZZTT3
        RET
;-------
LINE1   PUSH HL,DE

LIN1    LD A,(DE)
        AND %00000111
        LD B,A

        LD A,(DE)
.3      RRA
        AND %00000111
        LD C,A

        LD A,(DE)
        BIT 6,A:JR Z,CU1
        SET 3,B
        SET 3,C

CU1     LD A,(HL)
        PUSH BC:EXX
        POP BC:LD E,A:CALL BYTE2F:EXX

        INC L,E
        LD A,L:AND %00011111
        CP 8:JR NZ,CUZ
        LD A,L:ADD A,16:LD L,A
        EXX:LD BC,64:ADD HL,BC
        EXX
CUZ     LD A,L:AND %00011111:JP NZ,LIN1

        EXX:INC H:LD L,0
        EXX

        POP DE,HL
        RET
;-------
TETRA4  EXX:LD HL,8*4
        EXX

        LD B,8
ZZTT4   PUSH BC
        PUSH HL
        CALL LINE2:INC H
        EX DE,HL:LD BC,16:ADD HL,BC
        EX DE,HL
        CALL LINE2:INC H
        EX DE,HL:LD BC,16:ADD HL,BC
        EX DE,HL
        CALL LINE2:INC H
        EX DE,HL:LD BC,16:ADD HL,BC
        EX DE,HL
        CALL LINE2:INC H
        EX DE,HL:LD BC,16:ADD HL,BC
        EX DE,HL
        CALL LINE2:INC H
        EX DE,HL:LD BC,16:ADD HL,BC
        EX DE,HL
        CALL LINE2:INC H
        EX DE,HL:LD BC,16:ADD HL,BC
        EX DE,HL
        CALL LINE2:INC H
        EX DE,HL:LD BC,16:ADD HL,BC
        EX DE,HL
        CALL LINE2:INC H
        EX DE,HL:LD BC,16:ADD HL,BC
        EX DE,HL
        POP HL

        LD BC,32:ADD HL,BC
        POP BC
        DJNZ ZZTT4
        RET
;-------
LINE2   PUSH HL,DE

LIN2    LD A,(DE)
        AND %00000111
        LD B,A

        LD A,(DE)
.3      RRA
        AND %00000111
        LD C,A

        LD A,(DE)
        BIT 6,A:JR Z,CU2
        SET 3,B
        SET 3,C

CU2     LD A,(HL)
        PUSH BC:EXX
        POP BC:LD E,A:CALL BYTE2F:EXX

        INC L,E
        LD A,L:AND %00011111
        CP 24:JP C,LIN2

        EXX:INC H:LD L,8*4
        EXX

        POP DE,HL
        RET
;---------------------------------------
TETRA2  EXX:LD HL,0
        EXX

        LD B,8
ZZTT2   PUSH BC
        PUSH HL
.2      CALL LINE:INC H
        EX DE,HL:LD BC,32:ADD HL,BC
        EX DE,HL
.2      CALL LINE:INC H
        EX DE,HL:LD BC,32:ADD HL,BC
        EX DE,HL
.2      CALL LINE:INC H
        EX DE,HL:LD BC,32:ADD HL,BC
        EX DE,HL
.2      CALL LINE:INC H
        EX DE,HL:LD BC,32:ADD HL,BC
        EX DE,HL
        POP HL

        ADD HL,BC
        POP BC
        DJNZ ZZTT2
        RET
;-------
TETRA   EXX:LD HL,0
        EXX

        LD B,8
ZZTT    PUSH BC
        PUSH HL
.4      CALL LINE:INC H
        EX DE,HL:LD BC,32:ADD HL,BC
        EX DE,HL
.4      CALL LINE:INC H
        EX DE,HL:LD BC,32:ADD HL,BC
        EX DE,HL
        POP HL

        ADD HL,BC
        POP BC
        DJNZ ZZTT
        RET
;-------
LINE    PUSH HL,DE

LIN     LD A,(DE)
        AND %00000111
        LD B,A

        LD A,(DE)
.3      RRA
        AND %00000111
        LD C,A

        LD A,(DE)
        BIT 6,A:JR Z,CU
        SET 3,B
        SET 3,C

CU      LD A,(HL)

        PUSH BC
        EXX
        POP BC

        LD E,A
        LD A,B:SLA E:JR C,$+3:LD A,C
        RLD
        LD A,B:SLA E:JR C,$+3:LD A,C
        RLD:INC L

        LD A,B:SLA E:JR C,$+3:LD A,C
        RLD
        LD A,B:SLA E:JR C,$+3:LD A,C
        RLD:INC L

        LD A,B:SLA E:JR C,$+3:LD A,C
        RLD
        LD A,B:SLA E:JR C,$+3:LD A,C
        RLD:INC L

        LD A,B:SLA E:JR C,$+3:LD A,C
        RLD
        LD A,B:SLA E:JR C,$+3:LD A,C
        RLD:INC L
        EXX

        INC L,E
        LD A,E:AND %00011111:JP NZ,LIN

        EXX:INC H:LD L,0
        EXX

        POP DE,HL
        RET

BYTE2F  ;i:HL - 16c data
;           E - ZX SCR byte
;           B - Ink On  %0000XXXX
;           C - Ink Off %0000XXXX

        LD A,B:SLA E:JR C,$+3:LD A,C
        RLD
        LD A,B:SLA E:JR C,$+3:LD A,C
        RLD:INC L

        LD A,B:SLA E:JR C,$+3:LD A,C
        RLD
        LD A,B:SLA E:JR C,$+3:LD A,C
        RLD:INC L

        LD A,B:SLA E:JR C,$+3:LD A,C
        RLD
        LD A,B:SLA E:JR C,$+3:LD A,C
        RLD:INC L

        LD A,B:SLA E:JR C,$+3:LD A,C
        RLD
        LD A,B:SLA E:JR C,$+3:LD A,C
        RLD:INC L
        RET
;---------------------------------------
GOPAL   LD A,SCR4:CALL MNGCVPL

        LD A,16
        LD DE,#C000
GPAL    LD HL,PAL_ZX,BC,32:LDIR
        DEC A:JR NZ,GPAL

        LD B,SCR4,HL,0
        LD C,0,DE,0
        LD A,#00:CALL DMA_PL

        LD BC,#00FF,A,#07:CALL DMA_PL

        LD A,#F9:CALL DMA_PL
        RET
;---------------------------------------
YAYA    LD A,1:INC A:CALL MNGV_PL
        LD A,(YAYA+1):XOR 1
        LD (YAYA+1),A
        RET
;-------
X1      LD A,1
        RET
;-------
INIT    LD A,SCR4:CALL MNGCVPL
        RET

EXTCHE  CALL TENTRY
_LD HL,ENTRY+8,DE,XMG1:CALL TN:RET Z
_LD HL,ENTRY+8,DE,XMG2:CALL TN:RET Z
_LD HL,ENTRY+8,DE,XMG4:CALL TN:RET Z
_LD HL,ENTRY+8,DE,XMG8

TN
_LD A,(DE):CP (HL):RET NZ:INC HL,DE
_LD A,(DE):CP (HL):RET NZ:INC HL,DE
_LD A,(DE):CP (HL):RET

;---------------------------------------
NOGFX   LD A,%00110000:JP GVmod
;---------------------------------------
PRWOW   LD A,1:JP WLD
RRESB   LD A,2:JP WLD
PRSRW   LD A,3:JP WLD
PRIAT   EXA:LD A,4:JP WLD

DMA_PL  EXA:LD A,13:JP WLD

GEDPL   LD A,15:JP WLD
;-------
ENKE    LD A,22:JP WLD
ESC     LD A,23:JP WLD
;-------
LOAD512 LD A,48:JP WLD

TENTRY  LD DE,ENTRY,A,51:JP WLD
;-------
MNGV_PL EXA:LD A,64:JP WLD

MNG0VPL EXA:LD A,80:JP WLD
MNG8VPL EXA:LD A,81:JP WLD
MNGCVPL EXA:LD A,65:JP WLD
;-------
GVmod   EXA:LD A,66:JP WLD

GYoff   LD A,67:JP WLD
GXoff   LD A,68:JP WLD
;---------------------------------------
PAL_ZX  DW #0000,#0010,#4000,#4010
        DW #0200,#0210,#4200,#4210
        DW #0000,#0018,#6000,#6018
        DW #0300,#0318,#6300,#6318

XMG1    DB "MG1"
XMG2    DB "MG2"
XMG4    DB "MG4"
XMG8    DB "MG8"
;---------------------------------------
ENTRY   DS 32

DAHL    DS 2
DADE    DS 2

ESTAT   NOP
;---------------------------------------
