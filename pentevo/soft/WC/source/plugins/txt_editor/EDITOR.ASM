;IlichEditor v0.1
;(C) BUDDER/MGN 2015
;---------------------------------------
HEADER  EQU #6000
BINAR   EQU HEADER+512
;-------
        ORG HEADER
;-------
WLD     EQU #6006
TMN     EQU #6009;Timer
;-------
DFCOL   EQU %00010111;Default Color

LNZ     EQU 1
PGZ     EQU 0
PGM     EQU #3F
;---------------------------------------
;HEADER:
        DS 16
        DB "WildCommanderMDL";    Header
        DB #06;                  Version
        DB 0;                       Type
        DB 2; Pages
        DB 0; Page to #8000
;-------
        DB 0,8;    CODE

.5      DB 0,0
;-------
        DS 16
;-------
        DS 32*3
;-------
        DB 0
;-------
        DW #FFFE,#000F; MAX SIZE
;-------
        DB "TXT Editor v0.1 "
        DB "                "
;-------
        DB #14,"Edit  "
;---------------------------------------
        ORG #8000,BINAR
;-------
ENTRYN  EQU #A100
FLLOAD  EQU ENTRYN-1
FLMAKE  EQU ENTRYN-5

WHEAD   EQU ENTRYN+512
;---------------------------------------
PLUGIN  LD (DAHL),HL,(DADE),DE
        XOR A
        LD (ESTA),A
        LD (CHANGES),A

        LD HL,BC
        LD DE,ENTRYN
        LD BC,256:LDIR

        CALL LOAD

        CALL GEDPL
        LD IX,PLWND:CALL PRWOW

        CALL NAMETOH

        XOR A
        LD (CRX),A
        LD (PGHLP+2),A
        LD (LNHLP+2),A
        LD (LHLCR+2),A
        LD HL,0
        LD (PGHLP),HL
        LD (LNHLP),HL
        LD (LHLCR),HL

        CALL REFRESH
        LD HL,#0100,A,#FE:CALL ISTR
MAIN    EI:HALT
        LD A,#FC:CALL ISTR,STUPD
        LD A,#03:CALL ISTR

        CALL CTRL:JR Z,NOAD
        LD A,1:CALL KBSCN
        CP "s":CALL Z,QSAVE
        JR MAIN

NOAD    CALL HOME,NZ,SSQ
        CALL END,NZ,SSE

        CALL ENKE,NZ,GO0D
        CALL BSPC,NZ,BSPACE
        CALL DEL,NZ,DELETE
;-------
        XOR A:CALL KBSCN,NZ,SMBADD

        CALL LFFF,NZ,GOLF
        CALL RGGG,NZ,GORG
        CALL UPPP,NZ,GOUP
        CALL DWWW,NZ,GODW

        CALL ESC:JR Z,MAIN
;-------
EXIT    CALL SAVECH
        CALL RRESB
        LD A,(ESTA)
        RET
;-------
GOUP    CALL CRM13U
        CALL CRM13U,C,INCCUR
        LD A,(CRX):CALL CRMFWD
        LD A,(CRP+1)
        CP LNZ:CALL Z,PGMUZ
        JP REFRESH
;-------
GODW    CALL CRM13D:JR NC,GOD
        LD A,(CRX):CALL CRMFWD
        LD A,(CRP+1):INC A,A
        CP (IX+5):CALL NC,PGMD
GOD     JP REFRESH
;-------
GOLF    LD HL,(CRP)
        LD A,H:CP LNZ:JR NZ,GOlf
        LD A,L:OR A:CALL Z,PGMUZ

GOlf    CALL DECCUR
        CALL REFRESH
        LD A,(CRP),(CRX),A
        RET
;-------
GORG    LD A,(CRP):CP 80-1:RET NC
        LD A,(CRP+1):INC A,A
        CP (IX+5):CALL NC,GOrg

        CALL INCCUR
        CALL REFRESH
        LD A,(CRP),(CRX),A
        RET

GOrg    CALL INCCUR:RET NC
        PUSH AF:CALL DECCUR
        POP AF:CP #0D+1:RET NC
        JP PGMD
;-------
GO0D    LD A,#0D:CALL INCLCR:RET NC

        LD A,(CRP+1):INC A,A
        CP (IX+5):CALL NC,PGMD
        CALL REFRESH
        LD A,(CRP),(CRX),A
        JP CHA
;-------
SMBADD  LD BC,(INOV):BIT 0,C:JR Z,INSM
        PUSH AF:CALL INCCUR
        POP BC:RET NC
        CP #0D+1:LD A,B:JR C,OVRM
        CALL DECLCRN
        CALL REFRESH
        LD A,(CRP),(CRX),A
        JP CHA
OVRM    PUSH AF:CALL DECCUR
        POP AF
INSM    CALL INCLCR
        CALL REFRESH
        LD A,(CRP),(CRX),A
        JP CHA
;-------
SSQ     CALL CRM13U,C,INCCUR
        CALL REFRESH
        LD A,(CRP),(CRX),A
        RET
SSE     CALL CRM13D,C,DECCUR
        CALL REFRESH
        LD A,(CRP),(CRX),A
        RET
;-------
DELETE  CALL INCRCR,REFRESH:JP CHA
BSPACE  CALL DECLCR:RET NC
        LD HL,(CRP)
        LD A,H:CP LNZ:JR NZ,Bspc
        LD A,L:OR A:CALL Z,PGMUZ
Bspc    CALL REFRESH
        LD A,(CRP),(CRX),A
        JP CHA
;-------
STUPD   AND %10000000:RLCA:LD (INOV),A
        RET
;-------
CHA     LD A,1,(CHANGES),A:RET
;---------------------------------------
REFRESH
;---------------------------------------
PAGE    LD A,(PGHLP+2),(LNHLP+2),A
        LD HL,(PGHLP),(LNHLP),HL

        LD HL,#0000+LNZ*256,(XY),HL
MARA    CALL LINE
        LD HL,XY+1:INC (HL)
        LD A,(HL):INC A
        CP (IX+5):JP C,MARA
        RET
;---------------------------------------
LNE22   JP LNE2
;-------
LINE    ;i: LNHLP - Offset(2) + Page(1)

        LD HL,0,(CRPOZ),HL
        LD A,(LNHLP+2):CALL MNG0VPL

        LD DE,(XY):CALL GADRW:EX DE,HL
BROOT   LD HL,(LNHLP),BC,(LHLCR),B,#0D+1

BROO    LD A,C:CP L:JR Z,RYZ
RAZ     LD A,(HL):CP B:JR C,LNE22
ROZ     BIT 7,E:JR NZ,IGLN
        LD (DE),A:INC E
IGLN    INC HL
        LD A,H:CP #40:JR NC,CRASHX

        LD A,C:CP L:JR Z,RYZ
        LD A,(HL):CP B:JR C,LNE2
        BIT 7,E:JR NZ,IGLN2
        LD (DE),A:INC E
IGLN2   INC HL
        LD A,H:CP #40:JR NC,CRASHX
        JP BROO

RYZ     LD A,(LHLCR+1):CP H:JP NZ,RAZ
        LD A,(LNHLP+2),C,A
        LD A,(LHLCR+2):CP C:JR NZ,RAZ

        PUSH DE
        LD HL,RHLCR,DE,LNHLP
.3      LDI
        CALL INCLN
        PUSH AF
        LD A,(LNHLP+2):CALL MNG0VPL
        POP AF
        POP DE
        LD (CRPOZ),DE
        LD (CRP),DE
        LD A,(XY+1),(CRP+1),A
        LD HL,(LNHLP),BC,(LHLCR),B,#0D+1
        LD A," ":JP NC,ROZ
        JP RAZ

CRASHX  AND %00111111:LD H,A
        LD A,(LNHLP+2):INC A
        CP PGM+1:JR NC,LNE1
        LD (LNHLP+2),A
        LD (LNHLP),HL
        PUSH DE:CALL MNG0VPL
        POP DE
        JP BROOT

LNE1    DEC HL
        LD A,H:AND %00111111:LD H,A
LNE2    LD (LNHLP),HL
        PUSH DE:CALL INCLN
        POP HL

        CALL ESTRCLR
;-------
PRINT   LD E,%10000000
        CALL COLORS
        CALL CURTAT
        RET

;---------------------------------------
COLORS  EX DE,HL
        PUSH HL
        LD A,DFCOL
.80     LD (HL),A:INC L
        POP BC
        RET
;-------
CURTAT  LD HL,(CRPOZ):LD A,H:OR L:RET Z
        BIT 7,L:RET NZ
        SET 7,L
        LD A,(HL):RRD
        RET
;-------
ESTRCLR LD A,80
        LD C," "
.80     CP L:RET C:LD (HL),C:INC L
        RET
;---------------------------------------
PGMD    LD A,(PGHLP+2):CALL MNG0VPL
PGmd    CALL INCPG:RET NC
        LD A,E:CP #0D+1:JR NC,PGmd
        RET

PGMUZ   CALL PGMU
        CALL PGMU,C,INCPG
        RET

PGMU    LD A,(PGHLP+2):CALL MNG0VPL
        LD HL,(PGHLP)
PGmu    DEC HL
        LD A,H:CP #40:JR NC,ILYA2
GILIAN  LD A,(HL):CP #0D+1:JP NC,PGmu
        LD (PGHLP),HL
        RET

ILYA2   INC HL:LD (PGHLP),HL
        DEC HL
        AND %00111111:LD H,A
        LD A,(PGHLP+2)
        CP PGZ:RET Z:DEC A
        LD (PGHLP+2),A
        LD (PGHLP),HL
        PUSH HL,DE:CALL MNG0VPL
        POP DE,HL
        JP GILIAN


;---------------------------------------
FAST    AND %00111111:LD H,A
        LD A,(RHLCR+2):INC A
        CP PGM+1:RET NC
        LD (RHLCR+2),A
        PUSH HL:CALL MNGCVPL
        POP HL
        JP FASTB

CRM13D  LD A,(LHLCR+2):CALL MNG0VPL
        LD A,(RHLCR+2):CALL MNGCVPL

CR13D   LD HL,(RHLCR):INC HL
        LD A,H:CP #40:JR NC,FAST
FASTB   LD (RHLCR),HL
;-------
        LD HL,(RHLCR)
        SET 7,H
        SET 6,H
        LD A,(HL)
        LD HL,(LHLCR)
        LD (HL),A
;-------
        PUSH AF
        LD HL,(LHLCR):INC HL
        LD A,H:CP #40:JR NC,FAST2
FAST2B  LD (LHLCR),HL
        POP AF
        CP #0D+1:JP NC,CR13D
        RET
;-------
FAST2   AND %00111111:LD H,A
        LD A,(LHLCR+2):INC A
        LD (LHLCR+2),A
        PUSH HL:CALL MNG0VPL
        POP HL
        JP FAST2B

;---------------------------------------
FAZT    AND %00111111:LD H,A
        LD A,(LHLCR+2)
        CP PGZ:RET Z:DEC A
        LD (LHLCR+2),A
        PUSH HL:CALL MNG0VPL
        POP HL
        JP FAZTB

CRM13U  LD A,(LHLCR+2):CALL MNG0VPL
        LD A,(RHLCR+2):CALL MNGCVPL

CR13U   LD HL,(LHLCR):DEC HL
        LD A,H:CP #40:JR NC,FAZT
FAZTB   LD (LHLCR),HL
;-------
        LD HL,(LHLCR)
        LD A,(HL)
        LD HL,(RHLCR)
        SET 7,H
        SET 6,H
        LD (HL),A
;-------
        PUSH AF
        LD HL,(RHLCR):DEC HL
        LD A,H:CP #40:JR NC,FAZT2
FAZT2B  LD (RHLCR),HL
        POP AF
        CP #0D+1:JP NC,CR13U
        RET
;-------
FAZT2   AND %00111111:LD H,A
        LD A,(RHLCR+2):DEC A
        LD (RHLCR+2),A
        PUSH HL:CALL MNGCVPL
        POP HL
        JP FAZT2B

;---------------------------------------
CRMFWD  OR A:RET Z
        LD B,A
CRFWD   PUSH BC:CALL INCCUR
        POP BC:RET NC
        CP #0D+1:JP C,DECCUR
        DJNZ CRFWD
        SCF
        RET
;---------------------------------------
INCLN   LD HL,(LNHLP):INC HL
        LD A,H:CP #40:JR NC,CRASH
        LD (LNHLP),HL
        SCF
        RET

CRASH   AND %00111111:LD H,A
        LD A,(LNHLP+2):INC A
        CP PGM+1:RET NC
        LD (LNHLP+2),A
        LD (LNHLP),HL
        SCF
        RET
;---------------------------------------
INCPG   LD HL,(PGHLP),E,(HL):INC HL
        LD A,H:CP #40:JR NC,ILYA
        LD (PGHLP),HL
        SCF
        RET

ILYA    AND %00111111:LD H,A
        LD A,(PGHLP+2):INC A
        CP PGM+1:RET NC
        LD (PGHLP+2),A
        LD (PGHLP),HL
        PUSH DE:CALL MNG0VPL
        POP DE
        SCF
        RET
;---------------------------------------
INCLCR  PUSH AF
        LD A,(LHLCR+2):CALL MNG0VPL
        POP DE
        LD HL,(LHLCR),(HL),D:INC HL
        LD A,H:CP #40:JR NC,GRAD
        LD A,(LHLCR+2)
GRADB   LD DE,(RHLCR)
        PUSH HL:OR A:SBC HL,DE
        POP HL:JR NZ,LEQR
        LD BC,(RHLCR+2):CP C:RET Z

LEQR    LD (LHLCR+2),A
        LD (LHLCR),HL
        SCF
        RET
;-------
GRAD    AND %00111111:LD H,A
        LD A,(LHLCR+2):INC A
        JP GRADB
;---------------------------------------
DECLCRN LD C,A
        LD HL,(LHLCR):DEC HL
        LD A,H:CP #40:JR NC,NULL
        LD A,(LHLCR+2)
NULLB   PUSH HL,BC:CALL MNG0VPL
        POP BC,HL
        LD (HL),C
        SCF
        RET
NULL    AND %00111111:LD H,A
        LD A,(LHLCR+2)
        CP PGZ:RET Z:DEC A
        JP NULLB
;---------------------------------------
DECLCR  LD HL,(LHLCR):DEC HL
        LD A,H:CP #40:JR NC,CRASX
CRASXB  LD (LHLCR),HL
        SCF
        RET
CRASX   AND %00111111:LD H,A
        LD A,(LHLCR+2)
        CP PGZ:RET Z:DEC A
        LD (LHLCR+2),A
        JP CRASXB
;-------
INCRCR  LD HL,(RHLCR):INC HL
        LD A,H:CP #40:JR NC,GRADX
GRADXB  LD (RHLCR),HL
        SCF
        RET
GRADX   AND %00111111:LD H,A
        LD A,(RHLCR+2):INC A
        CP PGM+1:RET NC
        LD (RHLCR+2),A
        JP GRADXB

;---------------------------------------
CRAS    AND %00111111:LD H,A
        LD A,(LHLCR+2)
        CP PGZ:RET Z:DEC A
        LD (LHLCR+2),A
        JP CRASB

DECCUR  LD HL,(LHLCR):DEC HL
        LD A,H:CP #40:JR NC,CRAS
CRASB   LD (LHLCR),HL
;-------
        LD A,(LHLCR+2)
;CALL MNG0VPL:
        EXA:LD A,80:CALL WLD

        LD HL,(LHLCR)
        LD A,(HL)
        PUSH AF
        LD A,(RHLCR+2)
;CALL MNG0VPL:
        EXA:LD A,80:CALL WLD

        LD HL,(RHLCR)
        POP AF
        LD (HL),A
;-------
        EXA
        LD HL,(RHLCR):DEC HL
        LD A,H:CP #40:JR NC,CRASh
CRAShB  LD (RHLCR),HL
        EXA
        SCF
        RET
;-------
CRASh   AND %00111111:LD H,A
        LD A,(RHLCR+2):DEC A
        LD (RHLCR+2),A
        JP CRAShB
;---------------------------------------
CRASH2  AND %00111111:LD H,A
        LD A,(RHLCR+2):INC A
        CP PGM+1:RET NC
        LD (RHLCR+2),A
        JP CRASH2B

INCCUR  LD HL,(RHLCR):INC HL
        LD A,H:CP #40:JR NC,CRASH2
CRASH2B LD (RHLCR),HL
;-------
        LD A,(RHLCR+2)
;CALL MNG0VPL:
        EXA:LD A,80:CALL WLD

        LD HL,(RHLCR)
        LD A,(HL)
        PUSH AF
        LD A,(LHLCR+2)
;CALL MNG0VPL:
        EXA:LD A,80:CALL WLD

        LD HL,(LHLCR)
        POP AF
        LD (HL),A
;-------
        EXA
        LD HL,(LHLCR):INC HL
        LD A,H:CP #40:JR NC,CRASh2
CRASh2B LD (LHLCR),HL
        EXA
        SCF
        RET
;-------
CRASh2  AND %00111111:LD H,A
        LD A,(LHLCR+2):INC A
        LD (LHLCR+2),A
        JP CRASh2B
;---------------------------------------
LOAD    CALL LOADFL

        LD HL,(DAHL)
        LD DE,(DADE)
        CALL LNT3
        LD (SHLA+2),A
        LD (SHLA),HL

        LD A,PGM,(DHLA+2),A
        LD HL,#3FFF,(DHLA),HL

        LD HL,(DAHL)
        LD DE,(DADE)
        CALL LDDRR
        LD A,(DHLA+2),(RHLCR+2),A
        LD HL,(DHLA),(RHLCR),HL

        XOR A:LD (LHLCR+2),A
        LD HL,0,(LHLCR),HL
        RET
;-------
LOADFL  XOR A:LD (APG),A

LFL     LD A,(APG):CALL MNGCVPL
        LD HL,#C000,B,32:CALL LOAD512
        CP #0F:RET Z

        LD HL,APG:INC (HL)
        LD A,(HL):CP PGM+1:RET NC
        JR LFL

;---------------------------------------
LDDRR   ;i: [DE,HL] - Lenght
;              SHLA - Source
;              DHLA - Dest

        LD A,L:OR H,E,D:RET Z
        LD (LHLA),HL
        LD (LHLA+2),DE

DDRR    LD A,(LHLA+3):OR A:RET NZ
        LD A,(SHLA+2):CALL MNG0VPL
        LD A,(DHLA+2):CALL MNGCVPL
        LD HL,(SHLA)
        LD DE,(DHLA)
        PUSH HL:OR A:SBC HL,DE
        POP HL:LD BC,HL
        JR C,$+4:LD BC,DE
        INC BC

        PUSH HL,DE
        LD DE,(LHLA+2)
        LD HL,(LHLA)
        OR A:SBC HL,BC:JR NC,$+3:DEC DE
        LD A,D:OR E,H,L:JR NZ,$+4:LD D,1

        LD (LHLA+2),DE
        LD (LHLA),HL
        LD A,D:OR A:JR Z,CRH
        ADD HL,BC:LD BC,HL
CRH     POP DE,HL

        LD A,D:AND %00111111:OR #C0
        LD D,A
        LDDR

        LD A,D
        CP #C0:JR NC,MGN
        EXA
        LD A,(DHLA+2):DEC A
        LD (DHLA+2),A
        EXA
MGN     AND %00111111
        LD D,A

        LD A,H
        CP #40:JR C,MGN2
        AND %00111111
        LD H,A
        LD A,(SHLA+2):DEC A
        LD (SHLA+2),A

MGN2    LD (SHLA),HL
        LD (DHLA),DE
        JP DDRR

;---------------------------------------
LDIRR   ;i: [DE,HL] - Lenght
;              SHLA - Source
;              DHLA - Dest

        LD A,L:OR H,E,D:RET Z
        LD (LHLA),HL
        LD (LHLA+2),DE

DIRR    LD A,(LHLA+3):OR A:RET NZ
        LD A,(SHLA+2):CALL MNG0VPL
        LD A,(DHLA+2):CALL MNGCVPL
        LD HL,(SHLA)
        LD DE,(DHLA)
        PUSH HL:OR A:SBC HL,DE
        POP HL:LD BC,HL
        JR NC,$+4:LD BC,DE

        PUSH HL,DE
        LD HL,#4000:OR A:SBC HL,BC
        LD BC,HL

        LD DE,(LHLA+2)
        LD HL,(LHLA)
        OR A:SBC HL,BC:JR NC,$+3:DEC DE
        LD A,D:OR E,H,L:JR NZ,$+4:LD D,1

        LD (LHLA+2),DE
        LD (LHLA),HL
        LD A,D:OR A:JR Z,CRH2
        ADD HL,BC:LD BC,HL
CRH2    POP DE,HL

        LD A,D:AND %00111111:OR #C0
        LD D,A
        LDIR

        LD A,D
        CP #C0:JR NC,MGNI
        EXA
        LD A,(DHLA+2):INC A
        LD (DHLA+2),A
        EXA
MGNI    AND %00111111
        LD D,A

        LD A,H
        CP #40:JR C,MGNI2
        AND %00111111
        LD H,A
        LD A,(SHLA+2):INC A
        LD (SHLA+2),A

MGNI2   LD (SHLA),HL
        LD (DHLA),DE
        JP DIRR
;---------------------------------------
SAVECH  LD A,(CHANGES):OR A:RET Z

        PUSH IX
        LD IX,WMWND:CALL PRWOW
        LD HL,ME01,DE,#0100:CALL TXTPR

        LD A,#01:CALL YN
SDM     EI:HALT
        XOR A:CALL YN
        CALL ENKE:JR Z,SDM

        CALL RRESB
        LD A,#FF:CALL YN:JR NZ,NOCH

        CALL QSAVE
NOCH    POP IX
        RET
;---------------------------------------
LNT3    ;i: [DE,HL] - File Lenght
;        o:      HL - Offset in Page
;                 A - Page

        LD BC,1
        OR A:SBC HL,BC:JR NC,$+3:DEC DE

        LD A,H
.2      SLA A:RL E

        LD A,H:AND %00111111
        LD H,A
        LD A,E
        RET
;---------------------------------------
PRTOSV  CALL NORMFL
        LD A,(DHLA+2)
        LD BC,(DHLA)
        CALL YORGE
        RET

YORGE   PUSH BC
        LD HL,0,DE,HL
        OR A:LD BC,#4000:CALL NZ,YOYO
        POP BC
        ADD HL,BC:JR NC,$+3:INC DE
        RET
YOYO    ADD HL,BC:JR NC,$+3:INC DE
        DEC A:JR NZ,YOYO
        RET

;---------------------------------------
TOWORK  CALL DECSRC
        LD HL,(DHLA)
        LD A,(DHLA+2)

        PUSH HL
        LD HL,SHLA
        LD DE,DHLA
        LD BC,3:LDIR
        POP HL

        LD (SHLA),HL
        LD (SHLA+2),A
        CALL DECSRC

        LD HL,(LHLB)
        LD DE,(LHLB+2)
        CALL LDDRR
        RET

DECSRC  LD HL,(SHLA):DEC HL
        LD A,H:CP #40:JR NC,GRDX
GRDXB   LD (SHLA),HL
        RET
GRDX    AND %00111111:LD H,A
        LD A,(SHLA+2):DEC A
        CP PGM+1:RET NC
        LD (SHLA+2),A
        JP GRDXB

;---------------------------------------
NORMFL  CALL RCRTD
        CALL INCRCR

        LD HL,LHLCR,DE,DHLA,BC,3:LDIR
        LD HL,RHLCR,DE,SHLA,C,3:LDIR

        LD BC,(SHLA+2)
        LD A,PGM:SUB C
        LD BC,(SHLA)
        LD HL,#4000:OR A:SBC HL,BC
        LD BC,HL
        CALL YORGE

        LD (LHLB),HL
        LD (LHLB+2),DE
        CALL LDIRR
        CALL DCRTR
        RET

RCRTD   LD HL,RHLCR,DE,RHLCR2,BC,3:LDIR
        RET
DCRTR   LD HL,RHLCR2,DE,RHLCR,BC,3:LDIR
        RET
;---------------------------------------
NAMETOH LD HL,WHEAD,DE,HL:INC DE
        LD BC,80,(HL),32:LDIR

        LD HL,ENTRYN
        LD DE,WHEAD
        LD B,80-10
NMTHD   LD A,(HL):CP 32:JR C,BAX
        LD (DE),A:INC HL,DE
        DJNZ NMTHD

BAX     LD HL,WHEAD
        LD DE,#0006
        LD BC,80-16:CALL PRSRW
        RET

;---------------------------------------
QSAVE   PUSH IX
        LD IX,SVWND:CALL PRWOW

        CALL PRTOSV
        LD (DAHL),HL
        LD (DADE),DE

        LD HL,FLLOAD,(HL),#00
        CALL DELFL:JR Z,NFER

        LD HL,(DAHL),(FLMAKE+1+0),HL
        LD HL,(DADE),(FLMAKE+1+2),HL
        LD HL,FLMAKE,(HL),#00
        CALL MKFILE:JR NZ,MKER
        CALL SAVEDAT

        LD A,3,(ESTA),A
        XOR A:LD (CHANGES),A
BTZF    CALL TOWORK
        CALL RRESB
        POP IX
        CALL REFRESH
        XOR A
        RET
;-------
NFER
MKER    PUSH IX
        LD IX,ERWND:CALL PRWOW
        CALL USPO
        CALL NUSP
        CALL RRESB
        POP IX
        JR BTZF
;---------------------------------------
SAVEDAT LD A,PGZ,(SVD+1),A
        LD HL,#C000

SVD     LD A,0
        PUSH HL
        CALL MNGCVPL
        LD HL,SVD+1:INC (HL)
        POP HL
        LD B,32:CALL SAVE512
        CP #0F:RET Z
        LD BC,(LHLCR+2)
        LD A,(SVD+1):CP C:RET NC
        JP SVD
;---------------------------------------
MNGC_PL EXA:LD A,0:JP WLD
MNG0_PL EXA:LD A,78:JP WLD
MNG8_PL EXA:LD A,79:JP WLD
PRWOW   LD A,1:JP WLD
RRESB   LD A,2:JP WLD
PRSRW   LD A,3:JP WLD
PRIAT   EXA:LD A,4:JP WLD
GADRW   LD A,5:JP WLD
CURSOR  LD A,6:JP WLD
CURSER  LD A,7:JP WLD
YN      EXA:LD A,8:JP WLD
ISTR    EXA:LD A,9:JP WLD

NORK    EXA:LD A,10:JP WLD
TXTPR   LD A,11:JP WLD
DMAPL   EXA:LD A,13:JP WLD
GEDPL   LD A,15:JP WLD
;-------
KBSCN   EXA:LD A,42:JP WLD

SPKE    LD A,16:JP WLD
UPPP    LD A,17:JP WLD
DWWW    LD A,18:JP WLD
LFFF    LD A,19:JP WLD
RGGG    LD A,20:JP WLD
TABK    LD A,21:JP WLD
ENKE    LD A,22:JP WLD
BSPC    LD A,24:JP WLD
DEL     LD A,43:JP WLD
ESC     LD A,23:JP WLD
HOME    LD A,27:JP WLD
END     LD A,28:JP WLD
F1      LD A,29:JP WLD
F5      LD A,33:JP WLD
F10     LD A,38:JP WLD
ALT     LD A,39:JP WLD
SHIFT   LD A,40:JP WLD
CTRL    LD A,41:JP WLD
USPO    LD A,46:JP WLD
NUSP    LD A,47:JP WLD
;-------
LOAD512 LD A,48:JP WLD
LOAD256 LD A,60:JP WLD
LOADNON LD A,61:JP WLD

SAVE512 LD A,49:JP WLD
FENTRY  LD A,59:JP WLD
GFILE   LD A,62:JP WLD
MKFILE  LD A,72:JP WLD
DELFL   LD A,75:JP WLD
;-------
MNGV_PL EXA:LD A,64:JP WLD
MNGCVPL EXA:LD A,65:JP WLD
MNG0VPL EXA:LD A,80:JP WLD
GVmod   EXA:LD A,66:JP WLD
GYoff   LD A,67:JP WLD
GXoff   LD A,68:JP WLD
;---------------------------------------
PLWND   DB 2,0
        DB 0,0;      X,Y
        DB 80,0;     W,H
        DB %00010111;PAPER+INK
        DB 0
        DW #0000;    BUFFER
        DB 0,0;      LINES

        DB 1,5;        CURnow,CURmax
        DB %11110001,0;CURcolor

        DW TAPT
        DW TAPB
        DW 0
;-------
TAPT    DB #08,#01
        DB "File:               "
        DB "                    "
        DB "                    "
        DB "                    "
        DB 0

TAPB    DB #08,#01
        DB "                    "
        DB "                    "
        DB "                    "
        DB "                    "
        DB 0
;-------
SVWND   DB 1,0
        DB 29,13;    X,Y
        DB 20+2,1+2; W,H
        DB %01111111;PAPER+INK
        DB 0
        DW #0000;    BUFFER
        DB 0,0;      LINES

        DW 0
        DW 0
        DW SAVINGM

SAVINGM DB #0E,"Saving...",0
;-------
WMWND   DB 1,0
        DB 21,12;    X,Y
        DB 40+2,4+2; W,H
        DB %01111111;PAPER+INK
        DB 0
        DW #0000;    BUFFER
        DB 2,0;      LINES

        DW WARNING
        DW 0
        DW 0

WARNING DB #09,#0E,"WARNING!",0
;-------
ERWND   DB 1,0
        DB 21,13;    X,Y
        DB 40+2,2+2; W,H
        DB %00111111;PAPER+INK
        DB 0
        DW #0000;    BUFFER
        DB 0,0;      LINES

        DW ERT
        DW ERB
        DW 0

ERT     DB #09,#0E,"ERROR:",0
ERB     DB #09,#0E,"press any key",0
;---------------------------------------
ME01    DB #0E,"Save changes?",0
;---------------------------------------
ESTA    NOP
CHANGES NOP

;file-size
DAHL    DS 2;Low
DADE    DS 2;High

;loading
APG     NOP ;Active Page

LHLA    DS 4;Lenght
LHLB    DS 4
SHLA    DS 3;Source Pos   Off(2)+Page(1)
DHLA    DS 3;Dest Pos     Off(2)+Page(1)

;TXT-editing
CRX     NOP ;CURSOR X representation
CRY     NOP ;CURSOR Y representation
CRXX    DS 2;Col
CRYY    DS 2;Ln
XY      DS 2;temp. XY (uses in LINE PR)

INOV    NOP ;0-INS, 1-OVER

LHLCR   DS 3
RHLCR   DS 3
LHLCR2  DS 3
RHLCR2  DS 3

PGHLP   DS 3
LNHLP   DS 3

;COLORS
CRPOZ   DS 2
CRP     DS 2
;---------------------------------------
YADU    EQU $-PLUGIN
;---------------------------------------
;---------------------------------------
