;TR-DOS MOUNTER v1.51
;(C) KOSHI/MGN 2018
;---------------------------------------
        ORG #6000
;-------
WLD     EQU #6000+6
BLKT    EQU #6000+21

RESDNT  EQU #5B00

Vmod    EQU #00AF;VideoConfig/Status
Vpag    EQU #01AF;VideoPage
SYS     EQU #20AF;SysConfig
PE0     EQU #21AF;MemConfig
PW0     EQU #10AF;Page0
PW2     EQU #12AF;Page2
PW3     EQU #13AF;Page3
VFDD    EQU #29AF;FDDVirt

NV29AF  EQU #B0
;-------
RAMD    EQU #C0
RAMDE   EQU #C0+#28
;-------
MDLn2   EQU #C000
DRV_OFF EQU 8
IDNTOFF EQU 16
NAMEOFF EQU 32

DRV_A   EQU MDLn2+DRV_OFF+0
DRV_B   EQU MDLn2+DRV_OFF+1
DRV_C   EQU MDLn2+DRV_OFF+2
DRV_D   EQU MDLn2+DRV_OFF+3

IDNTPOZ EQU MDLn2+IDNTOFF

DRV_A_FNAME EQU MDLn2+NAMEOFF+0
DRV_B_FNAME EQU MDLn2+NAMEOFF+16
DRV_C_FNAME EQU MDLn2+NAMEOFF+32
DRV_D_FNAME EQU MDLn2+NAMEOFF+48
;---------------------------------------
;HEADER:
        DS 16
        DB "WildCommanderMDL";    Header
        DB #0A;                  Version
        DB 0;                       Type
        DB 4; Pages
        DB 0; Page to #8000
;-------
        DB 0,BLKZ; CODE
        DB 3,32;   Boot
        DB 1,32;   page to #FF
        DB 2,16;   page to #FE

.2      DB 0,0
;-------
        DS 16
;-------
        DB "TRD"
        DB "SCL"
        DS 30*3
;-------
        DB 0
;-------
        DW #0000,#0010; MAX SIZE
;-------
        DB "TR-DOS Mounter v1.51            "
;-------
        DB 3;    3 - by EXT or From menu
;---------------------------------------
        ORG #8000,#6200
;-------
LOBU    EQU #A000
LOBE    EQU LOBU+#1000
LOB2    EQU #B000
;---------------------------------------
PLUGIN  PUSH AF,HL,DE,BC:CALL GEDPL
        POP BC,DE,HL,AF

        OR A:JP Z,EXTENS
        CP 3:RET NZ
;-------
MENUS   CALL RSoDIZ:JR NZ,MOX

        LD A,(CUZ2)
        DEC A:JR Z,MORS
        DEC A:JR Z,DIZMA
MOX     LD A,(ESTAT)
        RET
;-------
DIZMA   LD HL,TXT2:CALL DRIVEZ,Z,DIZMAUN:JR MOX
;-------
MORS    LD HL,TXT1:CALL DRIVEZ,Z,MOUNTRS:JR MOX
;-------
RSoDIZ  LD IX,MEWND:CALL PRWOW
        LD HL,ME05,DE,#0102:CALL TXTPR

MADI    EI:HALT:CALL CURSOR

        CALL UPPP,NZ,UPC
        CALL DWWW,NZ,DNC

        CALL ESC:JR NZ,ADI
        CALL ENKE:JR Z,MADI

MAD     LD IX,MEWND:CALL RRESB
        XOR A
        RET
;-------
ADI     CALL MAD:INC A:RET
;---------------------------------------
START_CHANGE LD A,1:CALL KBSCN:RET Z
             CP "f":JR Z,FREQ_CHANGE
             CP "m":JR Z,MEM_CHANGE
             CP "c":JR Z,CACHE_CHANGE
             RET

FREQ_CHANGE  LD A,(SFRQ)
             INC A:CP 3:JR C,FREQOK
             XOR A
             LD HL,FRQ35
FREQCHANGE   LD (SFRQ),A,(START_FRQ),HL
             JR CHANGE
FREQOK       LD HL,FRQ70:CP 1:JR Z,FREQCHANGE
             LD HL,FRQ14
             JR FREQCHANGE

MEM_CHANGE   LD A,(SMEM)
             INC A:CP 4:JR C,MEMOK
             XOR A
             LD HL,MEM512
MEMCHANGE    LD (SMEM),A,(START_MEM),HL
             JR CHANGE
MEMOK        LD HL,MEM128:CP 1:JR Z,MEMCHANGE
             LD HL,MEMAUTO:CP 2:JR Z,MEMCHANGE
             LD HL,MEM1024
             JR MEMCHANGE

CACHE_CHANGE LD A,(SCAC),HL,AON
             INC A:CP 2:JR C,CACHECHANGE
             XOR A
             LD HL,AOFF
CACHECHANGE  LD (SCAC),A,(START_CAC),HL
             JR CHANGE

CHANGE       PUSH IX
             LD IX,SOPWND
             LD HL,START_INFO,DE,#0102:CALL TXTPR
             POP IX
             RET
;---------------------------------------
GOTRDOS LD IX,SOPWND:CALL PRWOW
        LD HL,START_INFO,DE,#0102:CALL TXTPR
        LD IX,TRWND:CALL PRWOW

TRMAIN  EI:HALT:CALL CURSOR

        CALL ENKE:JR NZ,TRGO
        CALL START_CHANGE

        CALL UPPP,NZ,UPC
        CALL DWWW,NZ,DNC

        CALL ESC:JR Z,TRMAIN

HAXHAX  LD IX,TRWND:CALL RRESB
        LD IX,SOPWND:JP RRESB
;-------
TRGO    LD A,(IX+12)
        DEC A:JR Z,RBOOT
        DEC A:JR Z,RDOS
        DEC A:JR Z,RBAS128
        JR HAXHAX

RBOOT   CALL USPO
        CALL BOOTINIT
        XOR A:CALL RINIT
        JP RESDNT+RESID3-RESIDE
RDOS    LD A,7:CALL RINIT:JP RESDNT
RBAS128 CALL USPO
        LD A,7:CALL RINIT
        JP RESDNT+RESID2-RESIDE

BOOTINIT LD A,3:CALL MNGC_PL
         DI:LD BC,PW0,A,7:OUT A
         LD HL,#C000,DE,#0000,BC,#4000:LDIR
         RET

RINIT   EI:HALT:DI
        EXA
        LD A,63,I,A:IM 1
        LD IY,#5C3A
        EXA

        LD B,A
.3      ADD A,A
        OR B
        LD HL,#5800,DE,HL:INC DE
        LD (HL),A,A,B
        LD BC,#0300-1:LDIR

        EXA
        XOR A
        LD BC,#EFF7:OUT A
        LD BC,PE0,A,(SMEM):AND %00000011:RRCA:RRCA:OUT A
        LD BC,PW0:LD A,%00000000:OUT A

        LD A,(SCAC):AND 1:SLA A,A:LD E,A
        LD BC,SYS,A,(SFRQ):AND %00000011:OR E:OUT A

        XOR A
        LD BC,Vmod:OUT A
        LD BC,Vpag,A,5:OUT A
        EXA:OUT (254)

        LD HL,RESIDE
        LD DE,RESDNT
        LD BC,ERESIDE-RESIDE:LDIR

        LD HL,#2758:EXX
        RET

RESIDE  LD BC,PW2,A,2:OUT A
        LD BC,PW3:XOR A:OUT A
        LD BC,#7FFD,A,16:OUT A
        LD HL,0:PUSH HL
        JP #3D2F
RESID2  LD BC,PW2,A,2:OUT A
        LD BC,PW3:XOR A:OUT A
        JP 0
RESID3  LD BC,PW2,A,2:OUT A
        LD BC,PW3:XOR A:OUT A
        LD BC,#7FFD,A,7:OUT A
        JP #C000
ERESIDE
;---------------------------------------
EXTENS  LD (FNAME),BC
        CALL EXTCHE:JR NZ,NOT_TRD

        LD (DAHL),HL,(DADE),DE
        LD A,L:OR A:JR NZ,YA
        OR H,E:JR Z,YA
        LD A,D:OR A:JR NZ,YA

        LD L,H,A,E:AND %00001111:LD H,A
        SRL H:RR L:JR NC,$+3:INC HL
.2      ADD HL,HL
        LD (DABB),HL

        CALL CHECK:JR NZ,YA

        LD HL,TXT0:CALL DRIVEZ,Z,MOUNTRD

YA      LD A,(ESTAT)
        RET
;-------
NOT_TRD LD HL,TXT3:CALL DRIVEZ,Z,MOUNRAM
        JR YA
;---------------------------------------
DRIVEZ  PUSH HL
        CALL INDICA
        LD IX,PLWND:CALL PRWOW
        POP HL:LD DE,#0000:CALL TXTPR

        LD HL,ME01,DE,#0102:CALL TXTPR

        LD A,1:CALL YN
MAIN    EI:HALT:XOR A:CALL YN,CURSOR

        CALL UPPP,NZ,UPC
        CALL DWWW,NZ,DNC

        CALL ESC:JR NZ,AIN
        CALL ENKE:JR Z,MAIN

        LD A,#FF:CALL YN:JR NZ,AIN

MAJ     LD IX,PLWND:CALL RRESB
        XOR A
        RET
;-------
AIN     CALL MAJ:INC A:RET
;-------
UPC     LD A,(IX+12):CP 1:RET Z
        CALL CURSER
        DEC (IX+12)
        JP CURSOR
DNC     LD A,(IX+12):CP (IX+13):RET NC
        CALL CURSER
        INC (IX+12)
        JP CURSOR
;---------------------------------------
INDICA  DI
        LD BC,#DFF7,A,NV29AF:OUT A
        LD B,#BF:IN E

        LD BC,#202A
        LD A,B:BIT 0,E:JR Z,$+3:LD A,C,(ME01+MEMES),A
        LD A,B:BIT 1,E:JR Z,$+3:LD A,C,(ME02+MEMES),A
        LD A,B:BIT 2,E:JR Z,$+3:LD A,C,(ME03+MEMES),A
        LD A,B:BIT 3,E:JR Z,$+3:LD A,C,(ME04+MEMES),A
;-------
        LD A,#FE:CALL MNGC
        CALL IDNT_CHECK:JR NZ,IDNT_NOT_FOUND
        LD A,(DRV_A),HL,DRV_A_FNAME,DE,ME01+MEME2:CALL ITM
        LD A,(DRV_B),HL,DRV_B_FNAME,DE,ME02+MEME2:CALL ITM
        LD A,(DRV_C),HL,DRV_C_FNAME,DE,ME03+MEME2:CALL ITM
        LD A,(DRV_D),HL,DRV_D_FNAME,DE,ME04+MEME2:CALL ITM
        RET
;-------
IDNT_NOT_FOUND LD A,#FF,DE,ME01+MEME2:CALL ITM
               LD A,#FF,DE,ME02+MEME2:CALL ITM
               LD A,#FF,DE,ME03+MEME2:CALL ITM
               LD A,#FF,DE,ME04+MEME2:CALL ITM
               RET
;---------------------------------------
IDNT_CHECK LD HL,IDNTPOZ,DE,IDNT
           LD B,IDNTL
IDNTCHE    LD A,(DE):CP (HL):RET NZ:INC L,E:DJNZ IDNTCHE
           XOR A
           RET
;---------------------------------------
ITM     PUSH HL,AF
        OR A:JR Z,RS_IT
        DEC A:JR Z,HDM_IT
        DEC A:JR Z,HDS_IT
        DEC A:JR Z,SD_IT
        DEC A
        DEC A:JR Z,RD_IT
;-------
        LD HL,SPC
SPI     LD BC,3:LDIR
        POP AF,HL:INC DE
        
        CP 1:JR Z,NAMEENA
        CP 2:JR Z,NAMEENA
        CP 3:JR Z,NAMEENA
        CP 5:JR Z,NAMEENA
        LD HL,TNAME
NAMEENA LD BC,TNAMEL:LDIR
        RET
;-------
RS_IT   LD HL,RS2:JR SPI
HDM_IT  LD HL,TRD:JR SPI
HDS_IT  LD HL,TRD:JR SPI
SD_IT   LD HL,TRD:JR SPI
RD_IT   LD HL,RAM:JR SPI
;---------------------------------------
MOUNT   CALL MOO1
        CALL MOO2
        RET
;-------
MOUNTRD LD IX,STWND:CALL PRWOW
        LD HL,TXT5,DE,#0101:CALL TXTPR

        CALL MOO1
        CALL MOOT

        LD IX,STWND:CALL RRESB

        JP GOTRDOS
;---------------------------------------
MOO1    LD A,#FF:CALL MNG0
        LD A,1:CALL MNGC_PL
        LD HL,#C000,DE,#0000,BC,#4000
        LDIR:RST 0
;-------
        LD A,(CUZ)
        LD HL,BITZ-1,B,0,C,A:ADD HL,BC
        DI
        LD BC,#DFF7,A,NV29AF:OUT A
        LD B,#BF:IN A
        OR A:JR Z,TMA

        PUSH HL,BC,AF
        LD A,#FE:CALL MNG0
        LD HL,#0000+DRV_OFF,DE,DRT,BC,4:LDIR
        LD HL,#0000+NAMEOFF,DE,TNAMES,BC,TNAMEL*4:LDIR
        POP AF,BC,HL

TMA     OR (HL):OUT A
        LD BC,VFDD:OUT A

        LD A,#FE:CALL MNG0
        LD HL,#0000+DRV_OFF
        LD A,#FF
.3      LD (HL),A:INC HL
        LD (HL),A

        CALL MNG0D
        RET
;-------
MOOT    LD A,(CUZ)
        DEC A:JR Z,DRVA
        DEC A:JR Z,DRVB
        DEC A:JR Z,DRVC

DRVD    LD A,#FD:CALL MNGC:JR DRVn
;-------
DRVC    LD A,#FD:CALL MNGC:JR DRVN
;-------
DRVB    LD A,#FC:CALL MNGC
DRVn    LD DE,#E000,BC,#0000-4
        JR DRVX
;-------
DRVA    LD A,#FC:CALL MNGC
DRVN    LD DE,#C000,BC,#E000
DRVX    PUSH DE,BC:CALL CHTOSEP
        POP DE,BC
        LD HL,(DABB):ADD HL,BC:CALL FFll

MOO2    LD HL,(CUZ),H,0
        LD BC,DRT-1:ADD HL,BC
        LD A,(MCZ),(HL),A

        PUSH AF
        LD A,#FE:CALL MNG0
        LD A,2:CALL MNGC_PL
        POP AF

        CP 6:JR NC,NOTANAM
        OR A:JR Z,NOTANAM
        CP 4:JR Z,NOTANAM

        LD HL,TNAMES,DE,#C000+NAMEOFF,BC,TNAMEL*4:LDIR
        LD A,(CUZ):DEC A
        LD HL,DRV_A_FNAME:JR Z,TORI
        LD B,A
FEINT   LD DE,TNAMEL:ADD HL,DE:DJNZ FEINT
TORI    EX DE,HL
        LD B,TNAMEL,HL,(FNAME)
AMOS    LD A,(HL):CP 32:JR C,NANONANO
        LD (DE),A:INC HL,DE
        DJNZ AMOS

NOTANAM LD HL,DRT,DE,#C000+DRV_OFF,BC,4:LDIR
        LD A,(BLKT),(DE),A

        LD HL,#C000,DE,#0000,BC,#2000:LDIR

        CALL MNG0D
        RET

NANONANO LD A,32,(DE),A:INC DE:DJNZ NANONANO
         JR NOTANAM
;-------
FFll    EX DE,HL
        OR A:SBC HL,DE:RET C,Z
        LD BC,HL:DEC BC
        LD HL,DE:INC DE
        LD (HL),#FF
        LDIR
        RET
;---------------------------------------
MOUNTRS XOR A:LD (MCZ),A;      0 - RS232
        JP MOUNT
;---------------------------------------
MOUNRAM LD IX,STWND:CALL PRWOW
        LD HL,TXT4,DE,#0101:CALL TXTPR

        CALL SCL_RAM

        LD IX,STWND:CALL RRESB
;-------
        LD A,5,(MCZ),A;     5 - RAM DISK
        CALL MOUNT
        JP GOTRDOS
;---------------------------------------
DIZMAUN LD A,(CUZ)
        LD HL,ZITZ-1,B,0,C,A:ADD HL,BC

        PUSH BC
        DI
        LD BC,#DFF7,A,NV29AF:OUT A
        LD B,#BF
        IN A:AND (HL):OUT A

        LD A,#FE:CALL MNGC
        POP BC
;-------
        LD HL,#C008-1:ADD HL,BC
        LD (HL),#FF
        RET
;---------------------------------------
SCL_RAM XOR A:LD (EOC),A

        LD HL,LOBU,B,8
        PUSH HL:CALL LOAD512
        POP HL
        LD B,8,DE,SINC:CALL CHEE:RET NZ

        LD A,(HL):DEC A:CP 128:RET NC
;-------
        LD A,RAMD,(PGRAMD),A:CALL MNGC

        EXX
        LD HL,#C000,DE,HL:INC DE
        LD BC,(256*9)-1,(HL),0:LDIR
        EXX

        LD DE,#0100,(#C000+14),DE
        LD DE,#C000
        LD B,(HL):INC HL
SCLF    PUSH BC
        LD BC,14:LDIR
        EX DE,HL
        PUSH DE
        DEC HL:LD B,(HL)
        INC HL:LD A,(HL)
        INC HL:LD D,(HL):CALL NFS
        LD C,15:ADD HL,BC
        LD (HL),A:INC HL
        LD (HL),D
        LD BC,0-15:ADD HL,BC
        POP DE
        EX DE,HL
        POP BC
        DJNZ SCLF
        XOR A:LD (DE),A
;-------
        PUSH HL
;              _
        CALL HAUDEH,CAT9C
        POP HL
;-------
        EX DE,HL
        LD HL,LOBE:OR A:SBC HL,DE
        LD BC,HL
        EX DE,HL
        LD DE,#C000+#1000:LDIR
;-------
DSCL    EX DE,HL
LDSCL   LD A,(EOC):CP #0F:RET Z
        LD B,1:CALL LOAD512
        LD (EOC),A
        LD A,H:CP #C0:JR NC,LDSCL

        LD A,(PGRAMD)
        INC A:CP RAMDE:RET NC
        LD (PGRAMD),A:CALL MNGC

        LD BC,HL,HL,0,DE,#C000:LDIR
        JR DSCL
;---------------------------------------
NFS     INC A:CP 16:JR C,JEKTOR:INC D
        XOR A
JEKTOR  DJNZ NFS
        RET

ADDSUM  LD HL,0,DE,0
        EXX
        LD HL,#C000,DE,13,B,128
DSU     LD A,(HL):OR A:RET Z
        ADD HL,DE
        LD A,(HL)
        EXX
        LD E,A
        ADD HL,DE
        EXX
        INC HL,HL,HL
        DJNZ DSU
        RET

CAT9C   EXX
        LD HL,#C8EA,DE,HL:INC DE
        LD BC,9-1,(HL),32:LDIR
        LD A,#10,(#C000+#08E7),A
        EXX

        LD A,129:SUB B
        LD (#C000+#08E4),A
        LD A,C,(#C000+#08F4),A
        DEC HL:LD D,(HL)
        DEC HL:LD A,(HL)
        DEC HL:LD B,(HL):CALL NFS
        LD E,A,(#C000+#08E1),DE
        CALL ADDSUM:EXX
        EX DE,HL:LD HL,2544
        OR A:SBC HL,DE:RET C
        LD (#C000+#08E5),HL
        XOR A
        RET
; _
HAUDEH  LD HL,#C000,DE,16,BC,#8100
HEHA    LD A,(HL):OR A:RET Z
        CP 1:JR NZ,$+3:INC C
        ADD HL,DE
        DJNZ HEHA
        OR A
        RET
;-------
CHEE    LD A,(DE):CP (HL):RET NZ
        INC HL,DE
        DJNZ CHEE
        RET
;---------------------------------------
CHECK   LD C,(IX+29)
        LD HL,CHE,B,0:ADD HL,BC
        LD A,(HL),(MCZ),A
        LD A,C

;0 - IDEnemoMaster
;1 - SD(ZC)
;2 - SD(NGS)
;3 - IDEsmucMaster
;4 - IDEsmucSlave
;5 - IDEnemoSlave

        CP 0:RET Z
        CP 1:RET Z
        CP 5:RET Z

        LD IX,ERWND:CALL PRWOW
        LD HL,TE01,DE,#0101:CALL TXTPR

        CALL USPO
        CALL NUSP

        LD IX,ERWND:CALL RRESB

        LD A,1:OR A
        RET
;---------------------------------------
EXTCHE  PUSH HL,DE
        CALL TENTRY
;-------
        LD HL,ENTRY+8,DE,TRD
        CALL TN:LD A,0:JR Z,YUKSEK

        LD HL,ENTRY+8,DE,SCL
        CALL TN:LD A,1:JR Z,YUKSEK
;-------
YUKSEK  POP DE,HL
        OR A
        RET
;---------------------------------------
TN
_LD A,(DE):CP (HL):RET NZ:INC HL,DE
_LD A,(DE):CP (HL):RET NZ:INC HL,DE
_LD A,(DE):CP (HL)
        RET
;---------------------------------------
MNG0    LD BC,PW0:OUT A:RET
MNG0D   LD BC,PW0,A,(#6000):OUT A:RET
MNGC    LD (#6003),A,BC,PW3:OUT A:RET
;---------------------------------------
MNGC_PL EXA:XOR A:JP WLD

PRWOW   LD A,1:JP WLD
RRESB   LD A,2:JP WLD
PRSRW   LD A,3:JP WLD
PRIAT   EXA:LD A,4:JP WLD

CURSOR  LD A,6:JP WLD
CURSER  LD A,7:JP WLD

YN      EXA:LD A,8:JP WLD
TXTPR   LD A,11:JP WLD
MEZZ    EXA:LD A,12:JP WLD
;-------
GEDPL   LD A,15:JP WLD
;-------
UPPP    LD A,17:JP WLD
DWWW    LD A,18:JP WLD

ENKE    LD A,22:JP WLD
ESC     LD A,23:JP WLD
KBSCN   EXA:LD A,42:JP WLD
USPO    LD A,46:JP WLD
NUSP    LD A,47:JP WLD
;-------
LOAD512 LD A,48:JP WLD

TENTRY  LD DE,ENTRY,A,51:JP WLD
CHTOSEP LD A,52:JP WLD
;---------------------------------------
PLWND   DB 3+128,0
        DB 24,10;    X,Y
        DB 30+2,6+2; W,H
        DB %01111111;PAPER+INK
        DB 0
        DW #0000;    BUFFER
        DB 2,0;      LINES

CUZ     DB 1,4
        DB %11110001,0
;-------
MEWND   DB 6+128,0
        DB 30,11;    X,Y
        DB 18+2,2+2; W,H
        DB %01111111;PAPER+INK
        DB 0
        DW #0000;    BUFFER
        DB 0,0;      LINES

CUZ2    DB 1,2
        DB %11110001,0
;-------
ERWND   DB 6+128,0
        DB 23,12;    X,Y
        DB 32+2,1+2; W,H
        DB %00101111;PAPER+INK
        DB 0
        DW #0000;    BUFFER
        DB 0,0;      LINES
;-------
STWND   DB 6+128,0
        DB 24,12;    X,Y
        DB 32+2,1+2; W,H
        DB %01111111;PAPER+INK
        DB 0
        DW #0000;    BUFFER
        DB 0,0;      LINES
;-------
TRWND   DB 8+64+128,0
        DB 24,11;    X,Y
        DB 32+2,4+2; W,H
        DB %01111111;PAPER+INK
        DB 0
        DW #0000;    BUFFER
        DB 0,0;      LINES

        DB 1,4
        DB %11110000,0

        DW 0
        DW 0
        DW TRWC

TRWC    DB #E,"RESET with BOOT",13
        DB #E,"RESET to TR-DOS",13
        DB #E,"RESET to Basic128",13
        DB #E,"BACK TO COMMANDER",0
;-------
SOPWND  DB 6+128,0
        DB 22,18;     X,Y
        DB 36+2,2+2; W,H
        DB %01001111;PAPER+INK
        DB 0
        DW #0000;    BUFFER
        DB 0,0;      LINES

START_INFO DB "CPU ",#2,"F",#7,#7,"requency: "
           DB #FE
START_FRQ  DW FRQ35
           DB " MHz  "

           DB #2,"C",#7,#7,"ache: "
           DB #FE
START_CAC  DW AOFF
           DB " ",13

           DB "  ",#2,"M",#7,#7,"emory Lock: "
           DB #FE
START_MEM  DW MEM128
           DB "   "
           DB 0

SFRQ    DB 0
FRQ35   DB "3.5",0
FRQ70   DB "7.0",0
FRQ14   DB "14",0

SMEM    DB 1;MEM128
MEM512  DB "512 KB",0
MEM128  DB "128 KB",0
MEMAUTO DB "Auto",0
MEM1024 DB "1024 KB",0

SCAC    DB 0
AOFF    DB "OFF",0
AON     DB "ON",0
;-------
BITZ    DB %00000001
        DB %00000010
        DB %00000100
        DB %00001000

ZITZ    DB %11111110
        DB %11111101
        DB %11111011
        DB %11110111
;-------
CHE     DB 1;NemoMaster
        DB 3;SDzc
        NOP ;SDngs
        NOP ;SmucMaster
        NOP ;SmucSlave
        DB 2;NemoSlave
        DS 6
;-------
TXT0    DB #E,9,"Mount TRD to:",0
TXT1    DB #E,9,"Mount RS232 to:",0
TXT2    DB #E,9,"Dismounting:",0
TXT3    DB #E,9,"Mount SCL as RAM disk to:",0

TXT4    DB #0B,2,8,"Copying SCL to RAM disk!!!",0
TXT5    DB #0B,3,8,"Mounting TRD to vDOS!!!",0

TNAMEL  EQU 16
TNAME   DB "No file name... "
TNAMES  DS TNAMEL*4,#FF

TE01    DB "This Device is NOT supported!!!",0

MEMES   EQU 8
MEME2   EQU MEMES+1
ME01    DB "Drive[A]                     ",13
ME02    DB "Drive[B]                     ",13
ME03    DB "Drive[C]                     ",13
ME04    DB "Drive[D]                     ",0

ME05    DB " <Mount RS-232> ",13
        DB "<Dismount Drive>",0

IDNTL   EQU 16
IDNT    DB 0,"vTR-DOS MDLn2!",0
;---------------------------------------
SPC     DB "   "
RS2     DB "COM"
RAM     DB "RAM"
TRD     DB "TRD"
SCL     DB "SCL"
SINC    DB "SINCLAIR"

DRT     DB #FF;0-RS232,1/2-HDD,3-SD(ZC)
        DB #FF;4-*SD(NGS)
        DB #FF;5-RAM DISK
        DB #FF

DAHL    DS 2
DADE    DS 2

DABB    DS 2

MCZ     NOP
MCC     NOP

PGRAMD  NOP
EOC     NOP

FNAME   DS 2; File name address
ESTAT   NOP;  Exit State
ENTRY   DS 32
PLUGEND
;---------------------------------------
BLKZ    EQU ((PLUGEND-PLUGIN)/512)+1
EMU     EQU #6200+(BLKZ*512)
EMU2    EQU EMU+#4000
;---------------------------------------
        ORG EMU
        INCB "QC311.CCB"
;---------------------------------------
        ORG EMU2
        INCB "EMU.CCB"
        ORG EMU2+#4000
        INCB "MN3O.CCB"
;---------------------------------------

