;---------------------------------------
CONF    EQU #77
DATA    EQU #57

CMD_17  EQU %01000000+17;Single Read
CMD_24  EQU %01000000+24;Single Write
;---------------------------------------
SD2BT   EQU %0000 1011
SDNUM   NOP;%0000 0001 - SD1
;           %0000 1011 - SD2
BLKT    NOP
;---------------------------------------
RDDSEsd ;i:HL(4) - Sector number
;             DE - Address

        PUSH DE
        LD E,(HL):INC HL
        LD D,(HL):INC HL
        LD C,(HL):INC HL
        LD B,(HL)
        POP HL:LD A,B:CP #FF:RET Z

TRYME   CALL CMD17:OR A:JR NZ,VISS
        CALL WTDO:CP #FE:JR NZ,$
        CALL READSsd,SNB
        JP CSH
VISS    BIT 0,A:JR Z,$;error (not idlestate)

;idlestate:
        PUSH HL,DE,BC
        CALL SD_INIT
        POP BC,DE,HL:JR NZ,GEGE
        JR TRYME

GEGE    LD A,2:OUT (254):JR $
;---------------------------------------
SDDSEsd ;i:HL(4) - Sector number
;             DE - Address

        PUSH DE
        LD E,(HL):INC HL
        LD D,(HL):INC HL
        LD C,(HL):INC HL
        LD B,(HL)
        POP HL:LD A,B:CP #FF:RET Z

        XOR A:IN A,(CONF)
        AND 2:JR NZ,XORK
        LD A,B:OR C,D,E
        LD A,3:RET Z

        CALL CMD24:JR NZ,$
        CALL SAVDSsd,DRESP,SNB
        JP CSH
;-------
XORK    XOR A:RET
;---------------------------------------
READSsd PUSH BC,DE
        LD BC,DATA
        LD D,8
RZD1
.64     INI
        DEC D:JP NZ,RZD1

        IN A,A
        POP DE,BC
        RET
;-------
SAVDSsd PUSH BC,DE
        LD BC,DATA,A,#FE:OUT A
        LD D,8
SVD1
.64     OUTI
        DEC D:JP NZ,SVD1

        LD A,#FF
        OUT A,A
        POP DE,BC
        RET
;---------------------------------------
CSH     PUSH BC,AF
        LD BC,CONF,A,%00000011:OUT A
        LD BC,DATA,A,#FF:OUT A
        POP AF,BC
        RET
CSL     PUSH BC,AF
        LD BC,CONF,A,(SDNUM):OUT A
        LD BC,DATA,A,#FF:OUT A
        POP AF,BC
        JP WAIT

SNB     PUSH BC,AF
        LD B,16
SnB     XOR A:IN A,(DATA):DJNZ SnB
        POP AF,BC
        RET
;---------------------------------------
CMD17   LD A,CMD_17
CMDz    PUSH HL,DE,BC

        LD L,C,H,B

        LD C,A
        LD A,(BLKT):OR A:JR NZ,CMzz
        EX DE,HL:ADD HL,HL
        EX DE,HL:ADC HL,HL
        LD H,L,L,D,D,E,E,A

CMzz    CALL CSH
        CALL CSL

        LD A,C,BC,DATA:OUT A
        OUT H
        OUT L
        OUT D
        OUT E
        LD A,#FF:OUT A
        POP BC,DE,HL
        JP RESP
CMD24   LD A,CMD_24:JR CMDz
;---------------------------------------
CMDi6   LD HL,CMD16:JR CMDME
CMD8    LD HL,CMD08:JR CMDME
CMD0    LD HL,CMD00
CMDME   CALL CSH
        CALL CSL
        LD BC,DATA
.6      OUTI

RESP    PUSH DE,BC
        LD BC,DATA,D,10
RESp    IN A:BIT 7,A:JR Z,REZ
        DEC D:JR NZ,RESp:INC D
REZ     POP BC,DE
        RET
;-------
WTDO    PUSH BC
        LD BC,DATA:IN A:CP #FF:JR Z,$-4
        POP BC
        RET

WAIT    PUSH BC,AF
        LD BC,DATA:IN A:INC A:JR NZ,$-3
        POP AF,BC
        RET
;-------
DRESP   PUSH BC,AF
        LD BC,DATA
        IN A:CP #FF:JR Z,$-4
        AND #1F:CP 5:JR NZ,ER
        IN A:OR A:JR Z,$-3
        POP AF,BC
        RET
ER      AND 15:ADD A,240
        LD BC,#0FAF:OUT A
        ;CALL SDOFF
        JR $
;---------------------------------------
CMD_1   EQU %01000000+1; init
CMD_12  EQU %01000000+12;Stop Transmiss
CMD_16  EQU %01000000+16;Block Size
ACMD_41 EQU %01000000+41;init (SDC only)
CMD_55  EQU %01000000+55;app CMD
CMD_58  EQU %01000000+58;Read OCR
;---------------------------------------
CMD00   DB %01000000+0:DS 4:DB #95
CMD08   DB %01000000+8,0,0,1,#AA,#87
CMD16   DB %01000000+16,0,0,2,0,#FF
;---------------------------------------
CMDo    CALL CSH
        CALL CSL
CMDx    PUSH BC
        LD BC,DATA:OUT A
        XOR A
        OUT A
        OUT A
        OUT A
        OUT A
        DEC A:OUT A
        POP BC
        RET
CMD1    LD A,CMD_1:CALL CMDo:JP RESP
CMD12   LD A,CMD_12:CALL CMDx
        XOR A:IN A,(DATA)
        JP RESP
CMD55   LD A,CMD_55:CALL CMDo:JP RESP
CMD58   LD A,CMD_58:CALL CMDo:JP RESP
;-------
ACMD41  CALL CMD55
        CALL CSH
        CALL CSL

        LD BC,DATA,A,ACMD_41:OUT A
        LD L,0
        OUT H
        OUT L
        OUT L
        OUT L
        DEC L:OUT L
        JP RESP
;---------------------------------------
SD_INIT ;CALL CSH
        ;LD DE,512+10:CALL CYCL

        LD DE,8000
SDWT    DEC DE:LD A,D:OR E:JP Z,NOSD
        CALL CMD0:JR NZ,SDWT
        DEC A:JP NZ,SDWT

        CALL CMD8
        PUSH AF
.2      IN E
        IN H
        IN L
        POP AF:JR NZ,SDWT
        BIT 2,A:JR Z,SDNEW
;-------
SDOLD   LD DE,8000
AA      DEC DE:LD A,D:OR E:JR Z,LC
        LD H,0
        CALL ACMD41:JR NZ,AA
        CP 1:JR Z,AA
        OR A:JR NZ,LC
;SDV1 Detected
        JR FBS
;-------
LC      LD DE,8000
OO      DEC DE:LD A,D:OR E:JR Z,NOSD
        CALL CMD1:JR NZ,OO
        CP 1:JR Z,OO
        OR A:JR NZ,NOSD
;MMC Ver.3 Detected
        JR FBS
;-------
SDNEW   LD DE,#01AA
        OR A:SBC HL,DE:JR NZ,NOSD

        LD DE,8000
YY      DEC DE:LD A,D:OR E:JR Z,NOSD
        LD H,#40
        CALL ACMD41:JR NZ,YY
        CP 1:JR Z,YY
        OR A:JR NZ,NOSD
;SDV2 Detected

        CALL CMD58:JR NZ,NOSD
        LD BC,DATA
        IN A
.3      IN L
        BIT 6,A:JR Z,FBS;SDV2 Byte Addr
;SDV2 Block Address

        LD A,1
SDFND   LD (BLKT),A
        LD A,(SDNUM)
        CP SD2BT
        LD A,(BLKT):JR NZ,SD1BLKT
        LD (BLKT2),A:JR SDBLKT
SD1BLKT LD (BLKT1),A
SDBLKT  XOR A
        JP CSH
;-------
FBS     CALL CMDi6:OR A:JR Z,SDFND
;-------
NOSD    ;CALL SDOFF
        XOR A:INC A
        RET
;-------
CYCL    LD BC,DATA
Cy      LD A,#FF:OUT A
        DEC DE:LD A,D:OR E:JR NZ,Cy
        RET
;---------------------------------------