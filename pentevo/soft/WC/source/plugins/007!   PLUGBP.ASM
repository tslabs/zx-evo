;BMP Viewer & Sprite Cutter
;(C) BUDDER/MGN/2012
;---------------------------------------
        ORG #6000
;-------
QUAC    EQU 255
SPAGE   EQU 16
;-------
WLD     EQU #6006
TMN     EQU #6009;Timer
;-------
Vfm     EQU #15AF
;---------------------------------------
;HEADER:
        DS 16
        DB "WildCommanderMDL";    Header
        DB #02;                  Version
        DB 0;                       Type
        DB 1; Pages
        DB 0; Page to #8000
;-------
        DB 0,10; CODE

.5      DB 0,0
;-------
        DS 16
;-------
        DB "BMP"
        DS 31*3
;-------
        DB 0
;-------
        DW #0000,#0004; MAX SIZE
;-------
        DB "BMP Viewer v0.6 "
        DB "                "
;-------
        DB 0
;---------------------------------------
        ORG #8000,#6200
;-------
LBSZ    EQU 4
LOBU    EQU #B000
LOBE    EQU LOBU+LBSZ*512
PALREZ  EQU LOBE

C16     EQU 16
C16Z    EQU #C000-C16*2
C256    EQU 256
C256Z   EQU #C000-C256*2
;---------------------------------------
PLUGIN  LD (DAHL),HL,(DADE),DE

        CALL GEDPL
        CALL CLEAR

        XOR A
        LD (SPF),A
        LD (LFL),A
        LD (ESTAT),A

        LD H,A,L,A
        LD (XXX),HL
        LD (YYY),HL
        LD (WNDX),HL
        LD (WNDY),HL

        LD A,SPAGE
        LD (PGA),A
        LD (PGB),A
        LD HL,#C000
        LD (SRAD),HL

        LD A,254,(IDX),A:CALL SETU

        CALL KOPT:JP Z,ERR
        CALL GENPAL
        CALL C16v256
;-------
MAIN    EI:HALT:CALL LINER
        CALL CTRL,NZ,WMOV:JR NZ,MAIN
        CALL ALT,NZ,SMOV:JR NZ,MAIN

        CALL TABK,NZ,SETUP
        CALL F5,NZ,SETUS

        CALL UPPP,NZ,UPN
        CALL DWWW,NZ,DWN
        CALL LFFF,NZ,LFN
        CALL RGGG,NZ,RGN

        CALL ENKE,NZ,GETSPR

        CALL F10:JR NZ,EXIT
        CALL ESC:JR Z,MAIN

EXIT    CALL GEDPL

;LD IX,PLWND:CALL PRWOW
;LD HL,CCNT+1,BC,255:XOR A:CPIR
;LD DE,CCNT:OR A:SBC HL,DE
;EX DE,HL
;LD A,D,HL,TXT+1:CALL NORK
;LD A,E,HL,TXT+3:CALL NORK
;_LD HL,TXT,DE,#0101,BC,5:CALL PRSRW
;CALL USPO
;CALL NUSP
;LD IX,PLWND:CALL RRESB

        CALL SAVEK

ERR     LD A,#FF:CALL DMAPL
        LD A,(ESTAT)
        RET
;-------
NXFL    LD A,2,(ESTAT),A:JR EXIT
;-------
UPN     LD HL,(YYY),DE,8;(HEI)
        OR A:SBC HL,DE
ELE     LD A,H:CP #02:RET NC
        PUSH HL:CALL RLINE
        POP HL
        LD (YYY),HL
        JP LINER
DWN     LD HL,(YYY),DE,8;(HEI)
        ADD HL,DE
        LD BC,(HEI):CALL SMR:RET NC
        JR ELE
;-------
LFN     LD HL,(XXX),DE,8;(WID)
        OR A:SBC HL,DE
        LD A,H:CP #02:RET NC
RM      PUSH HL:CALL RLINE
        POP HL
        LD (XXX),HL
        JP LINER
RGN     LD DE,8
Rgn     LD HL,(XXX)
        ADD HL,DE
        LD BC,(WID):CALL SMR:RET NC
        JR RM
;CALL DWN
;CALL RLINE
;LD HL,0,(XXX),HL
;JP LINER
;-------
RGN2    LD DE,(WID):JR Rgn
;---------------------------------------
SAVEK   CALL PAS:RET Z
        PUSH HL,DE:CALL INAME
        POP DE,HL:RET NZ
        LD A,3,(ESTAT),A

        CALL GOSAVE
        CALL RRESB
        RET

GOSAVE  LD A,(SPF):OR A:JR NZ,NOPAL
        LD BC,(PALsz)
        ADD HL,BC:JR NC,$+3:INC DE
NOPAL   LD (FLSIZE),HL,(FLSIZE+2),DE

        LD DE,FLNAME
        LD HL,FLSIZE:CALL MKFILE:RET NZ

        LD A,(SPF):OR A:JR NZ,GA3

GA2     LD A,(PGA):CALL MNGCVPL
        LD HL,(PALOF):CALL GAD:RET Z
        LD DE,(PALOF),BC,(PALsz):LDIR
        LD HL,PGA:INC (HL)
        LD A,(PGB):CP (HL):JR NC,GA2
        RET
;-------
GA3     LD A,(PGA):CALL MNGCVPL
        LD HL,#C000:CALL GAD2:RET Z
        LD HL,PGA:INC (HL)
        LD A,(PGB):CP (HL):JR NC,GA3
;-------
GAD     LD B,1:CALL SAVE512:CP #0F:RET Z
        LD A,H:OR A:JR Z,Gad
        CP #FE:JR C,GAD
Gad     LD A,1:OR A
        RET
;-------
GAD2    LD B,1:CALL SAVE512:CP #0F:RET Z
        LD A,H:OR A:JR NZ,GAD2
        LD A,1:OR A
        RET
;---------------------------------------
PAS     LD BC,CCNT
        LD DE,(PALOF)

        LD A,(PALSZ)
VEK     EXA
        LD A,(BC):INC BC
        LD H,0,L,A:ADD HL,HL
        LD A,H:ADD A,PALREZ[:LD H,A
        LD A,(HL),(DE),A:INC DE,HL
        LD A,(HL),(DE),A:INC DE
        EXA:DEC A:JR NZ,VEK

        LD HL,(SRAD),DE,#C000
        OR A:SBC HL,DE
        LD A,(PGB):SUB SPAGE

        LD D,0,B,D
.2      SRL A:RR B
        LD E,A
        LD A,B:ADD A,H:LD H,A:OR L:RET Z

        LD A,1:OR A
        RET
;---------------------------------------
ALPHA   LD HL,PALREZ
        LD BC,#1800
C4E     LD A,B
        CP (HL):INC HL:JR NZ,TOO
        LD A,#60:CP (HL):RET Z
TOO     INC HL,C:RET Z
        JP C4E
;---------------------------------------
GENPAL  CALL ALPHA

        LD HL,CCNT,DE,HL:INC DE
        LD (HL),C,BC,255:LDIR

        LD IX,CCNT+1

        LD HL,(BMPX):DEC HL
        LD A,L,(AX1+1),A
        LD A,H,(AX2+1),A

        XOR A:LD (PAGN),A
        EXX:LD H,A,L,A
        EXX
NYA     EXX:PUSH HL:EXX
        CALL MNGCVPL
        EXX:POP HL:LD DE,(BMPY):EXX

        LD DE,#C000-1
NXT     INC DE:LD A,(DE),HL,CCNT,BC,256
        CPIR:JR Z,AX1
        LD (IX),A:INC IX
AX1     LD A,0:CP E:JP NZ,NXT
        LD A,D:AND 1
AX2     CP 0:JP NZ,NXT

        EXX
        INC HL:OR A:SBC HL,DE:RET NC
        ADD HL,DE
        EXX
        INC D:BIT 0,D:JR Z,$+3:INC D
        LD E,0,A,D:OR A:JP NZ,NXT

        LD A,(PAGN):INC A:LD (PAGN),A
        JR NYA
;---------------------------------------
C16v256 PUSH IX
        POP HL:LD DE,0-CCNT:ADD HL,DE

        LD A,H:OR A:RET NZ
        LD A,L:CP 17:JR NC,V256

V16     LD HL,C16,(PALSZ),HL
        LD HL,C16*2,(PALsz),HL
        LD HL,C16Z,(PALOF),HL
        RET

V256    LD HL,C256,(PALSZ),HL
        LD HL,C256*2,(PALsz),HL
        LD HL,C256Z,(PALOF),HL
        RET
;---------------------------------------
GETSPR  CALL RLINE
        LD HL,(XXX),DE,(YYY)

        LD BC,(HEI)
TP      PUSH BC
        LD IX,TTBU
        LD BC,(WID)
TSP     PUSH HL,DE
        CALL POINTR:LD (IX),A:INC IX
        POP DE,HL:INC HL
        DEC BC:LD A,B:OR C:JP NZ,TSP

        PUSH HL,DE,BC:CALL LB
        POP BC,DE,HL

        OR A
        PUSH DE:LD DE,(WID):SBC HL,DE
        POP DE:INC DE
        POP BC
        DEC BC:LD A,B:OR C:JP NZ,TP
;-------
        CALL LINER
        LD A,(AST):OR A:JP Z,RGN2
        RET
;-------
LB      LD A,(PGB):CALL MNGCVPL
        LD DE,(SRAD)
        PUSH DE:LD HL,TTBU,BC,(WID):LDIR
        POP HL
        PUSH HL:CALL CNV16C
        POP HL
        CALL CNV16F
        LD A,B:CP #C0:JR NC,JZ
        LD HL,PGB:INC (HL)
        LD DE,#C000:OR C:JR Z,GE
        LD A,(HL):CALL MNGCVPL
        LD HL,#0000:LDIR
GE      LD BC,DE
JZ      LD (SRAD),BC
        RET
;---------------------------------------
CNV16C  LD BC,(WID)
BAB     LD A,(HL)
        EXX
        LD HL,CCNT
        LD BC,(PALSZ):CPIR:JR NZ,HAB
        LD A,(PALSZ):DEC A:SUB C
;AND %00001111
HAB     EXX
        LD (HL),A:INC HL
        DEC BC:LD A,B:OR C:JR NZ,BAB
        LD BC,HL
        RET
;-------
CNV16F  LD A,(PALSZ+1):OR A:RET NZ
        LD DE,HL,BC,HL

        EXX
        LD BC,(WID)
        SRL B:RR C:JR NC,$+3:INC BC
DAX     EXX
.4      SLA (HL)
        INC DE:LD A,(DE):OR (HL)
        INC HL,HL,DE
        LD (BC),A:INC BC
        EXX:DEC BC:LD A,B:OR C:JR NZ,DAX
        EXX
        RET
;---------------------------------------
LINER   LD A,(LFL):OR A:CALL Z,LNN:RET
;-------
LNN     LD A,1,(LFL),A

        LD IX,LNBU
        LD HL,(XXX),DE,(YYY)

        LD BC,(WID)
LDK1    PUSH HL,DE,BC
        LD A,QUAC:CALL POINTP
        POP BC,DE,HL
        LD (IX),A:INC HL,IX
        DEC BC:LD A,B:OR C:JP NZ,LDK1
        DEC HL

        LD BC,(HEI):DEC BC
LDK2    INC DE
        PUSH HL,DE,BC
        LD A,QUAC:CALL POINTP
        POP BC,DE,HL
        LD (IX),A:INC IX
        DEC BC:LD A,B:OR C:JP NZ,LDK2

        LD BC,(WID):DEC BC
LDK3    DEC HL
        PUSH HL,DE,BC
        LD A,QUAC:CALL POINTP
        POP BC,DE,HL
        LD (IX),A:INC IX
        DEC BC:LD A,B:OR C:JP NZ,LDK3

        LD BC,(HEI):DEC BC,BC
LDK4    DEC DE
        PUSH HL,DE,BC
        LD A,QUAC:CALL POINTP
        POP BC,DE,HL
        LD (IX),A:INC IX
        DEC BC:LD A,B:OR C:JP NZ,LDK4
        RET
;---------------------------------------
RLINE   CALL LN2:RET
;-------
LN2     XOR A:LD (LFL),A

        LD IX,LNBU
        LD HL,(XXX),DE,(YYY)

        LD BC,(WID)
LDR1    PUSH HL,DE,BC
        LD A,(IX):CALL POINTP
        POP BC,DE,HL
        INC HL,IX
        DEC BC:LD A,B:OR C:JP NZ,LDR1
        DEC HL

        LD BC,(HEI):DEC BC
LDR2    INC DE
        PUSH HL,DE,BC
        LD A,(IX):CALL POINTP
        POP BC,DE,HL:INC IX
        DEC BC:LD A,B:OR C:JP NZ,LDR2

        LD BC,(WID):DEC BC
LDR3    DEC HL
        PUSH HL,DE,BC
        LD A,(IX):CALL POINTP
        POP BC,DE,HL:INC IX
        DEC BC:LD A,B:OR C:JP NZ,LDR3

        LD BC,(HEI):DEC BC,BC
LDR4    DEC DE
        PUSH HL,DE,BC
        LD A,(IX):CALL POINTP
        POP BC,DE,HL:INC IX
        DEC BC:LD A,B:OR C:JP NZ,LDR4
        RET
;---------------------------------------
POINTP  ;i:HL - X (0-511)
;          DE - Y (0-511)
;           A - Value to Screen
;        o: A - Value from Screen

        PUSH AF,DE
.5      SRL D:RR E
        LD A,E:AND %00001111
        CALL MNGCVPL
        POP DE
        LD A,E:AND %00011111:ADD A,A
        LD DE,#C000:ADD A,D:LD D,A
        ADD HL,DE
        POP AF
        LD C,(HL),(HL),A,A,C
        RET

POINTR  ;i:HL - X
;          DE - Y
;        o:HL - Address in Screen

        PUSH DE
.5      SRL D:RR E
        LD A,E:AND %00001111
        CALL MNGCVPL
        POP DE
        LD A,E:AND %00011111:ADD A,A
        LD DE,#C000:ADD A,D:LD D,A
        ADD HL,DE
        LD A,(HL)
        RET
;---------------------------------------
KOPT    LD HL,LOBU,B,LBSZ:CALL LOAD512

        LD HL,(LOBU+#12),(BMPX),HL
        CALL CHKHL:RET Z
        LD HL,(LOBU+#16),(BMPY),HL
        CALL CHKHL:RET Z

        LD HL,LOBU+#36
        LD DE,512:CALL PALCNV
        LD HL,512,DE,PALREZ,BC,HL:LDIR
;-------
        LD A,%10000010:CALL GVmod
        LD A,1:CALL MNGV_PL
        EI:HALT
        LD HL,%0101001010010100
        LD (512+510),HL
        CALL PABE
        LD HL,512,DE,0,BC,HL:LDIR
        CALL PAED
;-------
        XOR A
        LD (EOF),A
        LD D,A,E,A

        LD HL,(BMPY):DEC HL
.5      SRL H:RR L,D
        LD A,L,(PAGN),A
.2      SRL D
        LD A,#C0:ADD A,D:LD D,A

        LD HL,LOBU+#36+1024
ELEK    LD A,(PAGN):CALL MNGCVPL
VSEGDA  LD BC,(BMPX)
PEKA    LDI
        LD A,H:CP LOBE[:CALL NC,OVER
        LD A,B:OR C:JP NZ,PEKA
        LD E,0:DEC D,D,D
        LD A,D:CP #C0:JR NC,VSEGDA

        LD A,(EOF):OR A:RET NZ
        LD A,(PAGN):DEC A:CP #FF:JR Z,ND
        LD (PAGN),A
        LD DE,#0000-512
        JR ELEK
;-------
ND      OR A:RET
;-------
OVER    PUSH DE,BC
        LD HL,LOBU,B,LBSZ:CALL LOAD512
        LD (EOF),A
        LD HL,LOBU
        POP BC,DE
        RET
;---------------------------------------
CHKHL   LD A,H:OR L:RET Z
        LD DE,512+1:SBC HL,DE:RET C
        XOR A
        RET
;---------------------------------------
PAED    LD BC,Vfm:XOR A:OUT A:RET
PABE    LD A,%00010000,BC,Vfm:OUT A:RET
;-------
PALCNV  ;i:HL - BGRN(4) 1024b Buffer
;        o:DE - RGB(2) 512b Buffer

        EXX:LD E,0
        EXX

        LD B,0
CNV     PUSH BC
        LD A,(HL):INC HL:CALL DEL10
        LD A,C:AND %00011000
        EXX:LD L,A,H,E
        EXX
        LD A,(HL):INC HL:CALL DEL10
        LD A,C:AND %00011000
        EXX:LD B,E,C,A
.5      SLA C:RL B
        ADD HL,BC
        EXX
        LD A,(HL):INC HL:CALL DEL10
        LD A,C:AND %00011000
        EXX
.2      SLA A
        OR H:EXA:LD A,L
        EXX
        INC HL
        LD (DE),A:INC DE:EXA
        LD (DE),A:INC DE
        POP BC
        DJNZ CNV
        RET

DEL10   LD BC,#0AFF
DEL     INC C
        SUB B:RET C
        JP DEL
;---------------------------------------
SMOV    ;CALL PR_XY

        CALL UPPP:LD B,1:JR NZ,PRETTY
        CALL DWWW:LD B,2:JR NZ,PRETTY
        CALL RGGG:LD B,3:JR NZ,PRETTY
        CALL LFFF:LD B,4:JR NZ,PRETTY
SM      LD A,1:OR A
        RET

PRETTY  LD A,1,(AST),A
        PUSH BC:CALL RLINE
        POP AF
        CALL RETY
        CALL LINER
        JR SM
;-------
RETY    LD DE,8
        DEC A:JR Z,RTU
        DEC A:JR Z,RTD
        DEC A:JR Z,RTR
        DEC A:JR Z,RTL
        RET

RTU     LD HL,(HEI):SBC HL,DE:RET Z
RtU     LD (HEI),HL
        RET
RTD     LD HL,(HEI):ADD HL,DE
        LD BC,(YYY):CALL SMR:RET NC
        JR RtU
RTR     LD HL,(WID):ADD HL,DE
        LD BC,(XXX):CALL SMR:RET NC
        JR RtL
RTL     LD HL,(WID):SBC HL,DE:RET Z
RtL     LD (WID),HL
        RET

SMR     PUSH HL
        LD DE,512+1
        ADD HL,BC
        OR A:SBC HL,DE
        POP HL
        RET
;---------------------------------------
WMOV    CALL UPPP,NZ,GYU
        CALL DWWW,NZ,GYD
        CALL RGGG,NZ,GXR
        CALL LFFF,NZ,GXL
        JR SM

GYU     LD HL,(WNDY):DEC HL
Gy      LD DE,512-240+1
        OR A:SBC HL,DE:RET NC
        ADD HL,DE:LD (WNDY),HL
        JP GYoff
GYD     LD HL,(WNDY):INC HL:JR Gy
GXR     LD HL,(WNDX):INC HL
Gx      LD DE,512-320+1
        OR A:SBC HL,DE:RET NC
        ADD HL,DE:LD (WNDX),HL
        JP GXoff
GXL     LD HL,(WNDX):DEC HL:JR Gx
;---------------------------------------
SETUS   XOR A:LD (AST),A
        CALL RLINE
        CALL SETS
        JP LINER
;-------
SETS    LD HL,USPRESE
        LD DE,WID,BC,4:LDIR
        RET
;---------------------------------------
SETUP   XOR A:LD (AST),A
        CALL RLINE
        CALL SETU
        JP LINER
;-------
SETU    LD A,(IDX):INC A
        CP 7:JR C,$+3:XOR A
        LD (IDX),A

        LD H,0,L,A
.2      ADD HL,HL
        LD DE,PRESETS:ADD HL,DE
        LD DE,WID,BC,4:LDIR
        RET
;---------------------------------------
INAME   LD IX,PLWND:CALL PRWOW

_LD HL,TXT00,DE,#000B,BC,13:CALL PRSRW
_LD A,%11110111:CALL PRIAT

_LD HL,TXT04,DE,#0205,BC,26:CALL PRSRW
_LD A,%01111110:CALL PRIAT

_LD HL,TXT01,DE,#0101,BC,5:CALL PRSRW
_LD A,%01110001:CALL PRIAT

        LD HL,TXT03,DE,#0106,BC,12
        PUSH DE
        CALL PRSRW
        LD A,%01110000:CALL PRIAT
        POP DE
        CALL GADRW

        PUSH HL
        LD DE,#0800,A,#FF:CALL ISTR

TIK     EI:HALT:CALL SPX

        CALL UPPP,NZ,SPD
        CALL DWWW,NZ,SPE

        CALL ENKE:JR NZ,TEX
        CALL ESC:JR NZ,TEX2

        LD A,#00:CALL ISTR
        JR TIK

TEX     LD A,#01:CALL ISTR
        POP HL
        LD DE,FLNAME,BC,8:LDIR

_LD HL,TXTZZ,DE,#0101,BC,32:CALL PRSRW
_LD HL,TXTZZ,DE,#0201,BC,32:CALL PRSRW

_LD HL,TXT02,DE,#0101,BC,21:CALL PRSRW
_LD A,%01111110:CALL PRIAT

        XOR A
        RET
;-------
TEX2    POP HL
        CALL RRESB

        LD A,1:OR A
        RET
;-------
SPD     LD A,1,(SPF),A :RET
SPE     XOR A:LD (SPF),A:RET

SPX     LD A,(SPF):OR A
        LD HL,TXT05:JR Z,$+5:LD HL,TXT06
        LD DE,#0114,BC,12:CALL PRSRW
        LD A,%01111111:JP PRIAT
;---------------------------------------
CLEAR   XOR A:CALL MNGCVPL
        LD HL,0,(#C000),HL

        LD A,#FF:CALL DMAPL

        LD A,#05,B,32*8-1:CALL DMAPL
        LD A,#06,B,255:CALL DMAPL

        LD HL,#0000,DE,#0002,BC,#0000
        LD A,#00:CALL DMAPL

        LD A,#FE:CALL DMAPL
        LD A,#FD:JP DMAPL
;---------------------------------------
PRWOW   LD A,1:JP WLD
RRESB   LD A,2:JP WLD
PRSRW   LD A,3:JP WLD
PRIAT   EXA:LD A,4:JP WLD
GADRW   LD A,5:JP WLD
ISTR    EXA:LD A,9:JP WLD

NORK    EXA:LD A,10:JP WLD
DMAPL   EXA:LD A,13:JP WLD
GEDPL   LD A,15:JP WLD
;-------
UPPP    LD A,17:JP WLD
DWWW    LD A,18:JP WLD
LFFF    LD A,19:JP WLD
RGGG    LD A,20:JP WLD
TABK    LD A,21:JP WLD
ENKE    LD A,22:JP WLD
ESC     LD A,23:JP WLD
F1      LD A,29:JP WLD
F5      LD A,33:JP WLD
F10     LD A,38:JP WLD
ALT     LD A,39:JP WLD
SHIFT   LD A,40:JP WLD
CTRL    LD A,41:JP WLD
USPO    LD A,46:JP WLD
NUSP    LD A,47:JP WLD
;-------
LOAD512 LD A,48:JP WLD
LOAD256 LD A,60:JP WLD
LOADNON LD A,61:JP WLD

SAVE512 LD A,49:JP WLD
MKFILE  LD A,58:JP WLD
;-------
MNGV_PL EXA:LD A,64:JP WLD
MNGCVPL EXA:LD A,65:JP WLD
GVmod   EXA:LD A,66:JP WLD
GYoff   LD A,67:JP WLD
GXoff   LD A,68:JP WLD
;---------------------------------------
PLWND   DB 0,0
        DB 23,13;    X,Y
        DB 32+2,2+2; W,H
        DB %01111111;PAPER+INK
        DB 0
        DW #0000;    BUFFER
        DB 0,0;      LINES
;-------
ERWND   DB 0,0
        DB 23,13;    X,Y
        DB 32+2,1+2; W,H
        DB %00101111;PAPER+INK
        DB 0
        DW #0000;    BUFFER
        DB 0,0;      LINES
;-------
PRESETS DW 16,16
        DW 8,16
        DW 16,8
        DW 8,8
        DW 32,32
        DW 16,32
        DW 32,16
;-------
USPRESE DW 9,16
;-------
FLNAME  DB "SPRITES SPR",0
FLSIZE  DS 4
;---------------------------------------
TXT     DB "#    "
TXT00   DB "Save Sprites:"
TXT01   DB "Name:"
TXT02   DB "            Saving..."
TXT03   DB "SPRITES .SPR"
TXT04   DB "ENTER - Save; ESC - EXIT! "
TXT05   DB "+ Pallete ",#18,#19
TXT06   DB "- Pallete ",#19,#18

TXTZZ   DS 32,32
;---------------------------------------
SPBU    DS 2

DAHL    DS 2
DADE    DS 2

BMPX    DS 2
BMPY    DS 2

WNDX    DS 2
WNDY    DS 2

XXX     DS 2
YYY     DS 2

SPF     NOP
LFL     NOP

EOF     NOP
PAGN    NOP
ESTAT   NOP

PGA     NOP
PGB     NOP
SRAD    DS 2

AST     NOP
IDX     NOP
WID     DS 2
HEI     DS 2

PALSZ   DW C16
PALsz   DW C16*2
PALOF   DW C16Z
;-------
LNBU    DS 512*4; Lines Buffer
CCNT    DS 256;   Colors in USE
TTBU    ;         Sprite Buffer
;---------------------------------------
