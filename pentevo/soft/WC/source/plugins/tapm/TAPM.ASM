;TAP Mounter
;(C) BUDDER/MGN/2013
;---------------------------------------
        ORG #6000
;-------
BINAR   EQU #6200

SPAGE   EQU #C0
EPAGE   EQU #F0
;-------
WLD     EQU #6006
TMN     EQU #6009;Timer
;-------
SYC     EQU #20AF;SysConf
PE0     EQU #21AF;MemConf
Vmod    EQU #00AF
Vpag    EQU #01AF
Vfm     EQU #15AF
;---------------------------------------
;HEADER:
        DS 16
        DB "WildCommanderMDL";    Header
        DB #02;                  Version
        DB 0;                       Type
        DB 4; Pages
        DB 0; Page to #8000
;-------
        DB 0,4-1;  CODE
        DB 1,32;   TRDOS
        DB 2,32;   Basic128
        DB 3,32;   Basic48

.2      DB 0,0
;-------
        DS 16
;-------
        DB "TAP"
        DS 31*3
;-------
        DB 0
;-------
        DW #0000,#000C; MAX SIZE
;-------
        DB "TAP Mounter v0.2"
        DB "a               "
;-------
        DB 0
;---------------------------------------
        ORG #8000,BINAR
;---------------------------------------
PLUGIN  LD (DAHL),HL,(DADE),DE

        CALL GEDPL

        LD IX,HPWND:CALL PRWOW
_LD HL,HELP,DE,#0101,BC,44:CALL PRSRW
        LD IX,PLWND:CALL PRWOW
_LD HL,TAPL,DE,#0005,BC,12:CALL PRSRW

        LD A,1:CALL YN
;-------
MAIN    EI:HALT:XOR A:CALL YN,CURSOR
        LD DE,CONFIG:CALL PRCONF

        CALL UPPP,NZ,UPC
        CALL DWWW,NZ,DNC
        CALL SPKE,NZ,CHCO
        CALL ENKE:JR Z,MAIN

        LD IX,HPWND:CALL RRESB
        LD IX,PLWND:CALL RRESB
        LD A,#FF:CALL YN:JP NZ,EXIT
;-------
LGO     LD A,SPAGE,(PAGG),A
DADU    LD HL,PAGG,A,(HL):INC (HL)
        CP EPAGE:JP NC,EXIT:CALL MNGC
        LD HL,#C000,B,32:CALL LOAD512
        CP #0F:JR NZ,DADU

        JP TAPM
;-------
PRCONF  XOR A:LD (YYY),A
PRCON   CALL GENBUF:RET Z
        PUSH DE:LD D,A,E,1:CALL PRSRW
        POP DE
        JR PRCON

GENBUF  LD A,(DE):INC A:RET Z:DEC A

        EX DE,HL
        INC HL
        LD E,(HL):INC HL
        LD D,(HL):INC HL
        PUSH AF,DE
        LD DE,TXTBUF:CALL LDIRT:INC HL
        POP BC,AF

        PUSH HL:LD HL,BC
        INC HL:LD C,(HL):INC HL
        LD B,A:INC B
        XOR A:SUB C:ADD A,C:DJNZ $-1
        PUSH BC:LD C,A:ADD HL,BC
        POP BC
        LDIR
        LD A,32
        LD B,6,(DE),A:INC DE:DJNZ $-2

        POP HL
        EX DE,HL

        LD HL,YYY:INC (HL):LD A,(HL)
        LD HL,TXTBUF,BC,20
        OR A
        RET
LDIRT   LD A,(HL):OR A:RET Z
        LD (DE),A:INC HL,DE
        JR LDIRT
;-------
CHCO    LD HL,CONFIG
        LD A,(IX+12):DEC A:JR Z,LA
        LD E,A
COCO    LD A,(HL):CP #FF:RET Z
        INC HL,HL,HL
        XOR A:LD BC,32:CPIR:RET NZ
        DEC E:JR NZ,COCO

LA      CALL CHPRM
        RET
CHPRM   PUSH HL:INC HL
        LD E,(HL):INC HL
        LD D,(HL)
        LD A,(DE),C,A
        POP HL
        INC (HL):LD A,(HL):CP C:RET C
        LD (HL),0
        RET
;-------
UPC     LD A,(IX+12):CP 1:RET Z
        CALL CURSER
        DEC (IX+12)
        JP CURSOR
DNC     LD A,(IX+12):CP (IX+13):RET NC
        CALL CURSER
        INC (IX+12)
        JP CURSOR
;-------
EXIT    CALL GEDPL
        LD A,0
        RET
;-------
PAGG    NOP
;---------------------------------------
TAPM    DI
        LD HL,RESIDE,DE,RESID,BC,RESIDL
        LDIR

        LD A,TFPG:CALL MNGC

        LD HL,WRK+#2000-#0200
        LD DE,#C000
        LD BC,#0200
        LDIR

        LD A,TRPG:CALL MNG0
        LD A,1:CALL MNGC_PL
        LD HL,#C000
        LD DE,#0000
        LD BC,#4000
        LDIR

        LD A,BCPG:CALL MNG0
        LD A,2:CALL MNGC_PL
        LD HL,#C000
        LD DE,#0000
        LD BC,#4000
        LDIR

        LD A,BAPG:CALL MNG0
        LD A,3:CALL MNGC_PL
        LD HL,#C000
        LD DE,#0000
        LD BC,#4000
        LDIR

        LD DE,#3CC0
        LD HL,#05E9
        LD (HL),#C3:INC HL
        LD (HL),E:INC HL
        LD (HL),D
        LD HL,STB+#2000-#0200
        LD BC,STBL
        LDIR

        XOR A:CALL MNGC
        LD BC,PW0,A,#F8:OUT A
        LD A,(C3),C,#08:AND 3:OR C
        LD BC,PE0:OUT A

        LD BC,#EFF7:XOR A:OUT A
        LD A,(C2):AND 1:SLA A,A:LD C,A
        LD A,(CONFIG):AND 3:OR C
        LD BC,SYC:OUT A

        LD A,63,I,A:IM 1
        LD IY,#5C3A

        LD HL,#5800,DE,HL:INC DE
        LD BC,#0800-1,(HL),L:LDIR

        LD BC,Vmod:XOR A:OUT A
        LD A,(C4):AND 1
.4      SLA A
        LD BC,#7FFD:OUT A
        JP RESID
;-------
RESIDE  LD BC,PW2,A,2:OUT A
        LD BC,PW3:XOR A:OUT A
        LD HL,#2758:EXX
        JP 0
RESIDL  EQU $-RESIDE
;---------------------------------------
PW0     EQU #10AF
PW2     EQU #12AF
PW3     EQU #13AF
;-------
BI0     EQU #C0
BI1     EQU #D0
BISY1   EQU #D0
BISY2   EQU #D0
BIPIL   EQU #E0
PILLEN  EQU #0300
;-------
TFPG    EQU #F8;SYS      [vROM]
TRPG    EQU #F9;TR-DOS   [vROM]
BCPG    EQU #FA;BASIC128 [vROM]
BAPG    EQU #FB;BASIC48  [vROM]
;-------
RESID   EQU #4000
;---------------------------------------
MNG0    LD BC,PW0:OUT A:RET
MNGC    LD BC,PW3,(#6003),A:OUT A:RET
;---------------------------------------
MNGC_PL EXA:LD A,0:JP WLD
PRWOW   LD A,1:JP WLD
RRESB   LD A,2:JP WLD
PRSRW   LD A,3:JP WLD
PRIAT   EXA:LD A,4:JP WLD
GADRW   LD A,5:JP WLD
CURSOR  LD A,6:JP WLD
CURSER  LD A,7:JP WLD
YN      EXA:LD A,8:JP WLD
ISTR    EXA:LD A,9:JP WLD

NORK    EXA:LD A,10:JP WLD
DMAPL   EXA:LD A,13:JP WLD
GEDPL   LD A,15:JP WLD
;-------
SPKE    LD A,16:JP WLD
UPPP    LD A,17:JP WLD
DWWW    LD A,18:JP WLD
LFFF    LD A,19:JP WLD
RGGG    LD A,20:JP WLD
TABK    LD A,21:JP WLD
ENKE    LD A,22:JP WLD
ESC     LD A,23:JP WLD
F1      LD A,29:JP WLD
F5      LD A,33:JP WLD
F10     LD A,38:JP WLD
ALT     LD A,39:JP WLD
SHIFT   LD A,40:JP WLD
CTRL    LD A,41:JP WLD
USPO    LD A,46:JP WLD
NUSP    LD A,47:JP WLD
;-------
LOAD512 LD A,48:JP WLD
LOAD256 LD A,60:JP WLD
LOADNON LD A,61:JP WLD

SAVE512 LD A,49:JP WLD
MKFILE  LD A,58:JP WLD
;-------
MNGV_PL EXA:LD A,64:JP WLD
MNGCVPL EXA:LD A,65:JP WLD
GVmod   EXA:LD A,66:JP WLD
GYoff   LD A,67:JP WLD
GXoff   LD A,68:JP WLD
;---------------------------------------
PLWND   DB 0,0
        DB 29,10;    X,Y
        DB 20+2,6+2; W,H
        DB %01111111;PAPER+INK
        DB 0
        DW #0000;    BUFFER
        DB 2,0;      LINES

        DB 1,4;        CURnow,CURmax
        DB %11110001,0;CURcolor
;-------
HPWND   DB 0,0
        DB 17,20;    X,Y
        DB 44+2,1+2; W,H
        DB %01001111;PAPER+INK
        DB 0
        DW #0000;    BUFFER
        DB 0,0;      LINES
;-------
TAPL    DB "TAP Mounter:"
HELP    DB "SPACE - Change option, "
        DB "ENTER - Start/Cancel."
;-------
CONFIG  DB 0:DW FRQX:DB " CPU Freq: ",0
C2      DB 0:DW ONOF:DB "    Cache: ",0
C3      DB 1:DW MELX:DB "   Memory: ",0
C4      DB 0:DW BASX:DB "      ROM: ",0
        DB #FF
;-------
FRQX    DB 3,6
        DB "3.5MHz"
        DB "7MHz  "
        DB "14MHz "
ONOF    DB 2,3
        DB "OFF"
        DB "ON "
MELX    DB 4,5
        DB "512K "
        DB "128K "
        DB "Auto "
        DB "1024K"
BASX    DB 2,8
        DB "Basic128"
        DB "Basic48 "
;---------------------------------------
TXTBUF  DS 32
;-------
SPBU    DS 2

YYY     NOP

DAHL    DS 2
DADE    DS 2
YADU    EQU $-PLUGIN
;---------------------------------------
STB     EQU BINAR+YADU
        ORG #3CC0,STB
StB     PUSH HL,BC
        LD BC,PW2,L,TFPG:OUT L
        JP #8000

EXWR    LD BC,PW2,L,#02:OUT L
        POP BC,HL
        LD B,A
        JP #05FA
STBL    EQU $-StB
;---------------------------------------
WRK     EQU STB+STBL
        ORG #8000,WRK
;-------
        LD BC,PW3:IN A:LD (OPW3),A
;-------
        LD A,(STAT)
        OR A:JR Z,LBIT
        DEC A:JP Z,PILOT1
        DEC A:JP Z,PILOT2
        DEC A:JP Z,SYN1
        DEC A:JP Z,SYN2

;NEW BLOCK

        LD HL,(TADR)
        LD A,L
        OR H:LD A,(BNK):JR NZ,LNWBN1
        LD H,#C0
        INC A:LD (BNK),A

LNWBN1  LD BC,PW3:OUT A
        LD A,(HL)
        LD (LLOW),A:INC HL
        LD A,L
        OR H:LD A,(BNK):JR NZ,LNWBN2

        LD H,#C0:INC A:LD (BNK),A

LNWBN2  OUT A
        LD A,(HL):INC HL
        LD (TADR),HL
;LD L,#00:OUT L

LLOW    EQU $+1
        LD L,0
        LD H,A
        LD (LLLEN),HL

        XOR A:LD (STAT),A
        LD A,#55,(LBIT+1),A

LBIT    LD A,#55
        RLCA
        LD (LBIT+1),A
        LD B,BI0:JP NC,EXWRK

        LD A,(BYS):ADD A,A
        LD (BYS),A
        LD A,(TBY):JR NZ,YBY

        LD HL,(LLLEN)
        LD A,L:OR H:JP Z,NXWRK;PILOT1
        DEC HL
        LD (LLLEN),HL

        LD HL,(TADR)
        LD A,L
        OR H:LD A,(BNK):JR NZ,NWBN
        LD H,#C0:INC A:LD (BNK),A

NWBN    LD BC,PW3:OUT A
        LD A,(HL):INC HL
        LD (TADR),HL
        LD L,#00:OUT L

        LD HL,BYS
        LD (HL),#FF;7 BIT

YBY     ADD A,A
        LD (TBY),A

        LD B,BI0:JP NC,EXWRK
        LD B,BI1
        JP EXWRK

BNK     DB SPAGE
TADR    DW #C000
LLLEN   DW #0001
TBY     DB 0
BYS     DB 0

PILOT1  LD HL,PILLEN
        LD (PILW),HL
        LD B,BIPIL
        JP NXWRK

PILOT2  LD B,BIPIL
        LD HL,(PILW):DEC HL
        LD (PILW),HL
        LD A,H:OR L:JR NZ,EXWRK
        JP PILOT1

PILW    DW 0

SYN1    LD B,BISY1:JP NXWRK
SYN2    LD B,BISY2
NXWRK   LD HL,STAT:INC (HL)
EXWRK   LD A,B
        LD BC,PW3
Opwz    LD L,0:OUT L
        JP EXWR
STAT    DB 1
OPW3    EQU Opwz+1
;---------------------------------------
