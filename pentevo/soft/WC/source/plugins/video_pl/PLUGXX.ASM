;Video Player v0.6h
;(C) BUDDER/MGN/2012
;---------------------------------------
        ORG #6000
        INCL "PRTGS"
;-------
WLD     EQU #6006
TMN     EQU #6009;Timer
;-------
Vfm     EQU #15AF
STS     EQU #27AF

DMASL   EQU #1AAF
DMASH   EQU #1BAF
DMASX   EQU #1CAF
DMADL   EQU #1DAF
DMADH   EQU #1EAF
DMADX   EQU #1FAF

DMA_T   EQU #28AF;0=1, 255=256
DMA_N   EQU #26AF;255=512
DMA_C   EQU #27AF;RW 1 - - - 0 0 1
;---------------------------------------
;HEADER:
        DS 16
        DB "WildCommanderMDL";    Header
        DB #02;                  Version
        DB 0;                       Type
        DB 1; Pages
        DB 0; Page to #8000
;-------
        DB 0,8; CODE

.5      DB 0,0
;-------
        DS 16
;-------
        DB "TGV"
        DS 31*3
;-------
        DB 0
;-------
        DW #FFFF,#FFFF; MAX SIZE
;-------
        DB "Video Player v0."
        DB "6h              "
;-------
        DB 0
;---------------------------------------
        ORG #8000,#6200
;-------
LOBU    EQU #B000
LOB2    EQU LOBU+512
;---------------------------------------
PLUGIN  LD (DAHL),HL,(DADE),DE

        CALL GEDPL
        XOR A
        LD (SC),A
        LD (ESTAT),A

        CALL DEVCHE:RET Z

        LD IX,PLWND:CALL PRWOW

_LD HL,TXT0,DE,#000B,BC,12:CALL PRSRW
_LD A,%11110111:CALL PRIAT
_LD HL,TXT00,DE,#010A,BC,14:CALL PRSRW
_LD A,%01110000:CALL PRIAT

        CALL CLEAR
        CALL HEADER
;-------
MAIN    CALL SHOW:JR Z,NXFL
        LD A,(SC):CP 4:CALL NC,SKIP

        CALL SHOW2:JR Z,NXFL
        LD A,(SC):CP 4:CALL NC,SKIP

        CALL ESC:JR Z,MAIN

EXIT    CALL GEDPL
        CALL STOPM

        LD IX,PLWND:CALL RRESB
        LD A,(ESTAT)
        RET
;-------
NXFL    LD A,2,(ESTAT),A:JR EXIT
;---------------------------------------
HEADER  LD HL,LOBU,B,1:CALL LOAD512

        LD HL,(LOBU+32)
        SRL H:RR L
        LD (LNZ),HL

        LD HL,(LOBU+16)
        LD A,H:OR L:CALL NZ,LOADMP3
        RET
;---------------------------------------
SHOW    XOR A:LD (PGNA),A
        LD HL,(LNZ),(LINES),HL
        LD HL,0,(TMN),HL

        LD HL,#0000,B,1:CALL LOAD512

NAG     LD A,(PGNA):CALL MNGCVPL

        LD HL,#C000
GABU    LD B,1:CALL LOAD256:CP #0F:RET Z

        EXX
        LD HL,(LINES):DEC HL
        LD A,H:OR L:JR Z,EOF
        LD (LINES),HL
        EXX

        LD A,H:OR A:JP NZ,GABU

        LD HL,PGNA:INC (HL)
        LD HL,#C000
        JP NAG
;-------
EOF     LD A,(TMN):SUB 3:CALL C,HALD
        LD HL,SC:ADD A,(HL):LD (HL),A

        LD A,%00000010:CALL GVmod
        LD A,1:CALL MNGV_PL
        EI:HALT

        LD DE,(#6000)
        LD BC,DMA_N,A,255:OUT A
        XOR A
        LD B,DMA_T[:OUT A
        LD B,DMASL[:OUT A
        LD B,DMASH[:OUT A
        LD B,DMASX[:OUT E
        LD B,DMADX[:OUT A
        LD B,DMADH[:OUT A
        LD B,DMADL[:OUT A
        LD B,DMA_C[,A,%11000100
        OUT A
        LD B,STS[:INF:JP M,$-2

        LD A,1:OR A
        RET
;---------------------------------------
SHOW2   LD A,16,(PGNA),A
        LD HL,(LNZ),(LINES),HL
        LD HL,0,(TMN),HL

        LD HL,#0000,B,1:CALL LOAD512

NAG2    LD A,(PGNA):CALL MNGCVPL

        LD HL,#C000
GABU2   LD B,1:CALL LOAD256:CP #0F:RET Z

        EXX
        LD HL,(LINES):DEC HL
        LD A,H:OR L:JR Z,EOF2
        LD (LINES),HL
        EXX

        LD A,H:OR A:JP NZ,GABU2

        LD HL,PGNA:INC (HL)
        LD HL,#C000
        JP NAG2
;-------
EOF2    LD A,(TMN):SUB 3:CALL C,HALD
        LD HL,SC:ADD A,(HL):LD (HL),A

        LD A,%00000010:CALL GVmod
        LD A,2:CALL MNGV_PL
        EI:HALT

        LD DE,(#6000)
        LD BC,DMA_N,A,255:OUT A
        XOR A
        LD B,DMA_T[:OUT A
        LD B,DMASL[:OUT A
        LD B,DMASH[:OUT A
        LD B,DMASX[:OUT E
        LD B,DMADX[:OUT A
        LD B,DMADH[:OUT A
        LD B,DMADL[:OUT A
        LD B,DMA_C[,A,%11000100
        OUT A
        LD B,STS[:INF:JP M,$-2

        LD A,1:OR A
        RET
;---------------------------------------
HALD    ADD A,3
        EI:HALT:DEC A:JR NZ,$-2
        RET
;---------------------------------------
SKIP    LD HL,(LNZ),(LINES),HL
        LD HL,0,(TMN),HL

        LD B,1:CALL LOADNON
GABUS   LD B,1:CALL LOADNON:CP #0F:RET Z

        EXX
        LD HL,(LINES):DEC HL
        LD A,H:OR L:JR Z,EOFS
        LD (LINES),HL
        EXX
        JP GABUS
;-------
EOFS    EI:HALT
        LD HL,(TMN),A,4:SUB L:JR C,OMG
        LD H,A,A,(SC):SUB H:LD (SC),A
        RET
;-------
OMG     LD HL,SC:ADD A,(HL):LD (HL),A
        RET
;---------------------------------------
CLEAR   DI
        LD (SPBU),SP
        XOR A:LD (PGNA),A

YUHU    LD A,(PGNA):CALL MNGCVPL

        LD HL,0
        LD SP,0

        LD B,128
.64     PUSH HL
        DJNZ $-64

        LD HL,PGNA:INC (HL)
        LD A,(HL):CP 28:JR C,YUHU

        LD SP,(SPBU)
        EI
        RET
;***************************************
LOADMP3 LD A,(GSENA):INC A:CALL Z,GSFET
        LD A,(GSENA):OR A:JR NZ,NONGS

        PUSH HL:CALL PBSHW,MP3HAND
        POP HL
        CALL ZALIV
        RET
;-------
NONGS   CALL PBSHW,EZALIV
        RET
;---------------------------------------
EZALIV  PUSH HL
        CALL PBPR
        LD HL,LOB2,B,1:CALL LOADNON
        POP HL
        DEC HL:LD A,H:OR L:JP NZ,EZALIV
        RET
;---------------------------------------
ZALIV   PUSH HL:CALL GSLOAD,PBPR
        POP HL
        DEC HL:LD A,H:OR L:JP NZ,ZALIV
        RET
;---------------------------------------
MP3HAND LD (MP3TOGS+4),HL

        XOR A
        OUT (#B3),A
        OUT (#BB),A
        IN A,(#BB)

        LD A,#F3:CALL SENDCOM

        LD A,#00:OUT (#B3),A
        LD A,#14:CALL SENDCOM,GSWD
        LD A,#04:CALL SENDDAT

        LD A,#00:CALL SENDDAT
        LD A,#40:CALL SENDDAT

        LD HL,MP3TOGS,BC,#0400

WAV2    PUSH BC
        LD A,(HL):CALL SENDDAT:INC HL
        POP BC
        DEC BC:LD A,B:OR C:JR NZ,WAV2

        XOR A:OUT (#B3)
        LD A,#13:CALL SENDCOM,GSWD
        LD A,#40:CALL SENDDAT

        XOR A:OUT (#BB),A
        IN A,(#B3)
        RET
;-------
GSLOAD  LD HL,LOB2,B,1:CALL LOAD512

        LD HL,LOB2
        LD BC,#80BB
TE1     IN A:RLCA:JR C,TE1
RDA     LD A,(HL):OUT (#B3),A:INC L
TE2     IN A:RLCA:JR C,TE2
RDB     LD A,(HL):OUT (#B3),A:INC L
TE3     IN A:RLCA:JR C,TE3
RDC     LD A,(HL):OUT (#B3),A:INC L
TE4     IN A:RLCA:JR C,TE4
RDD     LD A,(HL):OUT (#B3),A:INC HL
        DJNZ TE1
        RET
;-------
SNDCOM  OUT (#BB),A:RET
SENDCOM OUT (#BB),A
GSWC    IN A,(#BB)
        RRCA
        JR C,GSWC
        RET
GWC     IN A,(#BB)
        RRCA
        RET
;-------
SENDDAT OUT (#B3),A
GSWD    IN A,(#BB):RLCA:JR C,GSWD
        RET
;-------
GETDAT  IN A,(#BB):RLCA:JR NC,GETDAT
        IN A,(#B3)
        RET
;---------------------------------------
STOPM   LD A,#FE:CALL SNDCOM:RET
;---------------------------------------
GSFET   ;LD A,#80:OUT (#33)

        IN A,(#B3)
        LD B,0,C,A
STAB    IN A,(#B3):CP C:JR NZ,WSE
        DJNZ STAB

        LD A,#F3:OUT (#BB),A
        LD B,0:DJNZ $

        LD A,#23:OUT (#BB),A
        LD BC,#0F00
DIK     DEC BC:LD A,B:OR C:JR Z,WSE
        IN A,(#BB)
        RRCA
        JR C,DIK
        IN A,(#B3):CP 3:JR C,WSE
WNE     LD A,1:OUT (#B3),A
        LD A,#6A:CALL SENDCOM
        XOR A:OUT (#B3),A
        LD A,#6B:CALL SENDCOM
        XOR A
;-------
WZE     LD (GSENA),A
        PUSH AF:LD A,#F3:CALL SNDCOM
        POP AF
        RET
WSE     LD A,1:OR A
        JR WZE
;-------
MUTEGS  LD A,#F3:OUT (#BB):RET
;---------------------------------------
PBSHW   PUSH HL
        LD D,0,E,H,H,L,L,D
        CALL DEL32
        LD (PBSTL+1),HL
        LD (PBSTH+1),DE
        LD HL,0,(PBNOW),HL,(PBNOW+2),HL
        POP HL
        RET
;-------
PBHTW   EI
.4      HALT
_LD IX,PLWND
_LD HL,TXT32,DE,#0201,BC,32:CALL PRSRW
        RET
;-------
PBPR    LD HL,(PBNOW)
        LD DE,(PBNOW+2)
        LD BC,256
        ADD HL,BC:JR NC,$+3:INC DE
        LD (PBNOW),HL
        LD (PBNOW+2),DE

        CALL DELIT4P

        LD HL,TXTBU
        LD C,32
        OR A:JR NZ,$+5:LD A,C:JR DoL
        CP C:JR C,$+3:LD A,C
        LD B,A
        LD A,C:SUB B

        LD C,#DB
        LD (HL),C:INC HL:DJNZ $-2

        OR A:JR Z,DOL
DoL     LD B,A,C,#B1
        LD (HL),C:INC HL:DJNZ $-2
DOL
_LD IX,PLWND
_LD HL,TXTBU,DE,#0201,BC,32:CALL PRSRW
        RET
;---------------------------------------
DEL32
.5      SRL D:RR E,H,L
        RET
;-------
DELIT4P LD IX,0-1
NAZE    OR A
PBSTH   LD BC,0:INC IX
        EX DE,HL:SBC HL,BC:JR C,ND
PBSTL   LD BC,0
        EX DE,HL:SBC HL,BC:JR NC,PBSTH
        DEC DE
        LD A,D:INC A:JR NZ,NAZE
        LD A,E:INC A:JR NZ,NAZE
        INC DE

        ADD HL,BC
        EX DE,HL
        LD BC,(PBSTH+1)
ND      ADD HL,BC
        EX DE,HL
        PUSH IX
        POP BC
        LD A,C
        RET
;---------------------------------------
DEVCHE  LD A,(IX+29):CP 2:RET NZ

        CALL GEDPL

        LD IX,ERWND:CALL PRWOW
_LD HL,TXTER,DE,#0103,BC,26:CALL PRSRW

        CALL USPO
        CALL NUSP

        CALL RRESB

        XOR A
        RET
;---------------------------------------
PRWOW   LD A,1:JP WLD
RRESB   LD A,2:JP WLD
PRSRW   LD A,3:JP WLD
PRIAT   EXA:LD A,4:JP WLD

GEDPL   LD A,15:JP WLD
;-------
ESC     LD A,23:JP WLD
USPO    LD A,46:JP WLD
NUSP    LD A,47:JP WLD
;-------
LOAD512 LD A,48:JP WLD
LOAD256 LD A,60:JP WLD
LOADNON LD A,61:JP WLD
;-------
MNGV_PL EXA:LD A,64:JP WLD
MNGCVPL EXA:LD A,65:JP WLD
GVmod   EXA:LD A,66:JP WLD
;---------------------------------------
PLWND   DB 0,0
        DB 23,13;    X,Y
        DB 32+2,2+2; W,H
        DB %01111111;PAPER+INK
        DB 0
        DW #0000;    BUFFER
        DB 0,0;      LINES
;-------
ERWND   DB 0,0
        DB 23,13;    X,Y
        DB 32+2,1+2; W,H
        DB %00101111;PAPER+INK
        DB 0
        DW #0000;    BUFFER
        DB 0,0;      LINES
;-------
TXTBU   DS 64
TXT32   DS 32

TXT0    DB "Video Player"
TXT00   DB "Please Wait..."

TXTER   DB "CAN'T PLAY FROM SD(NGS)!!!"
;---------------------------------------
PBNOW   DS 4

SPBU    DS 2
LINES   DS 2
LNZ     DS 2

DAHL    DS 2
DADE    DS 2

SC      NOP
PGNA    NOP

GSENA   DB #FF
ESTAT   NOP
END
;---------------------------------------
;---------------------------------------
;--------------MP3 Driver---------------
;---------------------------------------
ORGSWAV EQU #6200+END-PLUGIN
;-------
MP3TOGS ORG #4000,ORGSWAV
        DI
        DI
        JR $+2+2
        DS 2
;-------
        LD SP,#5000
        LD HL,I_U_T,(#5EFF),HL
        LD A,#5E,I,A
        IM 2
;-------
        LD A,3:CALL FREQNC

        LD A,1,(PAGR2+1),A
LDE2    LD HL,PAGR2+1:INC (HL):LD A,(HL)
        OUT (#00),A
        LD HL,#8000:CALL LDPG:JR NZ,LDE2

        OUT (#00),A
        LD A,2,(PAG2+1),A
;-------
        CALL MP3INIT
;-------
        EXX:LD HL,#8000
        EXX
;-------
        EI
        LD BC,#02
WAITNGS IN A,(#01):OR A:JR NZ,EXIT2
        IN A,(#04)
        RLCA:JR NC,WAITNGS
        JP WAITNGS
;-------
EXIT2   INC A:JR NZ,FUCK2
        IN A
        LD A,(PAGR2+1),E,A
EXT2    LD A,(PAG2+1):CP E:JR Z,NXS2
        LD A,H:CP #80:JR C,EXT2
        LD (HL),0:INC HL
        JR EXT2
NXS2    LD A,(PAG2+1):CP E:JR NZ,EAH
        JR NXS2
;-------
FUCK2   IN A
EAH     DI
        LD HL,#C9FB,(I_U_T),HL
        LD A,3:CALL FREQNC
        JP #0000
;---------------------------------------
LDPG    LD C,64
D512    LD B,#80
D1      IN A,(#04):RLCA:JR NC,D1
        IN A,(#02):LD (HL),A:INC L
D2      IN A,(#04):RLCA:JR NC,D2
        IN A,(#02):LD (HL),A:INC L
D3      IN A,(#04):RLCA:JR NC,D3
        IN A,(#02):LD (HL),A:INC L
D4      IN A,(#04):RLCA:JR NC,D4
        IN A,(#02):LD (HL),A:INC HL
        DJNZ D1

        LD DE,(#4000+4):DEC DE
        LD (#4000+4),DE
        LD A,D:OR E:RET Z

        DEC C:JP NZ,D512
        LD A,1:OR A
        RET

;---------------------------------------
I_U_T   EXX:EXA
;-------
PAG2    LD A,2:OUT (#00),A

        IN A,(SSTAT):RRA:JR NC,PAGR2
        LD B,#20
DATT    LD A,(HL):OUT (MD_SEND),A:INC HL
        DJNZ DATT
        LD A,H:OR L:JR Z,POZ2

PAGR2   LD A,2:OUT (#00),A
;-------
        EXX:EXA
        EI
        RET
;-------
POZ2    LD A,(MXPG2),E,A,A,(PAG2+1)
        INC A:CP E:JR C,$+4:LD A,2
        LD (PAG2+1),A

        LD H,#80
        JP PAGR2
;---------------------------------------
MP3INIT XOR A:CALL FREQNC;         10MHz

        CALL HARDMP3

;LD HL,#020B
;LD DE,#0000
;CALL COM_MP3

        CALL SOFTMP3
        RET

;=======================================
NOPER
.32     NOP
        RET

;---------------------------------------
FREQNC  LD D,C_10MHZ;#30
        AND 3:JR Z,FREQNCS

        LD D,C_12MHZ;#10
        DEC A:JR Z,FREQNCS

        LD D,C_20MHZ;#20
        DEC A:JR Z,FREQNCS

        LD D,C_24MHZ;0

FREQNCS IN A,(GSCFG0)
        AND #CF
        OR D
        OUT (GSCFG0),A
        RET
;---------------------------------------
;HARD RESET:
HARDMP3 LD A,(#4000):OR A:RET Z

        XOR A:CALL VOL_MOD

        LD BC,MC_SEND
        LD A,%10011100:OUT (SCTRL),A

        LD HL,#0301:CALL COM_MP3
        LD A,E:AND %01110000

        PUSH AF
        LD A,M_MPXRS
        OUT (SCTRL),A:CALL NOPER

        LD A,M_MPXRS+M_SNCLR
        OUT (SCTRL),A
        IN A,(SSTAT):RRA:JR NC,$-3

        LD HL,#0203;#8000+#9B58=7000
        LD DE,#9B58:CALL COM_MP3
        POP AF

        LD HL,#0202
        LD DE,#8008:CALL Z,COM_MP3

        LD A,1:CALL FREQNC;        12MHz
        RET
;---------------------------------------
;SOFT RESET:
SOFTMP3 LD BC,MC_SEND
        LD HL,#030B:CALL COM_MP3

        PUSH DE
        LD DE,#FEFE

        LD HL,#020B:CALL COM_MP3

        LD HL,#0301:CALL COM_MP3
        LD A,E
        AND %01110000
        PUSH AF
        LD HL,#0300:CALL COM_MP3

        LD A,E:XOR 4:LD E,A
        LD HL,#0200:CALL COM_MP3
        LD A,E:XOR 4:LD E,A
        LD HL,#0200:CALL COM_MP3

        IN A,(SSTAT):RRA:JR NC,$-3

        LD HL,#0203
        LD DE,#9B58
        CALL COM_MP3
        POP AF

        LD HL,#0202
        LD DE,#8008:CALL Z,COM_MP3

        POP DE
        LD HL,#020B
        JR COM_MP3

;---------------------------------------
VOL_MOD OUT (VOL1),A
        OUT (VOL2),A
        OUT (VOL3),A
        OUT (VOL4),A
        OUT (VOL5),A
        OUT (VOL6),A
        OUT (VOL7),A
        OUT (VOL8),A
        RET
;---------------------------------------
;i: H - Command (3-READ, 2-WRITE)
;   L - Register Address
;  DE - Value

COM_MP3 CALL NOPER

        IN A,(SSTAT):RRA:JR NC,$-3

        CALL NOPER

        LD A,M_MCNCS:OUT (SCTRL),A

        CALL NOPER

        LD BC,MC_SEND
        LD A,H
        OUT H:CALL NOPER
        OUT L:CALL NOPER
        CP 3:JR Z,MP3READ

        OUT D:CALL NOPER
        OUT E

MP3END  CALL NOPER

        LD A,M_MCNCS+M_SNCLR;#82
        OUT (SCTRL),A

        JP NOPER
;-------
MP3READ LD BC,MC_READ,A,#FF
        OUT (MC_SEND),A:CALL NOPER
        IN D:CALL NOPER
        OUT (MC_SEND),A:CALL NOPER
        IN E
        JR MP3END

;=======================================
MXPG2   DB 64
MXP2    DB 4
;---------------------------------------
