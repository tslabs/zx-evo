;Wild Assembler Compilator v0.8
;(C) KOSHI/MGN 2018
;------------------------------------------------------------------------------
HEADER  EQU #0
STORML  EQU HEADER+512
MAINMDL EQU STORML+#4000

STRM    EQU 0;Storm Page (in Plugin)
MMDL    EQU 1;Main Module Page (in Plugin)

        ORG HEADER
;------------------------------------------------------------------------------
;HEADER:
        DS 16
        DB "WildCommanderMDL"
        DB #08;version
        DB 0
        DB 2;pages
        DB 0
;-------
        DB STRM,32;                   storm-like compiler
        DB MMDL,1+(ENDPL-MMODULE)/512;main module
.4      DB 0,0
;-------
        DS 16
;-------
        DB "ASM"
        DS 31*3
;-------
        DB 0
;-------
        DW #FFFF,#0007;512KB
;-------
        DB "ASM Compiler v0.8               "
;-------
        DB #00
;------------------------------------------------------------------------------
        ORG #8000,STORML
;-------
WCPG0   EQU #6000
WCPG4   EQU #6001
WCPG8   EQU #6002
WCPGC   EQU #6003

WLD     EQU #6006
TMN     EQU #6009;Timer

PW0     EQU #10AF
PW4     EQU #11AF
PWC     EQU #13AF

CYC     EQU #2BAF;Cache
CACHE   EQU %0000 0100;#8000 Only!

;Default Constants
DEFORG  EQU #6000

CBMSK   EQU %11000000; CodeBlockMask
SMBP    EQU #0;StartPage
SCBA    EQU #C000
SCBAP   EQU SMBP
CBASIZE EQU 8
ECBAP   EQU SCBAP+CBASIZE
SLBA    EQU #C000
SLBAP   EQU ECBAP
ELBAP   EQU SLBAP+2

FATAL   EQU #40
STBA    EQU #C000
STBAP   EQU ELBAP
ETBAP   EQU STBAP+32

SQUEEQU EQU #4000
SQUEQPG EQU ETBAP
SQUEEXP EQU #4000
SQUEEPG EQU SQUEQPG+1;16 Pages ;P

BUFPGX  EQU SQUEEPG+16;Loading Buffer 16KB (INCBINE)
BUFPGZ  EQU ETBAP-4;Loading Buffer 64KB (INCLUDE)
EBUFPGZ EQU BUFPGZ+4
;-------
MXCMDL  EQU 7;  MAX Command Lenght
;MXLBLL  EQU 255;MAX Label Lenght
MXEML   EQU 80; MAX Error Message Lenght

;Operand Type
OB      EQU 3
OBC     EQU 18
OHL     EQU 34;\
Ohl     EQU 9; /
Oix     EQU 32
Oiy     EQU 33
OIX     EQU Oix
OIY     EQU Oiy
O34     EQU 34;NNN
O35     EQU 35;(NNN)
MXOP    EQU 35;Operands Count

;Count of X Byte Command
CO2BC   EQU 15
CO3BC   EQU 44
CO4BC   EQU 21
CO5BC   EQU 0
CO6BC   EQU 0
CO7BC   EQU 2

;Start Address of X Byte Commands
SA2BC   EQU 0
SA3BC   EQU SA2BC+CO2BC
SA4BC   EQU SA3BC+CO3BC
SA5BC   EQU SA4BC+CO4BC
SA6BC   EQU SA5BC+CO5BC
SA7BC   EQU SA6BC+CO6BC

;Label Buffer
LABUF   EQU #AB00
LAPOS   EQU 3
LAPO2   EQU 4

;SP Zone
PLSP    EQU LABUF

;Calc Buffer
CBUF    EQU LABUF+256
CBUF1   EQU CBUF+256

;DECOD2 Buffer
D2BUF   EQU CBUF1+256
D2BUFE  EQU D2BUF+256

;Table with Commands
COMANDS EQU LBUFB-82;#0600 Bytes (Only second 81 bytes used of each 256)

;Line Buffer
LBUF0   EQU D2BUFE
LBUF1   EQU LBUF0+256
LBUF2   EQU LBUF1+256
LBUF3   EQU LBUF2+256
LBUF4   EQU LBUF3+256
LBUF5   EQU LBUF4+256
LBUF6   EQU LBUF5+256
LBUF7   EQU LBUF6+256
LBUF8   EQU LBUF7+256
LBUF9   EQU LBUF8+256
LBUFA   EQU LBUF9+256
LBUFB   EQU LBUFA+256
LBUFC   EQU LBUFB+256
LBUFD   EQU LBUFC+256
LBUFE   EQU LBUFD+256
LBUFF   EQU LBUFE+256
LBUFM   EQU LBUFF[+1

;Buffer
BUF     EQU LBUFF;Command Decode Only
BUF2    EQU BUF+2;Const1,0,Const2,0 for EXPs

;Command+Ops
CMDPARA EQU BUF+256

;Calc Prefx
C1B     EQU #01;1 Byte Index
C2B     EQU #02;2 Byte Index

CLA     EQU #04;Constant Index
CP1     EQU #05;+
CP2     EQU #06;-
CP3     EQU #07;*
CP4     EQU #08;/
CP5     EQU #09;\ Mod
CP6     EQU #0A;[ Hi
CP7     EQU #0B;] Low

;Const Type + Number size (1/2b)
TP1M    EQU #11
TP2M    EQU #12
TP1JR   EQU #21
TP1BT   EQU #31
TP1RS   EQU #41

;Const Type
TP1     EQU 1;1b + No Change
TP2     EQU 2;2b + No Change
TP3     EQU 3;1b JR
TP4     EQU 4;1b BIT
TP5     EQU 5;1b RST
;---------------------------------------
START   LD (DAHL),HL,(DADE),DE
        PUSH BC:LD A,MMDL:CALL MNG0_PL:POP BC:JP MMODULE
;-------
STORM   DI:CALL INITS

        LD HL,DEFORG,(BUX),HL,(ORGOP1),HL,(ORGOP2),HL

        CALL EBASPG:LD (HL),0
        LD A,SQUEQPG:CALL PG4
        LD HL,SQUEEQU,(QUEEQUA),HL
        LD (HL),0

        CALL LBASPG;Label
        XOR A:LD (ORGFL),A,(INCLFL),A
        INC A:LD (SLBA),A
        CALL CBASPG;Code
        CALL TBASPG;Text

BUU     CALL DUPLING:JP C,EBUU
        CALL GENL:JP C,ER
        CALL TBAUPG:JP C,ER
        CALL TBACPG
        JP BUU

INCLMODE CALL GENL:JP C,ER
         CALL TBAUPG:JP C,ER

         LD A,1,(INCLFL),A
         LD HL,TBA,DE,INCLDD,BC,3:LDIR

         LD HL,STBA,(TBA),HL
         LD A,BUFPGZ,(TBAPG),A
         CALL TBACPG
         JR BUU
         
EBUU    CP 1:JR Z,INCLMODE
        CP 2:JP NZ,ER
EBAU    CALL GENL:JP C,ER

        LD A,(INCLFL):OR A:JR Z,GOTOPASS2
        XOR A:LD (INCLFL),A
        LD HL,INCLDD,DE,TBA,BC,3:LDIR
        CALL TBACPG
        CALL REM:JR NC,BUU
        CP 2:JP NZ,ER
        JR EBAU

GOTOPASS2 LD A,5:OUT (254)
;-------
;Calculating and Adding EQUs to LabelTbl
        LD A,SQUEQPG:CALL PG4
        LD HL,SQUEEQU
PAZZ    CALL PAss2:JP C,ER,Z,PASSZ

        PUSH BC
        LD C,(HL):INC C
        LD DE,LABUF,B,0:LDIR
        POP BC

        EX DE,HL
        LD (HL),0:INC L
        LD (HL),C:INC L
        LD (HL),B
        EX DE,HL:CALL GENL:JR C,ER
        JP PAZZ

;Exps Calculation
PASSZ   CALL EBASPG
PASS2   LD A,(HL):INC A:JR NZ,PAAA
        LD A,(QUEEXPP):INC A
        LD (QUEEXPP),A:CALL PG4
        LD HL,SQUEEXP
PAAA    CALL PAss2:JR C,ER,Z,ER

        LD E,(HL):INC HL
        LD D,(HL):INC HL
        LD A,(HL):INC HL
        CALL CBATPG
        LD A,(HL):INC HL
        DEC A:JR Z,TP1N
        DEC A:JR Z,TP2N
        DEC A:JR Z,TP3N
        DEC A:JR Z,TP4N
        DEC A:JR Z,TP5N
        DI:HALT

TP1N    LD A,C,(DE),A:JP PASS2
TP2N    LD A,C,(DE),A:INC DE
        LD A,B,(DE),A:JP PASS2
TP3N    PUSH DE
        LD E,(HL):INC HL
        LD D,(HL):INC HL
        PUSH HL
        LD HL,BC:OR A:SBC HL,DE:LD BC,HL
        CALL JIRAF
        POP HL
        POP DE:JR C,ER
        LD A,C,(DE),A:JP PASS2
TP4N    CALL BITCHA:JR C,ER
TP45N   LD A,(HL):INC HL
        OR C:LD (DE),A:JP PASS2
TP5N    CALL RSTCHA:JR C,ER,TP45N
;-------
ER      LD (DA),A

        EX DE,HL
        LD DE,LBUF1
        LD BC,255:LDIR
        XOR A:LD (DE),A

        CALL TBACPG
        LD DE,LBUF2,BC,255:LDIR
        XOR A:LD (DE),A

        CALL WCPGS
        DI:LD SP,(WCSP):EI

        LD A,MMDL:CALL MNG0_PL
        JP EXIT

;---------------------------------------;
;i: BC',1 ($ Delta)                     ;
;   DE',Exp1 (inc D to Exp2...ExpN)     ;
;    DE,Ops                             ;
;    HL,Code Block                      ;
;---------------------------------------;
ELD     LD A,19:OR A:SCF:RET

Cld     LD A,(DE):OR A:RET Z:INC E
        EXX:INC C
        EXX:JP CLd

CLD     LD A,(DE):OR A:JR Z,ELD:INC E
CLd     ADD A,A
        ADD A,LDSCT]
        LD B,LDSCT[
        LD C,A:JR NC,$+3:INC B

        LD A,(DE):OR A:JR Z,ELD:INC E
        LD (NLN+1),A

        EXA:LD A,(BC):INC BC
        EXA:LD A,(BC),B,A
        EXA:LD C,A:OR B
NLN     LD A,0
        PUSH BC:RET NZ
        POP BC

LDopE   LD A,32:OR A:SCF:RET
;-------
LD10    LD BC,LD10T+1
        CP OB:JR C,LD3T2

LD3_10  CP 11:JR C,LD3T1
        SUB O3BD:JR C,LDopE
        CP Oix-O3BD:JR NC,LD3T3
        PUSH AF:EXA
        POP AF

        PUSH BC
        ADD A,C:LD C,A:JR NC,$+3:INC B

        LD A,(BC):OR A
        POP BC:JR Z,LDopE

        LD (HL),A:INC HL

        CP #DD:JR Z,LD3X
        CP #FD:JP NZ,Cld
LD3X    EXA:DEC BC
        AND %00000001
        ADD A,4
        EXA:LD A,(BC),C,A
        EXA:ADD A,C
        LD (HL),A:INC HL

        EXX:INC C
        EXX:JP Cld

LD3T1   SUB OB:DEC BC
        EXA:LD A,(BC),C,A
        EXA:ADD A,C

        LD (HL),A:INC HL:JP Cld

LD3T2   LD (HL),#ED:INC HL
        DEC A:LD A,#57:JR Z,$+4:LD A,#5F
        LD (HL),A:INC HL
        EXX:INC C
        EXX:JP Cld

LD3T3   CP 33-O3BD:JR Z,A35
        CP 34-O3BD:JR Z,A36
        CP 35-O3BD:JR Z,A37

A34     CALL LD3_7E2:JP Z,LDopE
        CALL DECOD:RET C

        LD (HL),#DD
A3435   INC HL
A7E2    LD (HL),0
A34A    INC HL
        LD (HL),C,A,TP1M:CALL NZ,DECODX
        INC HL

        EXX:INC C,C
        EXX:JP Cld

A35     CALL LD3_7E2:JP Z,LDopE
        CALL DECOD:RET C
        LD (HL),#FD
        JR A3435
LD3_7E2 ADD A,C:LD C,A:JR NC,$+3:INC B
        LD A,(BC):OR A:LD (A7E2+1),A
        RET

A36     ADD A,C:LD C,A:JR NC,$+3:INC B
        LD A,(BC),(A7E3+1),A
        CALL DECOD:RET C

A7E3    LD (HL),0:INC HL
        LD (HL),C,A,TP1M:CALL NZ,DECODX
        INC HL

        EXX:INC C
        EXX:JP Cld

A37     CALL DECOD:RET C

        LD (HL),#3A:INC HL
        LD (HL),C,A,TP2M:CALL NZ,DECODX
        INC HL
        LD (HL),B:INC HL

        EXX:INC C,C
        EXX:JP Cld

LD10T   DB #78;A,B
        DB #DD;A,IXH unDOC 24
        DB #DD;A,IXL unDOC 25
        DB #FD;A,IYH unDOC 26
        DB #FD;A,IYL unDOC 27
        DB 0;         28
        DB #1A;A,(DE) 29
        DB #0A;A,(BC) 30
        DB 0;         31
        DB #7E;       32
        DB #7E;       33
        DB #3E;       34
;-------
LD4     LD BC,LD04T+1
        CP OB:JP C,LDopE
        CP 35:JP Z,LDopE
        JP LD3_10

LD04T   DB #48;C,B
        DB #DD;C,IXH unDOC 24
        DB #DD;C,IXL unDOC 25
        DB #FD;C,IYH unDOC 26
        DB #FD;C,IYL unDOC 27
        DB 0;         28
        DB 0;         29
        DB 0;         30
        DB 0;         31
        DB #4E;       32
        DB #4E;       33
        DB #0E;C,N    34

LD5     LD BC,LD05T+1
        CP OB:JP C,LDopE
        CP 35:JP Z,LDopE
        JP LD3_10

LD05T   DB #50;D,B
        DB #DD;D,IXH unDOC 24
        DB #DD;D,IXL unDOC 25
        DB #FD;D,IYH unDOC 26
        DB #FD;D,IYL unDOC 27
        DB 0;         28
        DB 0;         29
        DB 0;         30
        DB 0;         31
        DB #56;       32
        DB #56;       33
        DB #16;D,N    34

LD6     LD BC,LD06T+1
        CP OB:JP C,LDopE
        CP 35:JP Z,LDopE
        JP LD3_10

LD06T   DB #58;E,B
        DB #DD;E,IXH unDOC 24
        DB #DD;E,IXL unDOC 25
        DB #FD;E,IYH unDOC 26
        DB #FD;E,IYL unDOC 27
        DB 0;         28
        DB 0;         29
        DB 0;         30
        DB 0;         31
        DB #5E;       32
        DB #5E;       33
        DB #1E;E,N    34

LD7     LD BC,LD07T+1
        CP OB:JP C,LDopE
        CP 35:JP Z,LDopE
        JP LD3_10

LD07T   DB #60;H,B
        DB #DD;H,IXH unDOC 24
        DB #DD;H,IXL unDOC 25
        DB #FD;H,IYH unDOC 26
        DB #FD;H,IYL unDOC 27
        DB 0;         28
        DB 0;         29
        DB 0;         30
        DB 0;         31
        DB #66;       32
        DB #66;       33
        DB #26;H,N    34

LD8     LD BC,LD08T+1
        CP OB:JP C,LDopE
        CP 35:JP Z,LDopE
        JP LD3_10

LD08T   DB #68;L,B
        DB #DD;L,IXH unDOC 24
        DB #DD;L,IXL unDOC 25
        DB #FD;L,IYH unDOC 26
        DB #FD;L,IYL unDOC 27
        DB 0;         28
        DB 0;         29
        DB 0;         30
        DB 0;         31
        DB #6E;       32
        DB #6E;       33
        DB #2E;L,N    34

LD9     LD BC,LD09T+1
        CP OB:JP C,LDopE
        CP 35:JP Z,LDopE
        CP 9:JP Z,LDopE
        JP LD3_10

LD09T   DB #70;(HL),B
        DB 0;         24
        DB 0;         25
        DB 0;         26
        DB 0;         27
        DB 0;         28
        DB 0;         29
        DB 0;         30
        DB 0;         31
        DB 0;         32
        DB 0;         33
        DB #36;(HL),N 34

LD3     LD BC,LD03T+1
        CP OB:JP C,LDopE
        CP 35:JP Z,LDopE
        JP LD3_10

LD03T   DB #40;B,B
        DB #DD;B,IXH unDOC 24
        DB #DD;B,IXL unDOC 25
        DB #FD;B,IYH unDOC 26
        DB #FD;B,IYL unDOC 27
        DB 0;         28
        DB 0;         29
        DB 0;         30
        DB 0;         31
        DB #46;       32
        DB #46;       33
        DB #06;B,N    34

LD183   ;BC,DE
        LD (HL),#42:INC HL
        LD (HL),#4B:JP LD212B
LD184   ;BC,HL
        LD (HL),#44:INC HL
        LD (HL),#4D:JP LD212B

LD18    ;BC,
        CP 19:JR Z,LD183
        CP 20:JR Z,LD184
        CP 34:JR Z,LD181
        CP 35:JR Z,LD182
        JP LDopE

LD181   ;BC,N
        CALL DECOD:RET C

        LD (HL),#01
LD18A   INC HL
        LD (HL),C,A,TP2M:CALL NZ,DECODX
        INC HL
        LD (HL),B:INC HL

        EXX:INC C,C
        EXX:JP Cld

LD182   ;BC,(N)
        CALL DECOD:RET C

        LD A,#4B
LD18B   EXX:INC BC
        EXX

        LD (HL),#ED:INC HL
        LD (HL),A:JR LD18A

LD19    ;DE,
        CP 18:JR Z,LD193
        CP 20:JR Z,LD194
        CP 34:JR Z,LD191
        CP 35:JR Z,LD192
        JP LDopE

LD191   ;DE,N
        CALL DECOD:RET C
        LD (HL),#11:JR LD18A

LD192   ;DE,(N)
        CALL DECOD:RET C
        LD A,#5B:JR LD18B

LD193   ;DE,BC
        LD (HL),#50:INC HL
        LD (HL),#59:JR LD212B
LD194   ;DE,HL
        LD (HL),#54:INC HL
        LD (HL),#5D:JR LD212B

LD20    ;HL,
        CP 18:JR Z,LD203
        CP 19:JR Z,LD204
        CP 34:JR Z,LD201
        CP 35:JR Z,LD202
        JP LDopE

LD201   ;HL,N
        CALL DECOD:RET C
        LD (HL),#21:JR LD18A

LD202   ;HL,(N)
        CALL DECOD:RET C
        LD (HL),#2A:JR LD18A

LD203   ;HL,BC
        LD (HL),#60:INC HL
        LD (HL),#69:JR LD212B
LD204   ;HL,DE
        LD (HL),#62:INC HL
        LD (HL),#6B:JR LD212B

LD21    CP 20:JR Z,LD211
        CP 22:JR Z,LD212
        CP 23:JR Z,LD213
        CP 34:JR Z,LD214
        CP 35:JR Z,LD215
        JP LDopE

LD211   ;SP,HL
        LD (HL),#F9:INC HL:JP Cld

LD212   ;SP,IX
        LD A,#DD
LD212A  LD (HL),A:INC HL
        LD (HL),#F9
LD212B  INC HL
        EXX:INC C
        EXX:JP Cld

LD213   ;SP,IY
        LD A,#FD:JR LD212A

LD214   ;SP,N
        CALL DECOD:RET C
        LD (HL),#31:JP LD18A

LD215   ;SP,(N)
        CALL DECOD:RET C
        LD A,#7B:JP LD18B

LD22    CP 34:JR Z,LD221
        CP 35:JR Z,LD222
        JP LDopE

LD221   ;IX,N
        CALL DECOD:RET C
        LD A,#21
LD22A   EXX:INC BC
        EXX
        LD (HL),#DD:INC HL
        LD (HL),A:JP LD18A

LD222   ;IX,(N)
        CALL DECOD:RET C
        LD A,#2A:JR LD22A

LD23    CP 34:JR Z,LD231
        CP 35:JR Z,LD232
        JP LDopE

LD231   ;IY,N
        CALL DECOD:RET C
        LD A,#21
LD23A   EXX:INC BC
        EXX
        LD (HL),#FD:INC HL
        LD (HL),A:JP LD18A

LD232   ;IY,(N)
        CALL DECOD:RET C
        LD A,#2A:JR LD23A

LD24    EXA:LD A,#DD
LD24Y   LD (DA3),A
        EXA
        LD C,#60;IXH
        CP 34:JR Z,LD241
LD24A   CP OB:JP C,LDopE
        CP 10:JR Z,LD24Z
        CP 7:JP NC,LDopE
LD24Z   SUB OB:ADD A,C
        EXA:LD A,(DA3),(HL),A:INC HL
        EXA:LD (HL),A:JP LD212B

LD241   LD A,#26
LD24B   LD (DA2),A
        CALL DECOD:RET C

        LD A,(DA3),(HL),A:INC HL
        LD A,(DA2),(HL),A:JP A34A

LD25    EXA:LD A,#DD
LD25Y   LD (DA3),A
        EXA
        LD C,#68;IXL
        CP 34:JR NZ,LD24A
        LD A,#2E:JR LD24B

LD26    EXA:LD A,#FD:JR LD24Y
LD27    EXA:LD A,#FD:JR LD25Y

LD29    ;(DE),A
        CP 10:JP NZ,LDopE
        LD (HL),#12:INC HL:JP Cld

LD30    ;(BC),A
        CP 10:JP NZ,LDopE
        LD (HL),#02:INC HL:JP Cld

LD32    LD C,#DD
LD32A   CP Ohl:JP Z,LDopE
        CP 34:JR Z,LD32B
        CP 11:JP NC,LDopE
        SUB OB:JP C,LDopE
        ADD A,#70

        LD (HL),C:INC HL
        LD (HL),A

        CALL DECOD:RET C:JP A34A

LD32B   LD (HL),C:INC HL
        LD (HL),#36:INC HL

        CALL DECOD:RET C
        LD (HL),C,A,TP1M:CALL NZ,DECODX
        INC HL

        CALL DECOD:RET C
        LD (HL),C,A,TP1M:CALL NZ,DECODX
        INC HL

        EXX:INC C,C,C
        EXX:JP Cld

LD33    LD C,#FD:JR LD32A

LD35    CP 10:JR Z,LD351
        CP 18:JR Z,LD352
        CP 19:JR Z,LD353
        CP 20:JR Z,LD354
        CP 21:JR Z,LD355
        CP 22:JR Z,LD356
        CP 23:JP NZ,LDopE

        LD (HL),#FD:INC HL
        LD (HL),#22
LD35A   INC HL
        CALL DECOD:RET C
        LD (HL),C,A,TP2M:CALL NZ,DECODX
        INC HL
        LD (HL),B:INC HL
        EXX:INC C,C,C
        EXX:JP Cld

LD351   LD (HL),#32
LD351A  INC HL
        CALL DECOD:RET C
        LD (HL),C,A,TP2M:CALL NZ,DECODX
        INC HL
        LD (HL),B:INC HL
        EXX:INC C,C
        EXX:JP Cld
LD352   LD (HL),#ED:INC HL
        LD (HL),#43:JR LD35A
LD353   LD (HL),#ED:INC HL
        LD (HL),#53:JR LD35A
LD354   LD (HL),#22:JR LD351A
LD355   LD (HL),#ED:INC HL
        LD (HL),#73:JR LD35A
LD356   LD (HL),#DD:INC HL
        LD (HL),#22:JR LD35A

LD1     CP 10:JP NZ,LDopE
        LD (HL),#ED:INC HL
        LD (HL),#47:JP LD212B
LD2     CP 10:JP NZ,LDopE
        LD (HL),#ED:INC HL
        LD (HL),#4F:JP LD212B

LDSCT   DW 0
        DW LD1
        DW LD2
        DW LD3
        DW LD4
        DW LD5
        DW LD6
        DW LD7
        DW LD8
        DW LD9
        DW LD10
.7      DW 0
        DW LD18
        DW LD19
        DW LD20
        DW LD21
        DW LD22
        DW LD23
        DW LD24
        DW LD25
        DW LD26
        DW LD27
        DW 0
        DW LD29
        DW LD30
        DW 0
        DW LD32
        DW LD33
        DW 0
        DW LD35
;-------
CREMAP  CP RMPL:RET NC

        LD BC,RMP
        ADD A,C:LD C,A:JR NC,$+3:INC B

        LD A,(BC):CP 1:RET Z
        SCF:RET
;-------
CJRA    LD A,#18
CJra    LD (DA2),A
        CALL DECOD:RET C:JR NZ,CJRa

        PUSH HL
        LD HL,BC
        EXX
        LD HL,(BUX):ADD HL,BC:INC HL
        PUSH HL
        EXX:POP BC
        OR A:SBC HL,BC:LD BC,HL
        POP HL:CALL JIRAF:RET C
        XOR A

CJRa    LD A,(DA2),(HL),A:INC HL
        LD (HL),C
        LD A,TP1JR:CALL NZ,DECODX
        INC HL

        EXX:INC C
        EXX

Cjr     LD A,(DE):OR A:RET Z:INC E
        EXX:INC C
        EXX:JR CJr
;-------
CJR     LD A,(DE):OR A:JP Z,ELD:INC E
CJr     CP 34:JR Z,CJRA
        CALL CREMAP:JP NC,LDopE
        CP %00100000:JP NC,LDopE
        EXA
        LD A,(DE):OR A:JP Z,ELD:INC E
        CP 34:JP NZ,LDopE
        EXA:OR %00100000:JR CJra

JIRAF   JR C,JRFF
        LD A,B:OR A:JR NZ,JRoffE
        LD A,C:CP 128:JR NC,JRoffE
        XOR A
        RET
JRFF    LD A,B:INC A:JR NZ,JRoffE
        LD A,C:CP 128:JR C,JRoffE
        RET

JRoffE  LD A,35:OR A:SCF:RET
;-------
CJPA    LD A,#C3
CJpa    LD (DA2),A
        CALL DECOD:RET C

        LD A,(DA2),(HL),A:INC HL
        LD (HL),C
        LD A,TP2M:CALL NZ,DECODX
        INC HL
        LD (HL),B:INC HL

        EXX:INC C,C
        EXX

Cjp     LD A,(DE):OR A:RET Z:INC E
        EXX:INC C
        EXX:JR CJp
;-------
CJP     LD A,(DE):OR A:JP Z,ELD:INC E
CJp     CP 9:JR Z,JPHL
        CP 32:JR Z,JPIX
        CP 33:JR Z,JPIY
        CP 34:JR Z,CJPA
        CALL CREMAP:JP NC,LDopE
        EXA
        LD A,(DE):OR A:JP Z,ELD:INC E
        CP 34:JP NZ,LDopE
        EXA:OR %11000010:JR CJpa

JPHL    LD (HL),#E9:INC HL:JR Cjp
JPIX    LD (HL),#DD
JPix    INC HL
        EXX:INC C
        LD A,(DE):INC DE:CP "0"
        LD A,(DE)
        EXX:JP NZ,LDopE
        OR A:JP NZ,LDopE
        EXX:INC D:LD E,0
        EXX:JR JPHL
JPIY    LD (HL),#FD:JR JPix
;-------
Cex     LD A,(DE):OR A:RET Z:INC E
        EXX:INC C
        EXX:JR CEx
;-------
CEX     LD A,(DE):OR A:JP Z,ELD:INC E
CEx     CP 19:JR Z,EXDE
        CP 20:JR Z,EXHL
        CP 31:JR Z,EXSP
        CP 34:JP NZ,LDopE
EXEXP   EXX:CALL ISAF
        EXX:JP NZ,LDopE

        LD A,(DE):OR A:JP Z,ELD:INC E
        CP 34:JP NZ,LDopE

        EXX:CALL ISAF
        EXX:JP NZ,LDopE

        LD (HL),#08:INC HL
        JR Cex

ISAF    LD A,(DE):CP "A":RET NZ:INC E
        LD A,(DE):CP "F":RET NZ:INC E
        LD A,(DE):OR A:JR Z,ISaf
        CP "'":RET NZ:INC E
        LD A,(DE):OR A:RET NZ
ISaf    INC D:XOR A:LD E,A
        RET

EXDE    LD A,(DE):OR A:JP Z,ELD:INC E
        CP 20:JP NZ,LDopE
EXde    LD (HL),#EB:INC HL:JR Cex
EXHL    LD A,(DE):OR A:JP Z,ELD:INC E
        CP 19:JP NZ,LDopE
        JR EXde
EXSP    LD A,(DE):OR A:JP Z,ELD:INC E
        CP 20:JR Z,EXSHL
        CP 22:JR Z,EXSIX
        CP 23:JP NZ,LDopE
EXSIY   LD (HL),#FD
EXsiy   INC HL
        EXX:INC C
        EXX
EXSHL   LD (HL),#E3:INC HL:JP Cex
EXSIX   LD (HL),#DD:JR EXsiy
;-------
CEXA    LD A,(DE):OR A:RET NZ
        LD (HL),#08:INC HL
        RET
;-------
CORA    CALL DECOD:RET C

        LD A,(DA3)
        LD (HL),A:INC HL
        LD (HL),C,A,TP1M:CALL NZ,DECODX
        INC HL

        EXX:INC C
        EXX

Cor     LD A,(DA2)
        CP #80:JR Z,Cadd
        CP #88:JP Z,Cadc
        CP #98:JP Z,Csbc
        LD A,(DE):OR A:RET Z:INC E
        EXX:INC C
        EXX:JR COr
;-------
COR     LD BC,#F6B0
CORZ    LD (DA2),BC
        LD A,(DE):OR A:JP Z,ELD:INC E
COr     CP 32:JR Z,ORIX
        CP 33:JR Z,ORIY
        CP 34:JR Z,CORA
        SUB OB:JP C,LDopE
        CP 8:JP NC,LDopE

        LD BC,(DA2):OR C
        LD (HL),A:INC HL
        JR Cor

ORIX    LD A,#DD
ORix    LD (HL),A:INC HL
        CALL DECOD:RET C

        EXA:LD A,(DA2):ADD A,6
        LD (HL),A:INC HL
        EXA
        LD (HL),C,A,TP1M:CALL NZ,DECODX
        INC HL

        EXX:INC C,C
        EXX:JR Cor
ORIY    LD A,#FD:JR ORix
;-------
CAND    LD BC,#E6A0:JR CORZ
CXOR    LD BC,#EEA8:JR CORZ
CCP     LD BC,#FEB8:JR CORZ
CSUB    LD BC,#D690:JR CORZ
;-------
Cadd    LD A,(DE):OR A:RET Z:INC E
        EXX:INC C
        EXX:JR CADd
CADD    LD A,(DE):OR A:JP Z,ELD:INC E
CADd    CP 20:JR Z,ADDHL
        CP 22:JR Z,ADDIX
        CP 23:JR Z,ADDIY

        CP 10:JP NZ,LDopE
        LD BC,#C680
        JP CORZ
;-------
Cadc    LD A,(DE):OR A:RET Z:INC E
        EXX:INC C
        EXX:JR CADc
CADC    LD A,(DE):OR A:JP Z,ELD:INC E
CADc    CP 20:JR Z,ADCHL
        CP 10:JP NZ,LDopE
        LD BC,#CE88
        JP CORZ
;-------
Csbc    LD A,(DE):OR A:RET Z:INC E
        EXX:INC C
        EXX:JR CSBc
CSBC    LD A,(DE):OR A:JP Z,ELD:INC E
CSBc    CP 20:JR Z,SBCHL
        CP 10:JP NZ,LDopE
        LD BC,#DE98
        JP CORZ
;-------
ADDHL   LD A,(DE):OR A:JP Z,ELD:INC E

ADDhl   SUB OBC:JP C,LDopE
        CP 4:JP NC,LDopE
.4      ADD A,A
        OR %00001001
        LD (HL),A:INC HL
        JP Cadd

ADDIY   LD BC,#17FD:JR ADDix
ADDIX   LD BC,#16DD
ADDix   LD A,(DE):OR A:JP Z,ELD:INC E
        CP 20:JP Z,LDopE
        LD (HL),C:INC HL
        EXX:INC C:EXX
        CP B:JR NZ,ADDhl
        LD A,20:JR ADDhl
;-------
ADCHL   LD A,(DE):OR A:JP Z,ELD:INC E
        SUB OBC:JP C,LDopE
        CP 4:JP NC,LDopE
.4      ADD A,A
        OR %01001010
        LD (HL),#ED:INC HL
        LD (HL),A:INC HL
        EXX:INC C
        EXX:JP Cadc
;-------
SBCHL   LD A,(DE):OR A:JP Z,ELD:INC E
        SUB OBC:JP C,LDopE
        CP 4:JP NC,LDopE
.4      ADD A,A
        OR %01000010
        LD (HL),#ED:INC HL
        LD (HL),A:INC HL
        EXX:INC C
        EXX:JP Csbc
;-------
INPRT   EXA:CP 10:JP NZ,LDopE

INFE    CALL DECOD:RET C
        LD (HL),#DB:INC HL
        LD (HL),C,A,TP1M:CALL NZ,DECODX
        INC HL
        EXX:INC C
        EXX
;-------
Cin     LD A,(DE):OR A:RET Z:INC E
        EXX:INC C
        EXX:JR CIn
;-------
CIN     LD A,(DE):OR A:JP Z,ELD:INC E
CIn     CP 35:JR Z,INFE
        EXA
        LD A,(DE):OR A:JR Z,INA:INC E
        CP 28:JR Z,INA
        CP 35:JR Z,INPRT
        DEC E
INA     EXA
        CP 34:JR Z,CINFA
        SUB OB:JP C,LDopE
        CP 6:JP Z,LDopE
        CP 8:JP NC,LDopE
.3      ADD A,A
        OR %01000000
Cina    LD (HL),#ED:INC HL
        LD (HL),A:INC HL

        EXX:INC C
        EXX:JR Cin

CINFA   EXX
        LD A,(DE):INC E
        CP "F":JR NZ,INZA
        LD A,(DE):OR A
INZA    EXA:INC D:LD E,0:EXA
        EXX:JP NZ,LDopE

        LD A,#70:JR Cina
;-------
CDI     LD A,(DE):OR A:RET NZ
        LD (HL),#F3:INC HL
        RET
CEI     LD A,(DE):OR A:RET NZ
        LD (HL),#FB:INC HL
        RET
CIM     LD A,(DE):OR A:JP Z,ELD:INC E
        CP 34:JP NZ,LDopE

        CALL DECOD:RET C
        LD (HL),#ED:INC HL
        LD A,C:CP 3:JP NC,LDopE
        OR A:JR Z,CIMA
        DEC A
        LD A,#56:JR Z,CIMB
        LD A,#5E:JR CIMB
CIMA    LD A,#46
CIMB    LD (HL),A:INC HL

        EXX:INC C
        EXX
        LD A,(DE):OR A:JP NZ,EA
        RET
;-------
Crot    LD A,6,(DA3),A
        LD A,(DE):OR A:RET Z:INC E
        EXX:INC C
        EXX:JR CROt
;-------
CRL     LD A,%00010000;010
CROT    LD (DA2),A
        LD A,6,(DA3),A
        LD A,(DE):OR A:JP Z,ELD:INC E
CROt    CP 32:JR Z,ROTIX
        CP 33:JR Z,ROTIY
        SUB OB:JP C,LDopE
        CP 6:JR Z,ROTHL
        CP 8:JP NC,LDopE

        EXA
        LD A,(DE):OR A:JR Z,ROTT
        CP 32:JR Z,RODD
        CP 33:JR NZ,ROTT
RODD    INC E
        EXA:LD (DA3),A
        EXA:CP 32:JR Z,ROTIX,ROTIY

ROTT    EXA
ROTHL   LD BC,(DA2):OR C
        LD (HL),#CB:INC HL
        LD (HL),A:INC HL
        EXX:INC C
        EXX:JR Crot

ROTIX   LD A,#DD
ROTix   LD (HL),A:INC HL
        CALL DECOD:RET C

        LD (HL),#CB:INC HL
        LD (HL),C,A,TP1M:CALL NZ,DECODX
        INC HL
        LD BC,(DA2),A,B:OR C
        LD (HL),A:INC HL

        EXX:INC C,C,C
        EXX:JP Crot
ROTIY   LD A,#FD:JR ROTix
;-------
CRLC    LD A,%00000000:JP CROT;000 0
CRRC    LD A,%00001000:JP CROT;001 1
CRR     LD A,%00011000:JP CROT;011 3
CSLA    LD A,%00100000:JP CROT;100 4
CSRA    LD A,%00101000:JP CROT;101 5
CSLL    LD A,%00110000:JP CROT;110 6
CSRL    LD A,%00111000:JP CROT;111 7
;-------
Cdw     LD A,(DE):OR A:RET Z:INC E
        EXX:INC C
        EXX:JR CDw
CDW     LD A,(DE):OR A:JP Z,ELD:INC E
CDw     CP 34:JP NZ,LDopE

        CALL DECOD:RET C
        LD (HL),C,A,TP2M:CALL NZ,DECODX
        INC HL
        LD (HL),B:INC HL

        EXX:INC C
        EXX:JR Cdw
;-------
Cdb     LD A,(DE):OR A:RET Z:INC E
        EXX:INC C
        EXX:JR CDb
CDB     LD A,(DE):OR A:JP Z,ELD:INC E
CDb     CP 34:JP NZ,LDopE

        EXX:PUSH DE
        EXX:POP BC
        LD A,(BC):CP #22:JR NZ,DBS:INC C
        LD A,(BC):CP #22:JR Z,DBS:INC C
        OR A:JP Z,LDopE
        LD A,(BC):CP #22:JR Z,DBS:DEC C

        EXX:INC D:DEC C
        EXX

DBSTR   LD A,(BC):INC C
        OR A:JR Z,Cdb
        CP #22:JR Z,Cdb

        LD (HL),A:INC HL
        EXX:INC C
        EXX:JP DBSTR

DBS     CALL DECOD:RET C:JR NZ,TATA
        LD A,B:OR A:JP NZ,BCC
        LD (HL),C
        XOR A
TATA    LD A,TP1M:CALL NZ,DECODX
        INC HL
        JR Cdb
;-------
CNOP    LD A,(DE):OR A:RET NZ
        LD (HL),#00:INC HL
        RET
;-------
Cinc    LD A,(DE):OR A:RET Z:INC E
        EXX:INC C
        EXX:JR CINc
;-------
INCbIX  LD (HL),#DD
INCbI   INC HL
        LD (HL),#34:INC HL

        CALL DECOD:RET C
        LD (HL),C,A,TP1M:CALL NZ,DECODX
        INC HL
        EXX:INC C,C
        EXX:JR Cinc
INCbIY  LD (HL),#FD:JR INCbI

INCIX   LD (HL),#DD
INCix   INC HL
        LD (HL),#23:INC HL
        EXX:INC C
        EXX:JR Cinc
INCIY   LD (HL),#FD:JR INCix

INCA    CP 32:JR Z,INCbIX
        CP 33:JR Z,INCbIY
        SUB OBC:JP C,LDopE
        CP 6:JP NC,LDopE
        CP 4:JR Z,INCIX
        CP 5:JR Z,INCIY
.4      ADD A,A
        OR %00000011
        LD (HL),A:INC HL
        JP Cinc

CINC    LD A,(DE):OR A:JP Z,ELD:INC E
CINc    CP 11:JR NC,INCA
        SUB OB:JP C,LDopE
.3      ADD A,A
        OR %00000100
        LD (HL),A:INC HL
        JP Cinc
;-------
Cdec    LD A,(DE):OR A:RET Z:INC E
        EXX:INC C
        EXX:JR CDEc
;-------
DECbIX  LD (HL),#DD
DECbI   INC HL
        LD (HL),#35:INC HL

        CALL DECOD:RET C
        LD (HL),C,A,TP1M:CALL NZ,DECODX
        INC HL
        EXX:INC C,C
        EXX:JR Cdec
DECbIY  LD (HL),#FD:JR DECbI

DECIX   LD (HL),#DD
DECix   INC HL
        LD (HL),#2B:INC HL
        EXX:INC C
        EXX:JR Cdec
DECIY   LD (HL),#FD:JR DECix

DECA    CP 32:JR Z,DECbIX
        CP 33:JR Z,DECbIY
        SUB OBC:JP C,LDopE
        CP 6:JP NC,LDopE
        CP 4:JR Z,DECIX
        CP 5:JR Z,DECIY
.4      ADD A,A
        OR %00001011
        LD (HL),A:INC HL
        JP Cdec

CDEC    LD A,(DE):OR A:JP Z,ELD:INC E
CDEc    CP 11:JR NC,DECA
        SUB OB:JP C,LDopE
.3      ADD A,A
        OR %00000101
        LD (HL),A:INC HL
        JP Cdec
;-------
CDAA    LD A,(DE):OR A:RET NZ
        LD (HL),#27:INC HL
        RET
CCPL    LD A,(DE):OR A:RET NZ
        LD (HL),#2F:INC HL
        RET
CSCF    LD A,(DE):OR A:RET NZ
        LD (HL),#37:INC HL
        RET
CCCF    LD A,(DE):OR A:RET NZ
        LD (HL),#3F:INC HL
        RET
;-------
CRET    LD A,(DE):OR A:JR NZ,Cret
        LD (HL),#C9:INC HL
        RET
Cret    INC E
CREt    CALL CREMAP:JP NC,LDopE
        OR %11000000
        LD (HL),A:INC HL
        LD A,(DE):OR A:RET Z:INC E
        EXX:INC C
        EXX:JR CREt
;-------
CEXX    LD A,(DE):OR A:RET NZ
        LD (HL),#D9:INC HL
        RET
;-------
Cout    LD A,(DE):OR A:RET Z:INC E
        EXX:INC C
        EXX:JR COUt
;-------
COUT    LD A,(DE):OR A:JP Z,ELD:INC E
COUt    CP 28:JR Z,OUTC
        CP 35:JR Z,OUTN

CouT    SUB OB:JP C,LDopE
        CP 6:JP Z,LDopE
        CP 8:JP NC,LDopE

.3      ADD A,A
        OR %01000001
        LD (HL),#ED:INC HL
        LD (HL),A:INC HL
        EXX:INC C
        EXX:JR Cout

OUTC    LD A,(DE):OR A:JP Z,ELD:INC E
        JP CouT

OUTN    LD A,(DE):OR A:JR Z,OUTn
        CP 35:JR Z,OUTn
        CP 10:JP NZ,LDopE
        INC E

OUTn    CALL DECOD:RET C
        LD (HL),#D3:INC HL
        LD (HL),C,A,TP1M:CALL NZ,DECODX
        INC HL
        EXX:INC C
        EXX:JR Cout
;-------
CRLA    LD A,(DE):OR A:RET NZ
        LD (HL),#17:INC HL
        RET
CRRA    LD A,(DE):OR A:RET NZ
        LD (HL),#1F:INC HL
        RET
;-------
Cbit    LD A,6,(DA3),A
        LD A,(DE):OR A:RET Z:INC E
        EXX:INC C
        EXX:JR CBIt
;-------
CBIT    LD A,%01000000
CBITX   LD (DA2),A
        LD A,6,(DA3),A
        LD A,(DE):OR A:JP Z,ELD:INC E
CBIt    CP 34:JP NZ,LDopE

        LD A,(DE):OR A:JP Z,ELD:INC E
        CP 32:JR Z,BITIX
        CP 33:JR Z,BITIY
        SUB OB:JP C,LDopE
        CP 6:JR Z,BITHL
        CP 8:JP NC,LDopE

        EXA
        LD A,(DE):OR A:JR Z,BITT
        CP 32:JR Z,BIDD
        CP 33:JR NZ,BITT
BIDD    INC E
        EXA:LD (DA3),A
        EXA:CP 32:JR Z,BITIX,BITIY

BITT    EXA
BITHL   LD (DA3),A
        LD (HL),#CB:INC HL
        CALL DECOD:RET C:JR NZ,BITAFT
        CALL BITCHA:RET C
        LD A,(DA3):OR C
        LD BC,(DA2):OR C
        LD (HL),A:XOR A
BITAFT  LD A,TP1BT:CALL NZ,DECODX
        INC HL
        EXX:INC C
        EXX:JP Cbit

BITIY   LD A,#FD:JR BITix
BITIX   LD A,#DD
BITix   LD (HL),A:INC HL
        LD (HL),#CB:INC HL

        INC HL
        CALL DECOD:RET C:JR NZ,BITAF2
        CALL BITCHA:RET C
        LD A,(DA3):OR C
        LD BC,(DA2):OR C
        LD (HL),A:XOR A
BITAF2  LD A,TP1BT:CALL NZ,DECODX
        DEC HL

        CALL DECOD:RET C
        LD (HL),C,A,TP1M:CALL NZ,DECODX
        INC HL
        INC HL

        EXX:INC C,C,C
        EXX:JP Cbit
;-------
BITCHA  LD A,B:OR A:JR NZ,BCC
        LD A,C:CP 8:JR NC,BCC
.3      SLA C
        RET
BCC     LD A,15:OR A:SCF:RET
;-------
CRES    LD A,%10000000:JP CBITX
CSET    LD A,%11000000:JP CBITX
;-------
CNEG    LD A,(DE):OR A:RET NZ
        LD (HL),#ED:INC HL
        LD (HL),#44:INC HL
        EXX:INC BC
        EXX:RET
;-------
Crst    LD A,(DE):OR A:RET Z:INC E
        EXX:INC C
        EXX:JR CRSt
;-------
CRST    LD A,(DE):OR A:JP Z,ELD:INC E
CRSt    CP 34:JP NZ,LDopE

        CALL DECOD:RET C:JR NZ,RSTN
        CALL RSTCHA:RET C
        OR %11000111:LD (HL),A
        XOR A
RSTN    LD A,TP1RS:CALL NZ,DECODX
        INC HL
        JR Crst
;-------
RSTCHA  LD A,B:OR A:JP NZ,BCC
        LD A,C:AND %11000111:JP NZ,BCC
        LD A,C
        RET
;-------
CEQU    LD A,(DE):OR A:JP Z,ELD:INC E
        CP O34:JP NZ,LDopE
        LD A,(DE):OR A:JR NZ,EA

        LD A,(LABUF):OR A:JR Z,EB
        CALL DECOD3:RET C:JR NZ,DQ

        PUSH HL
        LD HL,LABUF,L,(HL):INC L,L
        LD (HL),C:INC L
        LD (HL),B
        POP HL
        JR CQ

DQ      PUSH HL,DE
        CALL DECOD4:JR NC,CQII

        LD A,SQUEQPG:CALL PG4
        LD DE,(QUEEQUA)
        LD HL,D2BUF,BC,(DEQ),B,L:LDIR

        LD HL,LABUF
        LD C,(HL),B,L:INC C:LDIR
        LD (QUEEQUA),DE
        XOR A:LD L,A,(HL),A,(DE),A
        JR CQIQ

CQII    LD HL,LABUF,L,(HL):INC L,L
        LD (HL),C:INC L
        LD (HL),B
CQIQ    POP DE,HL
CQ      EXX:DEC C
        EXX
        RET

EA      LD A,31:OR A:SCF:RET
EB      LD A,34:OR A:SCF:RET
;-------
CRLCA   LD A,(DE):OR A:RET NZ
        LD (HL),#07:INC HL
        RET
CRRCA   LD A,(DE):OR A:RET NZ
        LD (HL),#0F:INC HL
        RET
CLDIR   LD C,#B0
CED     LD A,(DE):OR A:RET NZ
        LD (HL),#ED:INC HL
        LD (HL),C:INC HL
        EXX:INC C
        EXX:XOR A:RET
CCPIR   LD C,#B1:JR CED
CLDDR   LD C,#B8:JR CED
CCPDR   LD C,#B9:JR CED
CINIR   LD C,#B2:JR CED
COTIR   LD C,#B3:JR CED
CINDR   LD C,#BA:JR CED
COTDR   LD C,#BB:JR CED

CLDI    LD C,#A0:JR CED
CCPI    LD C,#A1:JR CED
CLDD    LD C,#A8:JR CED
CCPD    LD C,#A9:JR CED
COUTI   LD C,#A3:JR CED
COUTD   LD C,#AB:JR CED
CINI    LD C,#A2:JR CED
CIND    LD C,#AA:JR CED

CINF    LD C,#70:JR CED

CRRD    LD C,#67:JR CED
CRLD    LD C,#6F:JR CED
;-------
CDJNZ   LD A,(DE):OR A:JP Z,ELD:INC E
        CP 34:JP NZ,LDopE
        LD A,(DE):OR A:RET NZ

        LD (HL),#10:INC HL
        CALL DECOD:RET C:JR NZ,CDJ
        PUSH HL
        LD HL,BC
        EXX
        LD HL,(BUX):ADD HL,BC:INC HL
        PUSH HL
        EXX:POP BC
        OR A:SBC HL,BC:LD BC,HL
        POP HL:CALL JIRAF:RET C
        XOR A
CDJ     LD (HL),C,A,TP1JR:CALL NZ,DECODX
        INC HL
        EXX:INC C
        EXX:XOR A:RET
;-------
CCALLA  LD A,#CD
CCALLa  LD (DA2),A
        CALL DECOD:RET C

        LD A,(DA2),(HL),A:INC HL
        LD (HL),C
        LD A,TP2M:CALL NZ,DECODX
        INC HL
        LD (HL),B:INC HL

        EXX:INC C,C
        EXX

        LD A,(DE):OR A:RET Z:INC E
        EXX:INC C
        EXX:JR Ccall
;-------
CCALL   LD A,(DE):OR A:JP Z,ELD:INC E
Ccall   CP 34:JR Z,CCALLA
        CALL CREMAP:JP NC,LDopE
        EXA
        LD A,(DE):OR A:JP Z,ELD:INC E
        CP 34:JP NZ,LDopE
        EXA:OR %11000100:JR CCALLa
;-------
CHALT   LD A,(DE):OR A:RET NZ
        LD (HL),#76:INC HL
        RET
;-------
Cpush   LD A,(DE):OR A:RET Z:INC E
        EXX:INC C
        EXX:JR CPUSh

CPUSH   LD C,%11000101
CPUSHA  LD A,(DE):OR A:JP Z,ELD:INC E
CPUSh   CP 22:JR Z,CPUSHIX
        CP 23:JR Z,CPUSHIY
        CP 34:JR Z,PUSHAF
        SUB OBC:JP C,LDopE
        CP 3:JP NC,LDopE
PUSHA
.4      ADD A,A
        OR C
        LD (HL),A:INC HL
        JR Cpush
CPOP    LD C,%11000001:JR CPUSHA

CPUSHIX LD A,#DD
CPUSHix EXX:INC C:EXX
        LD (HL),A:INC HL
        LD A,2:JR PUSHA
CPUSHIY LD A,#FD:JR CPUSHix
PUSHAF  EXX
        LD A,(DE):INC E
        CP "A":JR NZ,PUZA
        LD A,(DE):INC E
        CP "F":JR NZ,PUZA
        LD A,(DE):OR A
PUZA    EXA:INC D:LD E,0:EXA
        EXX:JP NZ,LDopE
        LD A,3:JR PUSHA
;-------
Cds     LD A,(DE):OR A:RET Z:INC E
        EXX:INC BC
        EXX:JR CDs
CDS     LD A,(DE):OR A:JP Z,ELD:INC E
CDs     CP 34:JP NZ,LDopE

        CALL DECOD2:RET C
        LD (DBC2),BC

        LD C,0
        LD A,(DE):OR A:JR Z,DS1:INC E
        CP 34:JP NZ,LDopE

        CALL DECOD2:RET C
        LD A,B:OR A:JP NZ,BCC
DS1     EXX:DEC BC:EXX
        LD (DDE),DE
        LD DE,(DBC2)
DS2     LD A,H:CP #40
        CALL C,RECBA:JP C,CBAER
        LD (HL),C:INC HL:EXX:INC BC:EXX
        DEC DE:LD A,D:OR E:JP NZ,DS2
        LD DE,(DDE)
        JR Cds
;-------
CORG    XOR A:LD (DA2),A
        LD A,(DE):OR A:JP Z,ELD:INC E
        CP 34:JP NZ,LDopE

        LD A,(DE):OR A:JR Z,NO2OP:INC E
        CP 34:JP NZ,LDopE
        LD A,1,(DA2),A

        LD A,(DE):OR A:JP NZ,EA

NO2OP   PUSH HL
        LD HL,(BUX),DE,(ORGOP1):OR A:SBC HL,DE
        LD DE,(ORGOP2):ADD HL,DE
        LD (ORGPRX),HL
        POP HL

        CALL DECOD2:RET C
        LD (DHL),HL
        LD (DBC),BC,(ORGOP1),BC

        LD A,(DA2):OR A:JR Z,AOSE
        CALL DECOD2:RET C

AOSE    ;ORGs TABLE GEN is COMING SOON!!

        LD (ORGOP2),BC
;-------
        LD A,(ORGFL):OR A:LD A,1,(ORGFL),A:JR Z,FIRST

        LD HL,BC
        LD BC,(ORGPRX):OR A:SBC HL,BC:JR C,NETR

        LD BC,(DHL):ADD HL,BC
        LD A,H:CP #C0:CALL C,RECBA:JR C,CBAER
        LD (DHL),HL
NETR    LD BC,(DBC)

FIRST   LD (BUX),BC
        LD HL,(DHL)

        EXX:DEC C
        EXX:RET

CBAER   LD A,21:OR A:SCF:RET

DECOD3  LD A,1,(OPO),A:CALL DECOD
        EXA:XOR A:LD (OPO),A
        EXA:RET

DECOD2  CALL DECOD3:RET C,Z
DECOD4  PUSH HL,DE
        LD HL,D2BUF:CALL PAss2
        PUSH AF:CALL CBACPG
        POP AF
        POP DE,HL
        RET NZ
DCDE    LD A,30:OR A:SCF:RET
;-------
EINCL   LD A,3:OR A:SCF:RET

CINCL   LD A,(DE):OR A:JP Z,ELD:INC E
        CP 34:JP NZ,LDopE
        LD A,(DE):OR A:JP NZ,EA

        LD A,(INCLFL):OR A:JR NZ,EINCL

        EXX:PUSH DE
        EXX:POP DE

        LD A,(DE):CP #22:JP NZ,LDopE
        XOR A:LD (DE),A:INC E
kaboo   LD A,(DE):INC E:JP Z,LDopE
        OR A:JP Z,LDopE
        CP #22:JR NZ,kaboo:DEC E
        XOR A:LD (DE),A,E,A
;-------
        CALL WCPGS
        EI
        EX DE,HL:CALL FENTRY:JP Z,ERRLOAD
        LD A,D:OR E:JP NZ,ERRLOA2
        
        CALL GFILE
        CALL LOADFL2
        DI
;-------
        CALL CBACPG
        EXX:LD BC,0
        EXX:LD A,1:OR A:SCF:RET

LOADFL2 LD A,BUFPGZ,(APG),A
LFL2    LD A,(APG):CALL MNGCVPL
        LD HL,#C000,B,32:CALL LOAD512
        CP #0F:RET Z

        LD HL,APG:INC (HL)
        LD A,(HL):CP EBUFPGZ:RET NC
        JR LFL2
;-------
CINCB   LD A,(DE):OR A:JP Z,ELD:INC E
        CP 34:JP NZ,LDopE
        LD A,(DE):OR A:JP NZ,EA

        EXX:PUSH DE
        EXX:POP DE

        LD A,(DE):CP #22:JP NZ,LDopE
        XOR A:LD (DE),A:INC E
KABOO   LD A,(DE):INC E:JP Z,LDopE
        OR A:JP Z,LDopE
        CP #22:JR NZ,KABOO:DEC E

        XOR A:LD (DE),A,E,A

        CALL WCPGS
        EI
        EX DE,HL:CALL FENTRY:JR Z,ERRLOAD
        LD A,D:OR E:JR NZ,ERRLOA2
        LD A,H:CP #40:JR C,NOERRLO,NZ,ERRLOA2
        LD A,L:OR A:JR NZ,ERRLOA2

NOERRLO PUSH HL:CALL GFILE
        POP HL

        PUSH HL
        SRL H:INC H
        LD A,H:CP 32:JR C,$+4:LD A,32
        PUSH AF:LD A,BUFPGX:CALL MNGCVPL
        POP AF:LD B,A,HL,#C000:CALL LOAD512
        DI
        LD A,BUFPGX:CALL PG4
        CALL CBACPG
        EXX
        POP BC

        PUSH BC
        EXX
        POP BC
        LD DE,#4000
        EX DE,HL:LDIR
        EX DE,HL
        XOR A
        RET

ERRLOAD DI:LD A,37:OR A:SCF:RET
ERRLOA2 DI:LD A,38:OR A:SCF:RET
;---------------------------------------
INITS   XOR A:CALL MNGCVPL
        LD A,(WCPGC),(PGDELTA),A

        LD DE,COMANDS
        LD HL,CMD2,B,2-1:CALL DECRCOM
        LD HL,CMD3,B,3-1:CALL DECRCOM
        LD HL,CMD4,B,4-1

DECRCOM LD C,D
        LD A,(HL):OR A:RET Z
        LD (DE),A:INC D,E

        PUSH BC
DECO    INC HL:LD A,(HL),(DE),A:INC D
        DJNZ DECO
        POP BC

        INC HL:LD A,(HL),(DE),A:INC D
        INC HL:LD A,(HL),(DE),A
        INC HL:LD D,C
        JP DECRCOM

;---------------------------------------
;Code Block Addres Curent Pages
CBACPG  LD A,(CBAPG)
        CALL PGC:INC A:CALL PG0
        LD HL,(CBA)
        RET

;Code Block Address Start Pages
CBASPG  LD A,SCBAP,(CBAPG),A
        CALL PGC:INC A:CALL PG0
        LD HL,SCBA,(CBA),HL
        RET

;CBA seT Pages
CBATPG  CALL PGC:INC A:JP PG0

;UPD CBA Vars
RECBA   LD A,H:CP #C0:RET NC
        SET 7,H
        SET 6,H
        AND %11000000
.2      RLCA
        INC A
        PUSH BC:LD BC,(CBAPG):ADD A,C
        POP BC:CP ECBAP:JR NC,RECBAE
        LD (CBAPG),A:CALL CBATPG
        XOR A
        RET
RECBAE  SCF:RET
;-------
;Text Block Address Curent Page
TBACPG  LD A,(TBAPG)
        CALL PGC:INC A:CALL PG0
        LD HL,(TBA)
        RET

;Text Block Address Start Page
TBASPG  LD A,STBAP,(TBAPG),A
        CALL PGC:INC A:CALL PG0
        LD HL,STBA,(TBA),HL
        RET

;Text Block Address Update
TBAUPG  LD A,H:CP STBA[:JR NC,BAU
        LD BC,#4000
        OR A:SBC HL,BC:JR NC,TBAFAT
        LD A,(TBAPG):INC A
        LD (TBAPG),A
BAU     LD (TBA),HL
        XOR A
        RET
TBAFAT  LD A,33:SCF:RET
;-------
EBACCPG LD HL,(QUEEXPA)
        LD A,H:CP SQUEEXP[+#3E:JR C,EBCC
        LD (HL),#FF
        LD HL,SQUEEXP
        LD A,(QUEEXPP):INC A
        LD (QUEEXPP),A
EBCC    LD A,(QUEEXPP)
        JP PG4

EBACPG  LD A,(QUEEXPP)
        CALL PG4
        LD HL,(QUEEXPA)
        RET

EBASPG  LD A,SQUEEPG,(QUEEXPP),A
        CALL PG4
        LD HL,SQUEEXP,(QUEEXPA),HL
        RET
;-------
;Labels Block Address Start Page
LBASPG  LD A,SLBAP
        CALL PGC:INC A:CALL PG0
        LD HL,SLBA,(LBA),HL
        RET
;---------------------------------------
PG0     PUSH BC
        LD BC,(PGDELTA):ADD A,C
        LD BC,PW0:OUT A
        POP BC
        RET
PG0B    LD A,(WC0),BC,PW0:OUT A:RET

PG4     PUSH BC
        LD BC,(PGDELTA):ADD A,C
        LD BC,PW4:OUT A
        POP BC
        RET
PG4B    LD A,(WC4),BC,PW4:OUT A:RET

PGC     PUSH BC,AF
        LD BC,(PGDELTA):ADD A,C
        LD BC,PWC:OUT A
        POP AF,BC
        RET
WCPGS   CALL PG0B
        CALL PG4B
PGCB    LD A,(WCC),BC,PWC:OUT A:RET
;---------------------------------------
EPASS   LD A,30:SCF:RET

PAss2   LD (DDD),HL

        LD C,SLBAP
        LD A,(PGDELTA):ADD A,C
        LD BC,PWC:OUT A:INC A
        LD BC,PW0:OUT A

        LD A,1
MAZA    LD (INDEX),A
        LD HL,SLBA
        LD DE,(DDD)
        LD A,(DE):CP #20:JR C,PASSD
        LD B,0
        JP MASA

PANX
DDD     EQU $+1:LD DE,0
PANx    ADD HL,BC

MASA    LD C,(HL):DEC C:JR Z,EPASS
        INC HL
        LD A,(DE):CP (HL):JP NZ,PANx
        DEC C:INC HL,DE
PASA    LD A,(DE):CP (HL):JP NZ,PANX
        DEC C:INC HL,DE:OR A:JP NZ,PASA

        LD (DDD),DE

        LD A,(HL):INC HL
        LD H,(HL),L,A

        LD C,#20
VaZ     LD A,(DE):INC DE
        CP C:JP NC,VaZ:OR A:JR Z,VaZ

        DEC DE
ZaZ     LD A,(DE):INC DE
        CP CLA:JP NZ,PaZ
        LD A,(DE)
INDEX   EQU $+1:CP 0:JR NZ,PAZ
        DEC DE:LD A,C2B,(DE),A
        INC DE
        LD A,L,(DE),A:INC DE
        LD A,H,(DE),A:INC DE
        JP ZaZ

PaZ     ;CP C1B:JR Z,PAZ+1
        CP C2B:JP NZ,PAZA
PAZ     INC DE,DE
PAZA    OR A:JP NZ,ZaZ
        LD A,(INDEX):INC A:JP MAZA

PASSD   EX DE,HL:LD A,(HL):OR A:RET Z

        EXX:PUSH DE,BC
        EXX:CALL POLSK
        EXX:POP BC,DE
        EXX
        LD A,#FF:OR A
        RET

DECOD   PUSH HL,DE:CALL DECODER
        POP DE,HL
        RET
;---------------------------------------
REM     ;END LINE

        LD A,(HL)
        OR A:JR Z,FEX
        CP #0A:JR Z,LEX
        CP #0D:JR Z,LEX
        INC HL
;LD A,H:CP FATAL:JP C,REM
;CP STBA[:JP C,TBAFAT
        JP REM

LEX     INC HL
;LD A,H:CP FATAL:JR C,Lex
;CP STBA[:JP C,TBAFAT
Lex     LD A,(HL):OR A:JR Z,FEX
        CP #0A:JR Z,LEX
        CP #0D:JR Z,LEX

        XOR A
        RET

FEXX    DEC HL
FEX     ;END OF KEKS

        LD A,2:SCF
        RET
SDE     LD A,36:SCF:RET
;-------
DUPLING ;i:HL - ADDRES IN TEXT

        LD DE,LABUF
        XOR A:LD (DE),A:INC E

        LD A,(HL):INC HL
        OR A:JR Z,FEXX
        CP ".":JP NZ,NREPL

        LD DE,"00",C,E
        LD A,(HL):INC HL
        CP #30:JR C,SDE
        CP #3A:JR NC,SDE
        LD C,A
        LD A,(HL):INC HL
        CP #30:JR C,XREPL
        CP #3A:JR NC,XREPL
        LD E,C,C,A
        LD A,(HL):INC HL
        CP #30:JR C,XREPL
        CP #3A:JR NC,XREPL
        LD D,E,E,C,C,A
        LD A,(HL):INC HL
XREPL   CP #09:JR Z,XRP
        CP " ":JR NZ,SDE

XRP     LD A,D:SUB #30:JR Z,XRP1
        CP 3:JR NC,SDE
        LD B,A:XOR A:ADD A,100:DJNZ $-2
XRP1    LD D,A
        LD A,E:SUB #30:JR Z,XRP2
        LD B,A,A,D
Xrp1    ADD A,10:JR C,SDE
        DJNZ Xrp1
        LD D,A
XRP2    LD A,C:SUB #30:ADD A,D:JR C,SDE
        LD B,A

XRP3    PUSH BC
        LD DE,LABUF
        XOR A:LD (DE),A:INC E
        PUSH HL:CALL NOL:LD (XX+1),HL
        POP HL
        POP BC:RET C
        DJNZ XRP3
XX      LD HL,0
        XOR A
        RET

NREPL   CP #09:JR Z,NOL;TAB
        CP " ":JR Z,NOL;SPACE

        CP ";":JP Z,REM

        CP #41:JR C,NOK
        CP #5B:JR C,OK
        CP "_":JR Z,NOL;STORM
        CP #61:JR C,NOK
        CP #7B:JR NC,NOK
;-------
OK      ;LABEL INDEX
Ok      LD (DE),A:INC E
        LD A,(HL):INC HL
        CP #30:JR C,Nok
        CP #3A:JR C,Ok
        CP #41:JR C,Nok
        CP #5B:JR C,Ok
        CP "_":JR Z,Ok
        CP #61:JR C,Nok
        CP #7B:JR C,Ok
Nok     CP #09:JR Z,LGENN
        CP " ":JR Z,LGENN

        CP ";":JR Z,LGENS
        CP #0A:JR Z,LGENZ
        CP #0D:JR Z,LGENZ
        OR A:JR Z,LGENE

NOK     LD A,6:SCF:RET
;-------
NCok    LD A,4:SCF:RET
;-------
LGENN   CALL GENLA:JP NOL
;-------
LGENS   CALL GENLA:JP REM
;-------
LGENZ   CALL GENLA:XOR A:RET
;-------
LGENE   CALL GENLA:DEC HL:JP FEX
;---------------------------------------
NOL     ;i:HL - InText

        LD DE,CMDPARA
SKP     LD A,(HL):INC HL
        CP " ":JP Z,SKP
        CP #09:JR Z,SKP
        DEC HL

        CP ";":JP Z,REM
        CP #0A:JP Z,REM
        CP #0D:JP Z,REM
        OR A:JP Z,REM

        CP #41:JR C,NCok
        CP #5B:JR C,Cok
        CP #61:JR C,NCok
        CP #7B:JR NC,NCok

Cok     LD BC,BUF; ^256
        LD A,(HL):RES 5,A
        LD (BC),A:INC C

MOBY    INC HL:LD A,(HL):RES 5,A
        CP #41:JR C,NEok
        CP #5B:JR NC,NEok
        LD (BC),A:INC C
        LD A,C:CP MXCMDL+1:JR C,MOBY

        LD A,5:SCF:RET

NEok    LD A,(HL)
        CP #09:JR Z,COM
        CP " ":JR Z,COM

        CP ":":JR Z,COM

        CP ";":JR Z,COM
        CP #0A:JR Z,COM
        CP #0D:JR Z,COM
        OR A:JR Z,COM

        LD A,4:SCF
        RET
;-------
COM     XOR A:LD (BC),A
        LD (DHL),HL

        LD A,C
        CP 2:JR C,UNCOM,Z,COM2
        CP 3:JR Z,COM3
        CP 4:JP Z,COM4
        CP 5:JR Z,UNCOM
        CP 6:JR Z,UNCOM
COM7    JR UNCOM
;-------
UNCOM   LD A,5:SCF:RET
;-------
NOTC2   LD HL,(DHL):JR UNCOM

COM2    LD HL,COMANDS+SA2BC
        LD BC,CO2BC
NXCC2   LD A,(BUF):CPIR:JR NZ,NOTC2

        INC H:LD A,(BUF+1):CP (HL):JR Z,YESC2
        DEC H

        LD A,C:OR A:JP NZ,NXCC2
        JR NOTC2

YESC2   INC H:LD A,(HL),(DE),A:INC E
        INC H:LD A,(HL),(DE),A:INC E
        JP OPER
;-------
NOTC3   LD HL,(DHL):JR UNCOM

COM3    LD HL,COMANDS+SA3BC
        LD BC,CO3BC
NXCC3   LD A,(BUF):CPIR:JR NZ,NOTC3

        INC H:LD A,(BUF+1):CP (HL):JR Z,YEC3A
        DEC H
        LD A,C:OR A:JP NZ,NXCC3
        JR NOTC3

YEC3A   INC H:LD A,(BUF+2):CP (HL):JR Z,YESC3
        DEC H,H
        LD A,C:OR A:JP NZ,NXCC3
        JR NOTC3

YESC3   INC H:LD A,(HL),(DE),A:INC E
        INC H:LD A,(HL),(DE),A:INC E
        JP OPER
;-------
NOTC4   LD HL,(DHL):JR UNCOM

COM4    LD HL,COMANDS+SA4BC
        LD BC,CO4BC
NXCC4   LD A,(BUF):CPIR:JR NZ,NOTC4

        INC H:LD A,(BUF+1):CP (HL):JR Z,YEC4A
        DEC H
        LD A,C:OR A:JP NZ,NXCC4
        JR NOTC4

YEC4A   INC H:LD A,(BUF+2):CP (HL):JR Z,YEC4B
        DEC H,H
        LD A,C:OR A:JP NZ,NXCC4
        JR NOTC4

YEC4B   INC H:LD A,(BUF+3):CP (HL):JR Z,YESC4
        DEC H,H,H
        LD A,C:OR A:JP NZ,NXCC4
        JR NOTC4

YESC4   INC H:LD A,(HL),(DE),A:INC E
        INC H:LD A,(HL),(DE),A:INC E
        JP OPER
;-------
OPe     XOR A:LD (BC),A
        CALL GENC:RET C
        JP NOL

OPE     DEC HL
        XOR A:LD (BC),A
        CALL GENC:RET C
        JP REM
;---------------------------------------
OPER    LD HL,(DHL)
        LD BC,LBUF0
NullOp  XOR A:LD (BC),A:INC B
        LD A,B:CP LBUFM:JP C,NullOp

        LD BC,LBUF0
KYKY    LD A,(HL):INC HL
        CP " ":JP Z,KYKY
        CP #09:JR Z,KYKY

        CP #22:CALL Z,QUO:JP Z,ECHR;"
        CP #22:JR Z,OP
        CP ",":JR Z,EOP

        CP ":":JR Z,OPe
        CP ";":JR Z,OPE
        CP #0A:JR Z,OPE
        CP #0D:JR Z,OPE
        OR A:JR Z,OPE
        JP OPP

OP      LD A,(HL):INC HL
        CP " ":JP Z,OP
        CP #09:JR Z,OP

        CP #22:CALL Z,QUO:JP Z,ECHR
        CP #22:JR Z,OP
        CP ",":JR Z,NXOP

        CP ":":JR Z,NXOP2;OPe

        CP ";":JR Z,NXOP2;OPE
        CP #0A:JR Z,NXOP2;OPE
        CP #0D:JR Z,NXOP2;OPE
        OR A:JR Z,NXOP2;OPE

OPP     CP #21:JR C,EOP2
        CP #80:JR NC,EOP2

        CP ".":JR Z,EOP2
        CP "{":JR Z,EOP2
        CP "}":JR Z,EOP2

        LD (BC),A:INC C:JP NZ,OP

        LD A,12:SCF:RET
;-------
EOP     
EOP2    LD A,10:SCF:RET
EOP4    LD A,14:SCF:RET
EOP5    LD A,15:SCF:RET
EOP6    LD A,18:SCF:RET
;-------
NXOP2   DEC HL:CALL NXPP:RET C:JP KYKY
NXOP    CALL NXPP:RET C

KYK     LD A,(HL):INC HL
        CP " ":JP Z,KYK
        CP #09:JR Z,KYK

        CP #22:CALL Z,QUO:JP Z,ECHR
        CP #22:JP Z,OP
        CP ",":JP Z,EOP

        CP ":":JP Z,EOP6
        CP ";":JP Z,EOP6
        CP #0A:JP Z,EOP6
        CP #0D:JP Z,EOP6
        OR A:JP Z,EOP6
        JP OPP
;-------
NXPP    XOR A:LD (BC),A

        LD A,C
        DEC C:JP Z,OP1BA
        DEC C:JP Z,OP2BA
        DEC C:JP Z,OP3BA
        DEC C:JP Z,OP4BA
        LD C,A

        DEC C:LD A,(BC)
        CP ")":JR NZ,EXP
        PUSH BC:LD C,0,A,(BC)
        POP BC:CP "(":JR Z,BRA
        JP EXP

EXP3    DEC C:LD A,(BC)
        CP ")":JR Z,BRA
        LD C,0,A,(BC)
        CP "(":JP Z,EOP4

EXP     LD A,O34,(DE),A:INC E
EXP2    LD C,0:INC B
        LD A,B:CP LBUFM:JR NC,TOKX
        XOR A
        RET

TOKX    LD A,13:SCF:RET
;-------
BRA     DEC C
        LD (DBC),BC,C,0

        LD A,(BC)
        CP "(":JP NZ,EOP4:INC C
        LD A,(BC):AND #DF
        CP "I":JR NZ,AKF:INC C
        LD A,(BC):AND #DF
        CP "X":JR Z,AKK
        CP "Y":JR NZ,AKF
        LD A,OIY:JR Akk
AKK     LD A,OIX
Akk     LD (DA),A:INC C
        LD A,(BC)
        CP "+":JR Z,AKI
        CP "-":JR NZ,AKF
AKI     LD BC,(DBC):DEC C,C

        PUSH BC
        EXX:POP HL
        LD B,0,C,L,L,3,D,H,E,1:LDIR
        XOR A:LD (DE),A
        LD E,A,A,"0",(DE),A
        EXX

        LD A,(DA),(DE),A:INC E
        JP EXP2

AKF     LD BC,(DBC)

        PUSH BC
        EXX:POP HL
        LD B,0,C,L,L,1,D,H,E,B:LDIR
        XOR A:LD (DE),A
        EXX

        LD A,O35,(DE),A:INC E
        JP EXP2
;-------
OP1BA   LD A,(BC):AND #DF
        EXX
        LD HL,O1B
        LD BC,O1BE-O1B
        CPIR:LD A,C
        EXX:JP NZ,EXP

ODCD    LD (DE),A:INC E
        XOR A:LD C,A,(BC),A
        RET
;-------
OP2BA   PUSH HL,DE,BC

        LD A,(BC):AND #DF:LD E,A:INC C
        LD A,(BC):AND #DF:LD D,A

        LD B,O2BL,HL,O2B
O2BCH   LD A,E:CP (HL):INC HL:JP NZ,OMM
        LD A,D:CP (HL):JR Z,O2BF
OMM     INC HL:DJNZ O2BCH

        POP BC,DE,HL
        JP EXP

O2BF    LD A,O2BL:SUB B:ADD A,O2BD

        POP BC,DE,HL
        LD (DE),A:INC E
        XOR A:LD C,A,(BC),A
        RET
;-------
OP3BA   PUSH HL,DE,BC

        LD A,(BC):CP "(":JR Z,MR3A
        AND #DF
MR3A    LD E,A:INC C
        LD A,(BC):AND #DF:LD D,A:INC C
        LD A,(BC):CP ")":JR Z,MR3B
        AND #DF
MR3B    LD C,A

        LD B,O3BL,HL,O3B
O3BCH   LD A,E:CP (HL):INC HL:JR Z,O3m
        INC HL:JP O3M
O3m     LD A,D:CP (HL):INC HL:JR NZ,O3M
        LD A,C:CP (HL):JR Z,O3BF
O3M     INC HL
        DJNZ O3BCH

        POP BC,DE,HL
        LD C,3
        JP EXP3

O3BF    LD A,O3BL:SUB B:ADD A,O3BD

        POP BC,DE,HL
        LD (DE),A:INC E
        XOR A:LD C,A,(BC),A
        RET
;-------
OP4BA   PUSH HL,DE,BC

        LD DE,BC
        LD B,O4BL,HL,O4B
O4BCH   LD A,(DE):CP (HL)
        INC HL:JP NZ,I3
        INC E
        LD A,(DE):AND #DF:CP (HL)
        INC HL:JP NZ,I2
        INC E
        LD A,(DE):AND #DF:CP (HL)
        INC HL:JP NZ,I1
        INC E
        LD A,(DE):CP (HL)
        JP NZ,I1
        JP O4BF
I3      INC HL
I2      INC HL
I1      INC HL
        LD E,0
        DJNZ O4BCH

        POP BC,DE,HL
        LD C,4
        JP EXP3

O4BF    LD A,O4BL:SUB B:ADD A,O4BD
        POP BC,DE,HL

        CP OHL:JR Z,KOC
        CP Oix:JR Z,KOCT
        CP Oiy:JP NZ,ODCD

KOCT    LD (DE),A:INC E
        LD C,0
        LD A,"0":LD (BC),A:INC C
        XOR A:LD (BC),A
        JP EXP2

KOC     LD A,Ohl,(DE),A:INC E
        XOR A:LD C,A,(BC),A
        RET
;---------------------------------------
QUO     LD (BC),A:INC C:RET Z
        LD A,(HL):INC HL
        OR A:RET Z
        CP #0A:RET Z
        CP #0D:RET Z
        CP #22:JR NZ,QU

        LD (BC),A:INC C:RET Z
        LD A,(HL):INC HL
        CP #22:JR Z,Qu:XOR A:RET
Qu      LD (BC),A:INC C:RET

QU      LD (BC),A:INC C:RET Z
Quon    LD A,(HL):INC HL
        LD (BC),A:INC C:RET Z
        OR A:RET Z
        CP #0A:RET Z
        CP #0D:RET Z
        CP #22:JP NZ,Quon

        OR A
        RET
;---------------------------------------
GENL    ;GENERATE LABEL
;i: HL,InText

        LD (DHL),HL
        LD DE,LABUF
        LD A,(DE):OR A:JR Z,GENZ

        CALL LBASPG
        LD B,0,E,LABUF]+1
        JP BLUR

CHEDUP  LD E,LABUF]+1
CHED    ADD HL,BC
BLUR    LD C,(HL):DEC C:JR Z,NODUP
        INC HL
        LD A,(DE):CP (HL):JP NZ,CHED
        DEC C:INC E,HL
BLR     LD A,(DE):CP (HL):JP NZ,CHEDUP
        DEC C:INC E,HL:OR A:JP NZ,BLR

EDUP    LD A,29:SCF:JR GEN

NODUP   LD E,LABUF]
        LD A,(DE)
        ADD A,LAPOS+1:LD C,A,B,0
        LD (DE),A
        EX DE,HL:LDIR
        EX DE,HL
        LD (LBA),HL
        LD (HL),1

GENZ    XOR A
GEN     LD HL,(DHL)
        RET

GENLA   LD A,E:DEC A
        EX DE,HL
        LD (HL),0:INC L
        LD BC,(BUX)
        LD (HL),C:INC L
        LD (HL),B:INC L
        EX DE,HL
        LD E,0,(DE),A
        RET
;-------
GENC    ;GENERATE COMMAND
;       i: HL,Text
;          DE,CommandAddress+Ops
;       (BUX),$

        XOR A:LD (DE),A,E,A,(DA),A

        PUSH HL
        LD A,(DE),(CMDRUN+1),A:INC E
        LD A,(DE),(CMDRUN+2),A:INC E

        CALL CBACPG
        EXX:LD DE,LBUF0,BC,1;Exp,ComLn
        EXX
CMDRUN  CALL 0:JR Z,NOERR:JR C,ERRC
        LD A,20
ERRC    LD (DA),A

NOERR   EXX:LD HL,(BUX):ADD HL,BC:LD (BUX),HL
        EXX

        LD A,H
        CP #C0:JR NC,CMDR
        CP #40:JR C,NOERCMD
        DI:HALT
NOERCMD LD A,(CBAPG):INC A
        LD (CBAPG),A
        SET 7,H
        SET 6,H
CMDR    LD (CBA),HL
        CALL TBACPG
        POP HL

        LD A,(DA):OR A:RET Z:SCF
        RET
;---------------------------------------
DEDEC   PUSH BC
        LD C,E
Idec    LD A,(DE):INC E
        CP #30:JR C,Ilen
        CP #3A:JP C,Idec
Ilen    LD A,E:SUB C
        POP BC:CP 6:JP NC,EDEC
        DEC E

        PUSH BC
        LD BC,DE:DEC C
        PUSH HL,DE
        LD H,0
        DEC A:JR NZ,DEC2
        LD A,(BC):SUB #30:LD L,A
        JP DECXX

DEC2    DEC A:JR NZ,DEC3
        LD A,(BC):SUB #30:LD L,A:DEC C
        LD A,(BC):SUB #30:JP Z,DECXX
        LD B,A:XOR A:ADD A,10:DJNZ $-2
        ADD A,L:LD L,A
        JP DECXX

DEC3    DEC A:JR NZ,DEC4
        LD A,(BC):DEC C:SUB #30:LD L,A
        LD A,(BC):DEC C:SUB #30:JR Z,D31
        LD D,B
        LD B,A:XOR A:ADD A,10:DJNZ $-2
        LD B,D:ADD A,L:LD L,A
D31     LD A,(BC):SUB #30:JP Z,DECXX
        LD B,A,DE,100:ADD HL,DE:DJNZ $-1
        JP DECXX

DEC4    DEC A:JR NZ,DEC5
        LD A,(BC):DEC C:SUB #30:LD L,A
        LD A,(BC):DEC C:SUB #30:JR Z,D41
        LD D,B
        LD B,A:XOR A:ADD A,10:DJNZ $-2
        LD B,D:ADD A,L:LD L,A
D41     LD A,(BC):DEC C:SUB #30:JR Z,D42
        PUSH BC
        LD B,A,DE,100:ADD HL,DE:DJNZ $-1
        POP BC
D42     LD A,(BC):SUB #30:JR Z,DECXX
        LD DE,1000
        LD B,A:ADD HL,DE:DJNZ $-1
        JP DECXX

DEC5    LD A,(BC):DEC C:SUB #30:LD L,A
        LD A,(BC):DEC C:SUB #30:JR Z,D51
        LD D,B
        LD B,A:XOR A:ADD A,10:DJNZ $-2
        LD B,D:ADD A,L:LD L,A
D51     LD A,(BC):DEC C:SUB #30:JR Z,D52
        PUSH BC
        LD B,A,DE,100:ADD HL,DE:DJNZ $-1
        POP BC
D52     LD A,(BC):DEC C:SUB #30:JR Z,D53
        LD DE,1000
        PUSH BC
        LD B,A:ADD HL,DE:DJNZ $-1
        POP BC
D53     LD A,(BC):SUB #30:JR Z,DECXX
        LD DE,10000
        LD B,A:ADD HL,DE:JR C,TEDEC
        DJNZ $-3

DECXX   LD BC,HL:OR A
TEDEC   POP DE,HL
        LD (HL),C2B:INC L
        LD (HL),C:INC L
        LD (HL),B:INC L
        POP BC:JP C,EDEC
        JP DEE
;-------
DEHEX   PUSH BC
        LD C,E:INC C
Ihex    LD A,(DE):INC E
        CP #30:JR C,InoH
        CP #3A:JP C,Ihex
        CP #41:JR C,InoH
        CP #47:JP C,Ihex
InoH    LD A,E:SUB C
        POP BC:JP Z,EDEC
        CP 5:JP NC,EDEC
        DEC E

        PUSH BC
        PUSH HL,DE
        LD H,0,BC,#3007

        DEC E
        DEC A:JR NZ,HEX2
        LD A,(DE)
        SUB B:CP #0A:JR C,$+3:SUB C
        LD L,A
        JP HEXX

HEX2    DEC A:JR NZ,HEX3
        LD A,(DE):DEC E
        SUB B:CP #0A:JR C,$+3:SUB C
        LD L,A
        LD A,(DE)
        SUB B:CP #0A:JR C,$+3:SUB C
        OR A
.4      RLA
        OR L:LD L,A
        JP HEXX

HEX3    DEC A:JR NZ,HEX4
        LD A,(DE):DEC E
        SUB B:CP #0A:JR C,$+3:SUB C
        LD L,A
        LD A,(DE):DEC E
        SUB B:CP #0A:JR C,$+3:SUB C
        OR A
.4      RLA
        OR L:LD L,A
        LD A,(DE)
        SUB B:CP #0A:JR C,$+3:SUB C
        LD H,A
        JP HEXX

HEX4    LD A,(DE):DEC E
        SUB B:CP #0A:JR C,$+3:SUB C
        LD L,A
        LD A,(DE):DEC E
        SUB B:CP #0A:JR C,$+3:SUB C
        OR A
.4      RLA
        OR L:LD L,A
        LD A,(DE):DEC E
        SUB B:CP #0A:JR C,$+3:SUB C
        LD H,A
        LD A,(DE)
        SUB B:CP #0A:JR C,$+3:SUB C
        OR A
.4      RLA
        OR H:LD H,A

HEXX    LD BC,HL
        POP DE,HL

        LD (HL),C2B:INC L
        LD (HL),C:INC L
        LD (HL),B:INC L
        POP BC
        JP DEE
;-------
DEBUX   LD (HL),C2B:INC L
        PUSH BC
        PUSH HL
        EXX:LD A,C:DEC A
        EXX:LD C,A,B,0
        LD HL,(BUX):ADD HL,BC
        LD C,L
        LD B,H
        POP HL
        LD (HL),C:INC L
        LD (HL),B:INC L
        POP BC
        JP DEE
;-------
DEBIN   LD (DBC),BC

        XOR A
        LD B,A,C,A
Ibin    EXA
        LD A,(DE)
        CP "0":JR Z,Ibin0
        CP "1":JR Z,Ibin1
        EXA:OR A:JP Z,EDEC

        LD (HL),C2B:INC HL
        LD (HL),C:INC HL
        LD (HL),B:INC HL
        LD BC,(DBC)
        JP DEE

Ibin1   SCF
Ibin0   RL C,B:INC E
        EXA:INC A:CP 16+1:JP NC,EDEC
        JP Ibin
;-------
DECHR   LD (DBC),BC
        LD A,(DE):INC E:OR A:JR Z,ECHR
        LD B,A
        LD A,(DE):INC E:CP #22:JR Z,CH1B
        OR A:JR Z,ECHR
        LD C,A
        LD A,(DE):INC E:CP #22:JR Z,CH2B
EDEC    LD A,24:OR A:SCF:RET
ECHR    LD A,27:OR A:SCF:RET

CH1B    LD C,B,B,0
CH2B    LD (HL),C2B:INC HL
        LD (HL),C:INC HL
        LD (HL),B:INC HL
        LD BC,(DBC)
        JP DEE
;-------
DECODER ;i: DE',Exp
;           BC',$ delta+1
;         (BUX),$
;
;        o:  BC,Result
;             C - Err
;             Z - Ok
;            NZ - Exp2Queue

        EXX:LD A,D:INC D
        EXX:LD D,A:XOR A:LD E,A

        LD HL,BUF2
        LD (BUF2A),HL
        LD (BUF2I),A
        LD (HL),A

        LD HL,CBUF
        LD BC,CBUF1+1
DEE     LD A,(DE):INC E
        CP #22:JR Z,DECHR;"
        CP "%":JP Z,DEBIN
        CP "$":JP Z,DEBUX
        CP "#":JP Z,DEHEX
        CP #30:JP C,DEA
        CP #3A:JP C,DEDEC
DEA     CP "(":JP Z,BRO
        CP "+":JP Z,PLUS
        CP "-":JP Z,MINUS
        CP "*":JP Z,MUL
        CP "/":JP Z,DIV
        CP "\":JP Z,MOD
        CP "[":JP Z,HI
        CP "]":JP Z,LO
        CP ")":JR Z,BRC
        OR A:JP Z,GOCALC

;Constant Decoding
;    not ok:$#%"(
;        ok:+-*/\[])

        PUSH BC
        LD BC,(BUF2A)
CONST   LD (BC),A:INC C
        LD A,(DE):INC E
        CP "$":JR Z,SERP
        CP "#":JR Z,SERP
        CP "%":JR Z,SERP
        CP #22:JR Z,SERP
        CP "(":JR Z,SERP

        CP "+":JR Z,COT
        CP "-":JR Z,COT
        CP "*":JR Z,COT
        CP "/":JR Z,COT
        CP "\":JR Z,COT
        CP "[":JR Z,COT
        CP "]":JR Z,COT
        CP ")":JR Z,COT
        OR A:JP NZ,CONST
COT     XOR A:LD (BC),A:INC C
        LD (BUF2A),BC:DEC E
        LD A,(BUF2I):INC A
        LD (BUF2I),A

        LD (HL),CLA:INC L
        LD (HL),A:INC L
        LD (HL),0:INC L
        POP BC
        JP DEE

SERP    POP BC:LD A,22:OR A:SCF:RET
SER     LD A,22:OR A:SCF:RET

BRO     LD (BC),A:INC C:JP DEE
BRC     DEC C:LD A,(BC):JR Z,BRE
        CP "(":JR Z,BRG
        LD (HL),A:INC L
        JP BRC
BRG     JP DEE
BRE     LD A,23:OR A:SCF:RET
;-------
Padd    INC C:JP PADD
PLUS    DEC C:JR Z,Padd
        LD A,(BC)
        CP CP1:JR Z,PSWP
        CP CP2:JR Z,PSWP

        CP CP3:JR Z,PFSW
        CP CP4:JR Z,PFSW
        CP CP5:JR Z,PFSW

        CP CP6:JR Z,PFSW
        CP CP7:JR Z,PFSW

        CP "(":JR Z,Padd
        JP SER

PSWP    LD (HL),A:INC L
PADD    LD A,CP1,(BC),A:INC C:JP DEE

PFSW    LD (HL),A:INC L
        DEC C:JR Z,Padd
        LD A,(BC):CP "(":JR Z,Padd
        JP PFSW
;-------
Madd    INC C:JP MADD
MINUS   DEC C:JR Z,Madd
        LD A,(BC)
        CP CP1:JR Z,MSWP
        CP CP2:JR Z,MSWP

        CP CP3:JR Z,MFSW
        CP CP4:JR Z,MFSW
        CP CP5:JR Z,MFSW

        CP CP6:JR Z,MFSW
        CP CP7:JR Z,MFSW

        CP "(":JR Z,Madd
        JP SER

MSWP    LD (HL),A:INC L
MADD    LD A,CP2,(BC),A:INC C:JP DEE
MFSW    LD (HL),A:INC L
        DEC C:JR Z,Madd
        LD A,(BC):CP "(":JR Z,Madd
        JP MFSW
;-------
MULadd  INC C:JP MULADD
MUL     DEC C:JR Z,MULadd
        LD A,(BC)
        CP CP3:JR Z,MULSWP
        CP CP4:JR Z,MULSWP
        CP CP5:JR Z,MULSWP

        CP CP1:JR Z,MULadd
        CP CP2:JR Z,MULadd

        CP CP6:JR Z,MULFSW
        CP CP7:JR Z,MULFSW

        CP "(":JR Z,MULadd
        JP SER

MULSWP  LD (HL),A:INC L
MULADD  LD A,CP3,(BC),A:INC C:JP DEE
MULFSW  LD (HL),A:INC L
        DEC C:JR Z,MULadd
        LD A,(BC);"("
        CP CP3:JR Z,MULFSW
        CP CP4:JR Z,MULFSW
        CP CP5:JR Z,MULFSW
        CP CP6:JR Z,MULFSW
        CP CP7:JR Z,MULFSW
        JP MULadd
;-------
DIVadd  INC C:JP DIVADD
DIV     DEC C:JR Z,DIVadd
        LD A,(BC)
        CP CP3:JR Z,DIVSWP
        CP CP4:JR Z,DIVSWP
        CP CP5:JR Z,DIVSWP

        CP CP1:JR Z,DIVadd
        CP CP2:JR Z,DIVadd

        CP CP6:JR Z,DIVFSW
        CP CP7:JR Z,DIVFSW

        CP "(":JR Z,DIVadd
        JP SER

DIVSWP  LD (HL),A:INC L
DIVADD  LD A,CP4,(BC),A:INC C:JP DEE
DIVFSW  LD (HL),A:INC L
        DEC C:JR Z,DIVadd
        LD A,(BC);"("
        CP CP3:JR Z,DIVFSW
        CP CP4:JR Z,DIVFSW
        CP CP5:JR Z,DIVFSW
        CP CP6:JR Z,DIVFSW
        CP CP7:JR Z,DIVFSW
        JP DIVadd
;-------
MOD     JP DEE
;-------
HIadd   INC C:JP HIADD
HI      DEC C:JR Z,HIadd
        LD A,(BC)
        CP CP3:JR Z,HIadd
        CP CP4:JR Z,HIadd
        CP CP5:JR Z,HIadd

        CP CP1:JR Z,HIadd
        CP CP2:JR Z,HIadd

        CP "(":JR Z,HIadd
        JP SER
HIADD   LD A,CP6,(BC),A:INC C:JP DEE
;-------
LOadd   INC C:JP LOADD
LO      DEC C:JR Z,LOadd
        LD A,(BC)
        CP CP3:JR Z,LOadd
        CP CP4:JR Z,LOadd
        CP CP5:JR Z,LOadd

        CP CP1:JR Z,LOadd
        CP CP2:JR Z,LOadd

        CP "(":JR Z,LOadd
        JP SER
LOADD   LD A,CP7,(BC),A:INC C:JP DEE
;---------------------------------------
OPO     EQU $+1
NOPOLSK LD A,0:OR A:JR NZ,ORGSK

        PUSH HL
        LD HL,(BUF2A)
        LD DE,BUF2
        OR A:SBC HL,DE
        LD BC,HL
        CALL EBACCPG
        EX DE,HL:LDIR
        POP HL
        LD C,L:INC C
        LD L,B:LDIR
        LD (QUEEXPA),DE

NOPO    LD A,#FF:OR A
        RET

ORGSK   PUSH HL
        LD HL,(BUF2A)
        LD DE,BUF2
        OR A:SBC HL,DE
        LD BC,HL
        LD HL,D2BUF
        EX DE,HL:LDIR
        POP HL
        LD C,L:INC C
        LD L,B:LDIR
        LD (DEQ),DE
        JR NOPO
;-------
GOCALC  DEC C:LD A,(BC):JR Z,STP
        LD (HL),A:INC L
        JP GOCALC
STP     LD (HL),0

        LD A,(BUF2):OR A:JR NZ,NOPOLSK

        EXX:PUSH DE,BC
        EXX
        LD L,0:CALL POLSK
        EXX:POP BC,DE
        EXX
        RET
;-------
CPEND   POP BC
;DI:LD SP,(DSP)
        XOR A
        RET

CPHI    EXX
        POP HL:LD L,H,H,0
        PUSH HL
        EXX
        JP POL

CPLO    EXX
        POP HL:LD H,0
        PUSH HL
        EXX
        JP POL

POLSK   DI:LD (DSP),SP

POL     LD A,(HL):INC HL
        CP C2B:JR NZ,LSK
        LD C,(HL):INC HL
        LD B,(HL):INC HL
        PUSH BC
        JP POL

LSK     CP CP1:JR Z,CPPLS
        CP CP2:JR Z,CPMNS
        CP CP3:JR Z,CPMUL
        CP CP4:JR Z,CPDIV
;CP CP5 JR Z CPMOD
        CP CP6:JR Z,CPHI
        CP CP7:JR Z,CPLO
        OR A:JR Z,CPEND

        DI:LD SP,(DSP)
        LD A,25:OR A:SCF
        RET
;-------
CPPLS   EXX
        POP BC
        POP HL
        ADD HL,BC
        PUSH HL:EXX:JP POL

CPMNS   EXX
        POP BC
        POP HL
        OR A:SBC HL,BC
        PUSH HL:EXX:JP POL

CPMUL   EXX
        POP DE
        POP BC
        LD HL,0
        LD A,16
Mul16   ADD HL,HL:RL E,D:JP NC,NoMul16
        ADD HL,BC:JP NC,NoMul16
        INC DE
NoMul16 DEC A:JP NZ,Mul16
        PUSH HL:EXX:JP POL

CPDIV   EXX
        POP BC
        POP HL
        LD A,B
        OR A:JR NZ,DIVBIG
        OR C:JR Z,EDIV

        XOR A
        LD B,16
Div8    ADD HL,HL:RLA
        CP C:JP C,Div8Nxt
        SUB C:INC L
Div8Nxt DJNZ Div8
        PUSH HL:EXX:JP POL

DIVBIG  LD DE,0-1
        OR A
PDIV    SBC HL,BC:INC DE:JR C,Pdiv
        JP PDIV
Pdiv    PUSH DE:EXX:JP POL

EDIV    EXX:LD A,26:OR A:SCF
        RET

CPMOD   EXX
        EXX
        JP POL
;---------------------------------------
DECODX  ;Adding Parameters to EXP tale
;       i: A,Data Type

        PUSH AF:LD A,(QUEEXPP):CALL PG4
        POP AF

        PUSH HL,DE
        LD C,A:AND #F0
        CP #10:JR Z,TYPE1
        CP #20:JR Z,TYPE2
        CP #30:JR Z,TYPE3
        CP #40:JR Z,TYPE4

TYPE1   ;NO Change
        LD DE,(QUEEXPA)
        LD A,C:AND #0F:LD C,A
        LD A,L,(DE),A:INC DE
        LD A,H,(DE),A:INC DE
        LD A,(CBAPG),(DE),A:INC DE
        LD A,C,(DE),A:INC DE
        XOR A:LD (DE),A
        LD (QUEEXPA),DE
        JP DECODZ

TYPE2   ;JR
        LD DE,(QUEEXPA)
        LD A,L,(DE),A:INC DE
        LD A,H,(DE),A:INC DE
        LD A,(CBAPG),(DE),A:INC DE
        LD A,TP3,(DE),A:INC DE
        EXX:LD A,C:INC A
        EXX:LD C,A,B,0
        LD HL,(BUX):ADD HL,BC
        LD A,L,(DE),A:INC DE
        LD A,H,(DE),A:INC DE
        XOR A:LD (DE),A
        LD (QUEEXPA),DE
        JP DECODZ

TYPE3   ;BIT
        LD DE,(QUEEXPA)
        LD A,L,(DE),A:INC DE
        LD A,H,(DE),A:INC DE
        LD A,(CBAPG),(DE),A:INC DE
        LD A,TP4,(DE),A:INC DE
        LD BC,(DA2),A,B:OR C
        LD (DE),A:INC DE
        XOR A:LD (DE),A
        LD (QUEEXPA),DE
        JP DECODZ

TYPE4   ;RST
        LD DE,(QUEEXPA)
        LD A,L,(DE),A:INC DE
        LD A,H,(DE),A:INC DE
        LD A,(CBAPG),(DE),A:INC DE
        LD A,TP5,(DE),A:INC DE
        LD A,%11000111,(DE),A:INC DE
        XOR A:LD (DE),A
        LD (QUEEXPA),DE

DECODZ  POP DE,HL
        RET
;---------------------------------------
MNGC_PL EXA:XOR A:JP WLD
MNG0_PL EXA:LD A,78:JP WLD
MNG8_PL EXA:LD A,79:JP WLD
PRWOW   LD A,1:JP WLD
RRESB   LD A,2:JP WLD
PRSRW   LD A,3:JP WLD
PRIAT   EXA:LD A,4:JP WLD
GADRW   LD A,5:JP WLD
CURSOR  LD A,6:JP WLD
CURSER  LD A,7:JP WLD
YN      EXA:LD A,8:JP WLD
ISTR    EXA:LD A,9:JP WLD

NORK    EXA:LD A,10:JP WLD
TXTPR   LD A,11:JP WLD
DMAPL   EXA:LD A,13:JP WLD
GEDPL   LD A,15:JP WLD
;-------
KBSCN   EXA:LD A,42:JP WLD

SPKE    LD A,16:JP WLD
UPPP    LD A,17:JP WLD
DWWW    LD A,18:JP WLD
LFFF    LD A,19:JP WLD
RGGG    LD A,20:JP WLD
TABK    LD A,21:JP WLD
ENKE    LD A,22:JP WLD
BSPC    LD A,24:JP WLD
DEL     LD A,43:JP WLD
ESC     LD A,23:JP WLD
HOME    LD A,27:JP WLD
END     LD A,28:JP WLD
F1      LD A,29:JP WLD
F5      LD A,33:JP WLD
F10     LD A,38:JP WLD
ALT     LD A,39:JP WLD
SHIFT   LD A,40:JP WLD
CTRL    LD A,41:JP WLD
ANYK    LD A,45:JP WLD
USPO    LD A,46:JP WLD
NUSP    LD A,47:JP WLD
;-------
LOAD512 LD A,48:JP WLD
LOAD256 LD A,60:JP WLD
LOADNON LD A,61:JP WLD

SAVE512 LD A,49:JP WLD
FENTRY  LD A,59:JP WLD
GFILE   LD A,62:JP WLD
MKFILE  LD A,72:JP WLD
DELFL   LD A,75:JP WLD
;-------
MNGV_PL EXA:LD A,64:JP WLD
MNGCVPL EXA:LD A,65:JP WLD
MNG0VPL EXA:LD A,80:JP WLD
GVmod   EXA:LD A,66:JP WLD
GYoff   LD A,67:JP WLD
GXoff   LD A,68:JP WLD
;---------------------------------------
CMD2    DB "LD":DW CLD;1
        DB "JR":DW CJR;2
        DB "JP":DW CJP;3
        DB "EX":DW CEX;4
        DB "OR":DW COR;5
        DB "CP":DW CCP;6

        DB "IN":DW CIN;7

        DB "RL":DW CRL;8
        DB "RR":DW CRR;9

        DB "DB":DW CDB;10
        DB "DW":DW CDW;11
        DB "DS":DW CDS;12

        DB "DI":DW CDI;13
        DB "EI":DW CEI;14
        DB "IM":DW CIM;15
        DB 0

CMD3    DB "INC":DW CINC;1
        DB "DEC":DW CDEC;2
        DB "ADD":DW CADD;3
        DB "ADC":DW CADC;4
        DB "SUB":DW CSUB;5
        DB "SBC":DW CSBC;6

        DB "AND":DW CAND;7
        DB "XOR":DW CXOR;8
        DB "RET":DW CRET;9
        DB "POP":DW CPOP;10
        DB "EXX":DW CEXX;11
        DB "EXA":DW CEXA;12
        DB "EQU":DW CEQU;13

        DB "OUT":DW COUT;14
        DB "OTI":DW COUTI;15
        DB "OTD":DW COUTD;16
        DB "INI":DW CINI;17
        DB "IND":DW CIND;18

        DB "DAA":DW CDAA;19
        DB "CPL":DW CCPL;20
        DB "SCF":DW CSCF;21
        DB "CCF":DW CCCF;22
        DB "INF":DW CINF;23

        DB "LDI":DW CLDI;24
        DB "CPI":DW CCPI;25
        DB "LDD":DW CLDD;26
        DB "CPD":DW CCPD;27

        DB "RLA":DW CRLA;28
        DB "RRA":DW CRRA;29
        DB "RLC":DW CRLC;30
        DB "RRC":DW CRRC;31
        DB "SLA":DW CSLA;32
        DB "SRA":DW CSRA;33
        DB "SLL":DW CSLL;34    SLS
        DB "SRL":DW CSRL;35

        DB "RRD":DW CRRD;36
        DB "RLD":DW CRLD;37

        DB "BIT":DW CBIT;38
        DB "RES":DW CRES;39
        DB "SET":DW CSET;40

        DB "NEG":DW CNEG;41
        DB "NOP":DW CNOP;42

        DB "RST":DW CRST;43
        DB "ORG":DW CORG;44
        DB 0

CMD4    DB "PUSH":DW CPUSH;1
        DB "CALL":DW CCALL;2
        DB "DJNZ":DW CDJNZ;3

        DB "RLCA":DW CRLCA;4
        DB "RRCA":DW CRRCA;5

        DB "LDIR":DW CLDIR;6
        DB "CPIR":DW CCPIR;7
        DB "LDDR":DW CLDDR;8
        DB "CPDR":DW CCPDR;9

        DB "OUTI":DW COUTI;10
        DB "OUTD":DW COUTD;11
        DB "INIR":DW CINIR;12
        DB "OTIR":DW COTIR;13
        DB "INDR":DW CINDR;14
        DB "OTDR":DW COTDR;15

        DB "HALT":DW CHALT;16

        DB "DEFW":DW CDW;  17
        DB "DEFB":DW CDB;  18
        DB "DEFS":DW CDS;  19
        DB "INCL":DW CINCL;20
        DB "INCB":DW CINCB;21
        DB 0

CMD7    DB "INCLUDE":DW CINCL;1
        DB "INCBINE":DW CINCB;2
        DB 0
;---------------------------------------
RMP     DB 1,1,1,1
        DB %00011000;3
        DB 1,1,1,1,1,1
        DB %00001000;1
        DB %00110000;6
        DB %00111000;7
        DB %00000000;0
        DB %00010000;2
        DB %00100000;4
        DB %00101000;5
RMPE
RMPL    EQU RMPE-RMP

O1B     DB "MPZA";13,12,11,10
        DB "aLHEDCBRIf"
O1BE    ;   9876543210

O2B     DB "NZ";       14
        DB "NC";       15
        DB "PO";       16
        DB "PE";       17

        DB "BC";       18
        DB "DE";       19
        DB "HL";       20
        DB "SP";       21
        DB "IX";       22
        DB "IY";       23

        DB "HX";       24
        DB "LX";       25
        DB "HY";       26
        DB "LY";       27
O2BD    EQU 14;+Delta
O2BL    EQU 14

O3B     DB "IXH";      24
        DB "IXL";      25
        DB "IYH";      26
        DB "IYL";      27
        DB "(C)";      28
O3BD    EQU 24;+Delta
O3BL    EQU 5

O4B     DB "(DE)";     29
        DB "(BC)";     30
        DB "(SP)";     31
        DB "(IX)";     32
        DB "(IY)";     33
        DB "(HL)";     34->9
O4BD    EQU 29;+Delta
O4BL    EQU 6

;"(IX+-)";   32
;"(IY+-)";   33
;"NNN";      34
;"(NNN)";    35
;AF/AF'/F;   as EXP
;---------------------------------------
;MAIN Vars
PGDELTA NOP

WCSP    DS 2
DAHL    DS 2
DADE    DS 2

WC0     NOP
WC4     NOP
WC8     NOP
WCC     NOP

;TMP Vars
APG     NOP
DA      NOP
DA2     NOP ;\
DA3     NOP ;/
DA4     NOP
DHL     DS 2
DDE     DS 2
DBC     DS 2
DBC2    DS 2
DSP     DS 2
DEQ     DS 2;ORGSK

;Compilation Vars
ORGFL   NOP ;- 1st ORG Flag
INCLFL  NOP ;- INCLUDE Flag and TBAbckp
INCLDD  DS 3;/
BUX     DS 2;- $
CBA     DS 2;- Pointer in Code Block
CBAPG   NOP ;/
LBA     DS 2;- Cur poz in Label tbl
BUF2A   DS 2;- Const buf
BUF2I   NOP ;- Index
QUEEXPA DS 2;- Expressions
QUEEXPP NOP ;/
QUEEQUA DS 2;- EQUs
ORGOP1  DS 2;Prev $
ORGOP2  DS 2;Prev Code Address
ORGPRX  DS 2;Code Lenght (of Prev ORG) + ORGOP2 (Prev ORG)

;Text Vars
TBA     DS 2;- Pointer in Text Block
TBAPG   NOP ;/

;File Name
EXT     DB "."
        DB "WMF",0
FILE    DB #00;  Flag (0=file)
FILESZ  DW #1,#0;Lenght (4)
FILEX   EQU $-1
FILENM  DS 256;  see FILEGEN
;---------------------------------------
;---------------------------------------

        ORG #0,MAINMDL
;-------
MMODULE ;(MNWNAME),BC
        CALL NAMEGEN:RET NZ;A=0 (do nothing)

        CALL CLEAR_CODESPACE

        LD BC,CYC,A,CACHE:OUT A
        LD IX,INFWND:CALL PRWOW

        DI:LD (WCSP),SP,SP,PLSP
        LD HL,WCPG0,DE,WC0,BC,4:LDIR

        EI:CALL LOADFL
        LD A,1:OUT (254)
        JP STORM
        
;-------
EXIT    LD A,(DA)
        LD HL,CMPFAIL:OR A:JR NZ,$+5:LD HL,CMPDONE
        LD (ENDtxt),HL

        PUSH AF
        LD HL,ERROR_DECODE:OR A:JR Z,ULALA
        LD E,A
LALAU   LD BC,MXEML:XOR A:CPIR:DEC E:JR NZ,LALAU
ULALA   LD (ERRDCD),HL
        POP AF

        LD HL,ERRCOD+1
        LD C,#FF
EEE     SUB 10:INC C:JR NC,EEE
        ADD A,10
        ADD A,#30:LD (HL),A:DEC HL
        LD A,C
        ADD A,#30:LD (HL),A

        CALL GEDPL
        LD IX,INFWND:CALL RRESB
        LD IX,MNWND:CALL PRWOW
        LD HL,ENDTXT,DE,#0101:CALL TXTPR:INC D
        LD A,(DA):OR A:JR Z,POSTER
        CP 29:JR Z,LABELER
        CP 30:JR NZ,ONEPASE
LABELER LD HL,LBUF1,E,1:CALL TXTPR
ONEPASE LD HL,LBUF2,E,1:CALL TXTPR

POSTER  LD HL,SLBA,(DHL),HL
        CALL USPO
EXITMN  EI:HALT
        CALL ENKE:JR NZ,SAVE
        LD A,1:CALL KBSCN:CP "h":CALL Z,LABELS_PRINT
        CALL ANYK:JR NZ,NOSAVE
        JR EXITMN

SAVE    CALL SAVEFL
NOSAVE  CALL RRESB

        LD A,3
        RET
;---------------------------------------
CLEAR_CODESPACE LD A,SCBAP:CALL MNGCVPL
                LD HL,0,(SCBA),HL

                LD BC,(CBASIZE*32-1)*256+255
                LD A,#07:CALL DMAPL
                LD BC,SCBAP*256+SCBAP,DE,HL;=0
                LD A,#00:CALL DMAPL
                LD A,#FA:CALL DMAPL
                RET
;---------------------------------------
LABELS_PRINT LD HL,#0101,(DDE),HL

             LD HL,(DHL)
             LD B,(IX+5):DEC B,B
LPAGE        PUSH BC
             LD A,SLBAP:CALL MNGCVPL
             LD DE,LBUF0
             LD C,(HL):INC HL
.4           DEC C
             LD B,0:LDIR:INC HL
             INC HL:LD A,(HL)
             EX DE,HL
             LD (HL)," ":INC L
             LD (HL),"#":INC L
             PUSH DE:CALL NORK:POP DE
             DEC DE:LD A,(DE):INC DE,DE
             PUSH DE:CALL NORK:POP DE
NOOOPZ       LD A,L:CP 78:JR NC,NOOOPZEND:LD (HL)," ":INC L:JP NOOOPZ
NOOOPZEND    LD (HL),0
             PUSH DE:LD HL,LBUF0,DE,(DDE),E,1:CALL TXTPR:LD (DDE),DE
             POP HL
             POP BC:DJNZ LPAGE
             LD (DHL),HL

             CALL USPO
             RET
;---------------------------------------
LOADFL  LD A,STBAP,(APG),A

LFL     LD A,(APG):CALL MNGCVPL
        LD HL,#C000,B,32:CALL LOAD512
        CP #0F:RET Z

        LD HL,APG:INC (HL)
        LD A,(HL):CP ETBAP:RET NC
        JR LFL
;-------
SAVEFL  LD DE,0
        LD A,(CBAPG):SUB SCBAP:JR Z,ONEPAGE
        CP 4:RET NC
        LD HL,#4000
        EX DE,HL:LD B,A:ADD HL,DE:DJNZ $-1
        EX DE,HL
ONEPAGE LD HL,(CBA)
        RES 7,H
        RES 6,H
        ADD HL,DE
        LD (FILESZ),HL
        LD HL,FILE:CALL MKFILE:JR Z,FILE_CREATION_OK

         CP 3:JR Z,GODELETE
         CP 4:RET NZ
GODELETE LD HL,FILEX
         LD C,(HL),(HL),0
         PUSH HL,BC:CALL DELFL
         POP BC,HL:LD (HL),C:RET Z
         LD HL,FILE:CALL MKFILE:RET NZ

FILE_CREATION_OK
        LD A,SCBAP,(APG),A
        LD HL,(FILESZ)
        LD A,L:OR A:JR Z,$+4:LD L,1
        XOR A:SRL H:ADC A,0:OR L:ADD A,H

NXPGSV  CP 33:JR C,ONEPGSV
        PUSH AF
        CALL SAVEPGS
        LD HL,SCBA,B,32:CALL SAVE512
        POP AF:SUB 32:JR NXPGSV
ONEPGSV PUSH AF:CALL SAVEPGS
        POP AF
        LD HL,SCBA,B,A:CALL SAVE512
        RET
SAVEPGS LD HL,APG,A,(HL):INC (HL):JP MNGCVPL
;-------
NAMEGEN ;i:BC - File name address
        LD HL,BC,DE,FILENM
        LD A,(HL):CP #20:RET C
        LD B,0
NAMAGE  LD A,(HL),(DE),A:INC HL,DE:OR A:JR Z,MAMAGE
        DJNZ NAMAGE
        LD A,B
        INC B
        RET
MAMAGE  DEC DE
.4      DEC DE
        LD HL,EXT,BC,5:LDIR
        XOR A
        RET
;---------------------------------------
;Structures
INFWND  DB 4+128,0
        DB 24,11;     X,Y
        DB 30+2,4+2;  W,H
        DB %0111 1111;PAP INK
        DB 0
        DW #0
        DB 0,0

        DW 0
        DW 0
        DW INFCOMP
INFCOMP DB #D
        DB #E,"Compilation is in progress",#D
        DB #E,"Please Wait...",0

MNWND   DB 5,0;       TYPE,CURcolMSK
        DB 0,0;       X,Y
        DB 0,0;       W,H
        DB %0001 1111;PAP INK
        DB 0;         RESERVED
        DW #0;        BUFFER
        DB 0,0;       LINES

        DB 1,5;         CURnow,CURmax
        DB %1111 0001,0;CURcol

MNWNAME DW 0;          WINtop
        DW PRESS_ENTER;WINbot
        DW 0;          WINtxt

PRESS_ENTER
        DB #9,#E,"press ENTER to SAVE obj",0
;-------
CMPFAIL DB #2,#2,"FAILED:",0
CMPDONE DB #6,#6,"DONE:",0
ENDTXT  DB #FE
ENDtxt  DW 0
        DB #7
ERRCOD  DB "00 - "
        DB #FE
ERRDCD  DW 0
        NOP
;---------------------------------------
ERROR_DECODE
 DB "OK",0;0
 DB 0;1 INCL
 DB 0;2 EndOfText
 DB "Вложенность INCLUDE!",0;3
 DB "Недопустимый символ в поле команды",0;4
 DB "Команда не опознана",0;5
 DB "Недопустимый символ в поле метки",0;6
 DB 0;7
 DB 0;8
 DB 0;9
 DB "Недопустимый символ в поле операнда",0;10
 DB 0;11
 DB "Выражение в поле операнда превысило 256 байт",0;12
 DB "Превышен максимум количества операндов с выражениями",0;13
 DB "Есть '('/')', но нету ')'/'('",0;14
 DB "Число слишком большое",0;15
 DB 0;16
 DB 0;17
 DB "Отсутствует операнд в поле операнда",0;18
 DB "Отсутствует операнд для команды",0;19
 DB "Присутствует операнд у команды не требующей таковой",0;20
 DB "Кодовый блок превысил максимальный объем",0;21
 DB "Ошибка синтаксиса в выражении",0;22
 DB "Нестыковки по скобкам",0;23
 DB "Превышена максимальная разрядность числа (8 либо 16 бит)",0;24
 DB "Ошибка в подсчете",0;25
 DB "Деление на ААА ;P",0;26
 DB "Нестыковка по кавычкам",0;27
 DB 0;28
 DB "Уже есть такая метка",0;29
 DB "Нет метки",0;30
 DB "Много операндов у команды",0;31
 DB "Недопустимый операнд",0;32
 DB 0;33
 DB "Нет метки для EQU",0;34
 DB "Превышена дальность для JR",0;35
 DB "Ошибка в операнде тиража строки",0;36
 DB "Файл не найден",0;37
 DB "Недопустимый размер",0;38
 DB 0
;---------------------------------------
ENDPL
