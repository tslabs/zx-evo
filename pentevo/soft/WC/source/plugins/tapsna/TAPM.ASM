;TAP Mounter & SNA/Z80 Launcher
;(C) KOSHI/MGN 2024
;---------------------------------------
LOBU    EQU #B000
LOB     EQU LOBU-27-4
LOBZ80  EQU LOB-Z80VALS
;-------
        ORG #0
;Main window constants:
PLX     EQU 29
PLX25   EQU 29
PLX36   EQU 34
PLY     EQU 10
PLY25   EQU 8
PLY36   EQU 13
HPX     EQU 17
HPX25   EQU 17
HPX36   EQU 22
HPY     EQU 20
HPY25   EQU 18
HPY36   EQU 23

MD25    EQU 25
MD30    EQU 30
MD36    EQU 36
;-------
BINAR   EQU #200
CODOFF  EQU #8000

WRKORG  EQU CODOFF
WRK2ORG EQU WRKORG+#200
WRK3ORG EQU WRK2ORG+#200
;-------
SPAGE   EQU #C0
EPAGE   EQU #F0

D2PG    EQU #F6
D5PG    EQU #F5
;-------
WLD     EQU #6006;Access point
TMN     EQU #6009;Timer
HEI     EQU #600D;Height
;-------
SYC     EQU #20AF;SysConf
PE0     EQU #21AF;MemConf
Vmod    EQU #00AF
Vpag    EQU #01AF
Vfm     EQU #15AF
;-------
STS     EQU #27AF

DMASL   EQU #1AAF
DMASH   EQU #1BAF
DMASX   EQU #1CAF
DMADL   EQU #1DAF
DMADH   EQU #1EAF
DMADX   EQU #1FAF

DMA_T   EQU #28AF
DMA_N   EQU #26AF
DMA_C   EQU #27AF
;---------------------------------------
;HEADER:
        DS 16
        DB "WildCommanderMDL";    Header
        DB #10;                  Version
        DB 0;                       Type
        DB 4; Pages
        DB 0; Page to #8000
;-------
        DB 0,MAINPGL-1; CODE
        DB 1,32;       TRDOS
        DB 2,32;      Basic128
        DB 3,32;     Basic48

.2      DB 0,0
;-------
        DS 16
;-------
        DB "TAP"
        DB "SNA"
        DB "Z80"
        DS 29*3
;-------
        DB 0
;-------
        DW #0000,#000C; MAX SIZE
;-------
        DB "TAP Mounter & SNA Launcher v0.67"
;-------
        DB 0; +197
;-------
        DS 6; +198
        DS 24;+204
        DS 32;+228
;-------
PAR1    DB PAR2-PAR1;Structure size
        DB 1;Default option
        DB "loading"
        DB 3;Options count
        DB "slow",0
        DB "fast",0
        DB "real",0
PAR2    DB PAR3-PAR2
        DB 1;Default option
        DB "memory"
        DB 4;Options count
        DB "512",0
        DB "128",0
        DB "auto",0
        DB "1024",0
PAR3    DB PAR4-PAR3
        DB 1;Default option
        DB "cpu"
        DB 3;Options count
        DB "3,5",0
        DB "7",0
        DB "14",0
PAR4    DB PAR4END-PAR4
        DB 1;Default option
        DB "basic"
        DB 2;Options count
        DB "128",0
        DB "48",0
PAR4END NOP;END TOKEN
;---------------------------------------
        ORG #8000,BINAR
;---------------------------------------
PLUGIN  LD (DAHL),HL,(DADE),DE
        EXA
        PUSH AF:CALL GEDPL
        POP AF:OR A:JR Z,TAPS
               DEC A:JP Z,SNAS
               DEC A:JP Z,Z80S

TAPS    LD HL,MODE25,DE,4
        LD A,(HEI)
        CP MD25:JR Z,MDGO:ADD HL,DE
        CP MD30:JR Z,MDGO:ADD HL,DE
MDGO    LD A,(HL):INC HL:LD (PLWND+2),A
        LD A,(HL):INC HL:LD (PLWND+3),A
        LD A,(HL):INC HL:LD (HPWND+2),A
        LD A,(HL),(HPWND+3),A

        LD IX,HPWND:CALL PRWOW
        LD IX,PLWND:CALL PRWOW

        CALL TAPCONFIG
        LD A,1:CALL YN
;-------
MAIN    EI:HALT:XOR A:CALL YN,CURSOR
        LD DE,CONFIG:CALL PRCONF

        CALL ESC:JR NZ,Exit
        CALL UPPP,NZ,UPC
        CALL DWWW,NZ,DNC
        CALL SPKE,NZ,CHCO
        CALL ENKE:JR Z,MAIN

        LD IX,HPWND:CALL RRESB
        LD IX,PLWND:CALL RRESB
        LD A,#FF:CALL YN:JP NZ,EXIT
;-------
LGO     LD A,SPAGE,(PAGG),A
DADU    LD HL,PAGG,A,(HL):INC (HL)
        CP EPAGE:JP NC,EXIT:CALL MNGC
        LD HL,#C000,B,32:CALL LOAD512
        CP #0F:JR NZ,DADU
        JP TAPM
;-------
Exit    LD IX,HPWND:CALL RRESB
        LD IX,PLWND:CALL RRESB
        JP EXIT
;-------
TAPCONFIG LD A,1:CALL PRM_PL:RET Z:DEC A:CP 3:RET NC:LD (CONFIG),A
          LD A,2:CALL PRM_PL:RET Z:DEC A:CP 4:RET NC:LD (C3),A
          LD A,3:CALL PRM_PL:RET Z:DEC A:CP 3:RET NC:LD (C1),A
          LD A,4:CALL PRM_PL:RET Z:DEC A:CP 2:RET NC:LD (C4),A
          RET
;-------
PRCONF  XOR A:LD (YYY),A
PRCON   CALL GENBUF:RET Z
        PUSH DE:LD D,A,E,1:CALL PRSRW
        POP DE
        JR PRCON

GENBUF  LD A,(DE):INC A:RET Z:DEC A

        EX DE,HL
        INC HL
        LD E,(HL):INC HL
        LD D,(HL):INC HL
        PUSH AF,DE
        LD DE,TXTBUF:CALL LDIRT:INC HL
        POP BC,AF

        PUSH HL:LD HL,BC
        INC HL:LD C,(HL):INC HL
        LD B,A:INC B
        XOR A:SUB C:ADD A,C:DJNZ $-1
        PUSH BC:LD C,A:ADD HL,BC
        POP BC
        LDIR
        LD A,32
        LD B,6,(DE),A:INC DE:DJNZ $-2

        POP HL
        EX DE,HL

        LD HL,YYY:INC (HL):LD A,(HL)
        LD HL,TXTBUF,BC,20
        OR A
        RET
LDIRT   LD A,(HL):OR A:RET Z
        LD (DE),A:INC HL,DE
        JR LDIRT
;-------
CHCO    LD HL,CONFIG
        LD A,(IX+12):DEC A:JR Z,LA
        LD E,A
COCO    LD A,(HL):CP #FF:RET Z
        INC HL,HL,HL
        XOR A:LD BC,32:CPIR:RET NZ
        DEC E:JR NZ,COCO

LA      CALL CHPRM
        RET
CHPRM   PUSH HL:INC HL
        LD E,(HL):INC HL
        LD D,(HL)
        LD A,(DE),C,A
        POP HL
        INC (HL):LD A,(HL):CP C:RET C
        LD (HL),0
        RET
;-------
UPC     LD A,(IX+12):CP 1:RET Z
        CALL CURSER
        DEC (IX+12)
        JP CURSOR
DNC     LD A,(IX+12):CP (IX+13):RET NC
        CALL CURSER
        INC (IX+12)
        JP CURSOR
;-------
EXIT    CALL GEDPL
        LD A,0
        RET
;-------
PAGG    NOP
;---------------------------------------
TAPM    DI
        LD HL,RESIDE,DE,RESID,BC,RESIDL
        LDIR

        LD A,TFPG:CALL MNGC;         SYS

        LD HL,WRK+CODOFF-#0200
        LD DE,#C000
        LD BC,#200+#200+WRKB3L
        LDIR

        LD A,TRPG:CALL MNG0;      TR-DOS
        LD A,1:CALL MNGC_PL
        LD HL,#C000
        LD DE,#0000
        LD BC,#4000
        LDIR

        LD A,BCPG:CALL MNG0;    Basic128
        LD A,2:CALL MNGC_PL
        LD HL,#C000
        LD DE,#0000
        LD BC,#4000
        LDIR

        LD A,BAPG:CALL MNG0;     Basic48
        LD A,3:CALL MNGC_PL
        LD HL,#C000
        LD DE,#0000
        LD BC,#4000
        LDIR

        LD DE,#3CC0
        LD A,(CONFIG)
        OR A:JR Z,TRAP1;bit load fast
        DEC A:JR Z,TRAP2;block load ULTRA fast
;bit load realtime with sound
        LD HL,#2F79,(#5F6),HL
        LD HL,#E64F,(#5F8),HL
        LD HL,#CB07,(#5FA),HL
        LD HL,#2847,(#5FC),HL
        LD HL,#F602,(#5FE),HL
        LD A,16,(#600),A
TRAP3   LD HL,#5E9
        LD (HL),#C3:INC HL
        LD (HL),E:INC HL
        LD (HL),D
        LD HL,STB3+CODOFF-#200
        LD BC,STB3L:JR TRPZ
TRAP2   LD HL,#569
        LD (HL),#C3:INC HL
        LD (HL),E:INC HL
        LD (HL),D
        LD HL,STB2+CODOFF-#200
        LD BC,STB2L:JR TRPZ
TRAP1   LD HL,#5E9
        LD (HL),#C3:INC HL
        LD (HL),E:INC HL
        LD (HL),D
        LD HL,STB+CODOFF-#200
        LD BC,STBL
TRPZ    LDIR

        XOR A:CALL MNGC
        LD BC,PW0,A,#F8:OUT A
        LD A,(C3),C,#08:AND 3
.6      SLA A
        OR C:LD BC,PE0:OUT A

        LD BC,#EFF7:XOR A:OUT A
        LD A,(C2):AND 1:SLA A,A:LD C,A
        LD A,(C1):AND 3:OR C
        LD BC,SYC:OUT A

        LD A,63,I,A:IM 1
        LD IY,#5C3A

        LD HL,#5800,DE,HL:INC DE
        LD BC,#0800-1,(HL),L:LDIR

        LD BC,Vmod:XOR A:OUT A
        LD A,(C4):AND 1
.4      SLA A
        LD BC,#7FFD:OUT A
        JP RESID
;-------
RESIDE  LD BC,PW2,A,2:OUT A
        LD BC,PW3:XOR A:OUT A
        LD HL,#2758:EXX
        JP 0
RESIDL  EQU $-RESIDE
;---------------------------------------
SNA_I   EQU LOB
SNAaHL  EQU LOB+1
SNAaDE  EQU LOB+3
SNAaBC  EQU LOB+5
SNAaAF  EQU LOB+7
SNA_HL  EQU LOB+9
SNA_DE  EQU LOB+11
SNA_BC  EQU LOB+13
SNA_IY  EQU LOB+15
SNA_IX  EQU LOB+17
SNA_EI  EQU LOB+19

SNA_R   EQU LOB+20
SNA_AF  EQU LOB+21
SNA_SP  EQU LOB+23
SNA_IM  EQU LOB+25
SNA_BR  EQU LOB+26
SNA_PC  EQU LOB+27
SNA_7F  EQU LOB+29
SNA_TR  EQU LOB+30
;-------
SNA128  LD HL,(DAHL)
        LD A,L:CP #1F:JP NZ,EXIT
        LD A,H
        CP #00:JP Z,SNA7F
        CP #40:JP Z,SNA7F
        JP EXIT
;-------
SNAS    LD HL,(DADE)
        LD A,H:OR A:JP NZ,EXIT
        LD A,L:CP 2:JR Z,SNA128
        OR A:JP NZ,EXIT
        LD HL,(DAHL)
        LD DE,#C01B
        OR A:SBC HL,DE:JP NZ,EXIT

        DI
        LD BC,Vmod,A,%00100000:OUT A
        CALL LDSNA
SNAPSHO CALL VROM

        LD SP,#C000:CALL DMAZ
SNAGO   DI
        LD HL,(SNA_SP),(SNASP+1),HL
        LD HL,(SNA_BC),(SNABC+1),HL
        LD HL,(SNA_HL),(SNAHL+1),HL

        XOR A:LD (SNAEI),A
        LD A,(SNA_EI)
        BIT 2,A:JR Z,NOEI
        LD A,#FB,(SNAEI),A

NOEI    LD HL,PATCH
        LD DE,#3CC0
        LD BC,EPATCH-PATCH:LDIR

        LD A,(SNA_BR):OUT (254)
        LD BC,PW0,A,#F8:OUT A
        LD BC,PE0,A,#08:OUT A
        LD BC,#EFF7:XOR A:OUT A
        LD BC,SYC,A,#00:OUT A
        LD BC,Vmod:XOR A:OUT A
        LD BC,PW3:XOR A:OUT A
        LD BC,#7FFD
SNAXX   LD A,16:OUT A

        LD A,(SNA_IM):AND 3
        OR A:JR Z,IM0
        DEC A:JR Z,IM1
IM2     IM 2:JR IMZ
IM1     IM 1:JR IMZ
IM0     IM 0
IMZ     LD A,(SNA_I),I,A
        LD HL,(SNAaAF)
        PUSH HL
        POP AF
        LD HL,(SNAaHL)
        LD DE,(SNAaDE)
        LD BC,(SNAaBC)
        EXA:EXX
        LD HL,(SNA_AF)
        PUSH HL
        POP AF
        LD DE,(SNA_DE)
        LD IX,(SNA_IX)
        LD IY,(SNA_IY)
        JP #3CC0
;-------
SNA7F   DI
        LD BC,Vmod,A,%00100000:OUT A
        CALL LDSNA2
SNAPSHOT
        CALL VROM
        LD SP,#C000:CALL DMAZ

        LD A,(SNA_7F)
        BIT 4,A:JR Z,B128SNA

B48SNA  LD (SNAXX+1),A
        LD A,#C3,(SNAPC-1),A
        LD HL,(SNA_PC),(SNAPC),HL
        JP SNAGO

B128SNA PUSH AF:LD BC,PW0,A,BCPG:OUT A
        POP AF
        JR B48SNA
;-------
VROM    LD A,TRPG:CALL MNG0;      TR-DOS
        LD A,1:CALL MNGC_PL
        LD HL,#C000
        LD DE,#0000
        LD BC,#4000
        LDIR

        LD A,BCPG:CALL MNG0;    Basic128
        LD A,2:CALL MNGC_PL
        LD HL,#C000
        LD DE,#0000
        LD BC,#4000
        LDIR

        LD A,BAPG:CALL MNG0;     Basic48
        LD A,3:CALL MNGC_PL
        LD HL,#C000
        LD DE,#0000
        LD BC,#4000
        LDIR
        RET
;-------
DMAPG   CP 5:JR NZ,$+4:LD A,D5PG
        LD E,0,D,A:JR DMAz
DMAZ    LD DE,5*256+D5PG
DMAz    LD HL,0
        LD BC,DMASL:OUT L
        LD B,DMASH[:OUT H
        LD B,DMASX[:OUT E
        LD B,DMADL[:OUT L
        LD B,DMADH[:OUT H
        LD B,DMADX[:OUT D
        LD B,DMA_T[,A,#1F:OUT A
        LD B,DMA_N[,A,#FF:OUT A
        LD B,DMA_C[,A,%00000001:OUT A

        LD B,STS[:INF:JP M,$-2
        RET
;-------
LDSNA2  CALL LDSNA

        LD HL,LOBU+27,DE,LOB+27,BC,4
        LDIR

        LD A,(SNA_7F):AND %00000111
        PUSH AF:OR A:CALL NZ,DMAPG
        POP DE
        XOR A

LD128   CP 2:JR Z,SKP
        CP 5:JR Z,SKP
        CP D:JR Z,SKP:CALL MNGC,SNAPG2
SKP     INC A:CP 8:RET Z
        JR LD128

LDSNA   LD HL,LOBU,B,2:CALL LOAD512
        LD HL,LOBU,DE,LOB,BC,27:LDIR

        LD A,D5PG:CALL MNGC,SNAPG
        LD A,2:CALL MNGC,SNAPG
        LD A,0:CALL MNGC,SNAPG
        RET
;-------
SNAPG   LD DE,#C000
        LD A,32
BIKO    LD HL,LOBU+27,BC,512:LDIR
        PUSH DE
        LD DE,LOBU+27,BC,512-27:LDIR

        PUSH AF
        LD HL,LOBU+512,B,1:CALL LOAD512
        POP AF
        POP DE
        DEC A:JR NZ,BIKO
        RET
;-------
SNAPG2  PUSH DE
        LD DE,#C000
        LD B,32
BIKO2   PUSH BC
        LD HL,LOBU+27+4,BC,512:LDIR
        PUSH DE
        LD DE,LOBU+27+4,BC,512-27-4:LDIR

        PUSH AF
        LD HL,LOBU+512,B,1:CALL LOAD512
        POP AF
        POP DE
        POP BC:DJNZ BIKO2
        POP DE
        RET
;-------
PATCH   LD BC,PW1,L,5:OUT L
        LD BC,PW2,L,2:OUT L
SNAHL   LD HL,0
SNABC   LD BC,0
SNASP   LD SP,0
SNAEI   NOP
        RET
SNAPC   DS 2
EPATCH
;---------------------------------------
Z80_AF  EQU LOBZ80+0;needed revers
Z80_BC  EQU LOBZ80+2
Z80_HL  EQU LOBZ80+4
Z80_PC  EQU LOBZ80+6
Z80_SP  EQU LOBZ80+8
Z80_I   EQU LOBZ80+10
Z80_R   EQU LOBZ80+11
Z80_BR  EQU LOBZ80+12;0+BORDERR(1-3)+PCKDflg(5)
Z80_DE  EQU LOBZ80+13
Z80aBC  EQU LOBZ80+15
Z80aDE  EQU LOBZ80+17
Z80aHL  EQU LOBZ80+19
Z80aAF  EQU LOBZ80+21;needed revers
Z80_IY  EQU LOBZ80+23
Z80_IX  EQU LOBZ80+25
Z80_EI  EQU LOBZ80+27;0-DI, 1-EI
Z80_IF  EQU LOBZ80+28;IFF2
Z80_IM  EQU LOBZ80+29;IM0/1/2

Z80_LN  EQU LOBZ80+30;additional header lenght(2)
Z802PC  EQU LOBZ80+32;PC
Z80_7F  EQU LOBZ80+35;7FFD
;-------
Z80SEC  EQU 4
Z80VALS EQU 86
;-------
HALTEJ   LD A,6:OUT (254):DI:HALT

Z80v23  ;v2/v3
         CALL Z80INIT;Blank Screen, DI
         LD HL,LOBU+32,BC,(Z80_LN):ADD HL,BC

Z80NEWP2 LD C,(HL):INC HL
         LD B,(HL):INC HL;#FFFF-Unpacked
         LD A,C:OR B:JR Z,Z80END2
         LD A,B:CP #41:JR NC,Z80END2
         LD A,(HL):INC HL:SUB 3:CP 8:JR NC,Z80END2
         OUT (254):CP 5:JR NZ,$+4:LD A,D5PG:CALL MNGC
         LD DE,#C000
         LD A,B:INC A:JR NZ,PACKEDPG
         LD A,C:INC A:JR NZ,PACKEDPG
 LD A,6:OUT (254):DI:HALT
         LD BC,#4000:CALL Z80LDIR2
         JR Z80NEWP2
PACKEDPG CALL Z80DEPACKER2
         JR Z80NEWP2
Z80END2  JP Z80GO2
;-------
;.Z80 Snapshot Launcher
Z80S    ;LD HL,(DADE),A,H:OR L:JP NZ,EXIT

        LD A,D5PG,(Z80PG+1),A:CALL MNGC
        LD HL,LOBU,B,Z80SEC+1:CALL LOAD512
        LD HL,LOBU,DE,LOBZ80,BC,Z80VALS:LDIR
        LD HL,(Z80_PC),A,H:OR L:JP Z,Z80v23;not v1.X
        LD A,(Z80_BR):AND #20:JP Z,EXIT;Z80UNPACKED unsupported

        CALL Z80INIT;Blank Screen, DI
        LD HL,LOBU+30
Z80NEWP LD DE,#C000
JIR     CALL Z80DEPACKER
        LD A,B:OR A:JR Z,Z80GO
        CALL Z80PGX:JR NZ,Z80GO
        DEC B:JR Z,Z80NEWP
        PUSH HL:LD BC,DE,HL,0,DE,#C000:LDIR
        POP HL
        JR JIR

Z80GO2  LD D,1
        LD A,(Z80_7F),(SNA_7F),A
        LD HL,(Z802PC),(Z80_PC),HL
        JR $+4
Z80GO   LD D,0
        LD HL,(Z80_BC),(SNA_BC),HL
        LD HL,(Z80_HL),(SNA_HL),HL
        LD HL,(Z80_PC),(SNA_PC),HL
        LD HL,(Z80_SP),(SNA_SP),HL
        LD HL,(Z80_DE),(SNA_DE),HL
        LD HL,(Z80_IY),(SNA_IY),HL
        LD HL,(Z80_IX),(SNA_IX),HL
        LD HL,(Z80aBC),(SNAaBC),HL
        LD HL,(Z80aDE),(SNAaDE),HL
        LD HL,(Z80aHL),(SNAaHL),HL
        LD HL,(Z80_AF),B,L,C,H,(SNA_AF),BC
        LD HL,(Z80aAF),B,L,C,H,(SNAaAF),BC
        LD A,(Z80_I),(SNA_I),A
        LD A,(Z80_R),(SNA_R),A
        LD A,(Z80_EI):RLCA:RLCA:LD (SNA_EI),A
        LD A,(Z80_IM):AND %11:LD (SNA_IM),A
        LD A,(Z80_BR):AND %110:SRL A:LD (SNA_BR),A
        LD A,D:OR A:JP Z,SNAPSHO
        JP SNAPSHOT
;-------
Z80PGX  PUSH HL,DE,BC
Z80PG   LD A,0
        LD C,2:CP D5PG:JR Z,Z80PGN
        LD C,0:CP 2:JR NZ,Z80PGED
Z80PGN  LD A,C,(Z80PG+1),A:CALL MNGC
        XOR A
Z80PGED POP BC,DE,HL
        RET
;-------
Z80DEPACKER ;i:HL - Source Data
;              DE - Destination
;            o: B - #00 - End Of Data
;                   #01 - Buffer END
;                   #FF - Buffer Overflow
;              HL - Address in Source
;              DE - Address in Dest

DEPACKB     LD BC,#1ED
DEPACK      LD A,D:OR E:RET Z
            LD A,(HL):INC HL:CP C:JR Z,EDCHECK
            LD (DE),A:INC DE
            LD A,H:CP LOBU[+Z80SEC*2:JP C,DEPACK

            LD BC,0-(Z80SEC*512):ADD HL,BC
            PUSH HL,DE
            LD HL,LOBU+Z80SEC*512,DE,LOBU,BC,512:LDIR
            LD HL,LOBU+512,B,Z80SEC:CALL LOAD512
            POP DE,HL
            JP DEPACKB

EDCHECK     CP (HL):JR Z,DPCK
            LD (DE),A:INC DE
            JP DEPACK
            
DPCK        INC HL
            LD B,(HL):INC HL:LD A,B:OR A:RET Z;END Token
            LD A,(HL):INC HL
DPCKFILL    LD (DE),A:INC DE:DJNZ DPCKFILL
            INC B:LD A,D:OR E:RET Z
            LD A,D:CP #C0:JP NC,DEPACKB
            DEC B,B
            RET
;-----------
Z80DEPACKER2;i:HL - Source Data
;              DE - Destination
;              BC - Source Lenght (ignored)
;            o: Z - Buffer END
;              NZ - Buffer Overflow (imposibru)
;              HL - Address in Source

DEPACKB2    LD A,D:OR E:RET Z
            LD A,(HL):INC HL:CP #ED:JR Z,EDCHECK2
DEPA2       LD (DE),A:INC DE
            LD A,H:CP LOBU[+Z80SEC*2:JP C,DEPACKB2

            LD BC,0-Z80SEC*512:ADD HL,BC
            PUSH HL,DE
            LD HL,LOBU+Z80SEC*512,DE,LOBU,BC,512:LDIR
            LD HL,LOBU+512,B,Z80SEC:CALL LOAD512
            POP DE,HL
            JP DEPACKB2

EDCHECK2    CP (HL):JR NZ,DEPA2
            INC HL
            LD B,(HL):INC HL
            LD A,(HL):INC HL
DPCKFILL2   LD (DE),A:INC DE:DJNZ DPCKFILL2
            LD A,D:OR E:RET Z
            LD A,D:CP #C0:JP NC,DEPACKB2
            RET
;-----------
Z80LDIR2    LD A,D:OR E:RET Z
            LD A,(HL):INC HL
            LD (DE),A:INC DE
            LD A,H:CP LOBU[+Z80SEC*2:JP C,Z80LDIR2

            LD BC,0-Z80SEC*512:ADD HL,BC
            PUSH HL,DE
            LD HL,LOBU+Z80SEC*512,DE,LOBU,BC,512:LDIR
            LD HL,LOBU+512,B,Z80SEC:CALL LOAD512
            POP DE,HL
            JP Z80LDIR2
;-----------
Z80INIT     LD A,16:CALL MNG0VPL
            DI
            LD BC,Vmod,A,%00100000:OUT A
            RET

;---------------------------------------
PW0     EQU #10AF
PW1     EQU #11AF
PW2     EQU #12AF
PW3     EQU #13AF
;-------
BI0     EQU #C8
BI1     EQU #D8
BISY1   EQU #D0
BISY2   EQU #D0
BIPIL   EQU #E0
PILLEN  EQU #300
PILLENR EQU #C97
;-------
TFPG    EQU #F8;SYS      [vROM]
TRPG    EQU #F9;TR-DOS   [vROM]
BCPG    EQU #FA;BASIC128 [vROM]
BAPG    EQU #FB;BASIC48  [vROM]
;-------
RESID   EQU #4000
;---------------------------------------
MNG0    LD BC,PW0,(#6000),A:OUT A:RET
MNGC    LD BC,PW3,(#6003),A:OUT A:RET
;---------------------------------------
PRM_PL  EXA:LD A,83:JP WLD

MNGC_PL EXA:LD A,0:JP WLD
PRWOW   LD A,1:JP WLD
RRESB   LD A,2:JP WLD
PRSRW   LD A,3:JP WLD
PRIAT   EXA:LD A,4:JP WLD
GADRW   LD A,5:JP WLD
CURSOR  LD A,6:JP WLD
CURSER  LD A,7:JP WLD
YN      EXA:LD A,8:JP WLD
ISTR    EXA:LD A,9:JP WLD

NORK    EXA:LD A,10:JP WLD
TXTPR   LD A,11:JP WLD
DMAPL   EXA:LD A,13:JP WLD
GEDPL   LD A,15:JP WLD
;-------
SPKE    LD A,16:JP WLD
UPPP    LD A,17:JP WLD
DWWW    LD A,18:JP WLD
LFFF    LD A,19:JP WLD
RGGG    LD A,20:JP WLD
TABK    LD A,21:JP WLD
ENKE    LD A,22:JP WLD
ESC     LD A,23:JP WLD
F1      LD A,29:JP WLD
F5      LD A,33:JP WLD
F10     LD A,38:JP WLD
ALT     LD A,39:JP WLD
SHIFT   LD A,40:JP WLD
CTRL    LD A,41:JP WLD
USPO    LD A,46:JP WLD
NUSP    LD A,47:JP WLD
;-------
LOAD512 LD A,48:JP WLD
LOAD256 LD A,60:JP WLD
LOADNON LD A,61:JP WLD

SAVE512 LD A,49:JP WLD
TENTRY  LD DE,ENTRY,A,51:JP WLD
MKFILE  LD A,58:JP WLD
;-------
MNGV_PL EXA:LD A,64:JP WLD
MNGCVPL EXA:LD A,65:JP WLD
MNG0VPL EXA:LD A,80:JP WLD
GVmod   EXA:LD A,66:JP WLD
GYoff   LD A,67:JP WLD
GXoff   LD A,68:JP WLD
;---------------------------------------
MODE25  DB PLX25,PLY25,HPX25,HPY25
MODE30  DB PLX,PLY,HPX,HPY
MODE36  DB PLX36,PLY36,HPX36,HPY36
;-------
PLWND   DB 5+16+128,0
        DB 29,10;    X,Y
        DB 20+2,7+2; W,H
        DB %01111111;PAPER+INK
        DB 0
        DW #0000;    BUFFER
        DB 2,0;      LINES

        DB 1,5;        CURnow,CURmax
        DB %11110001,0;CURcolor

        DW TAPL
        DW 0
        DW 0
;-------
;MSWND   DB 4+128,0
;        DB 255,255;  X,Y
;        DB 32+2,4+2; W,H
;        DB %00101111;PAPER+INK
;        DB 0
;        DW #0000;    BUFFER
;        DB 0,0;      LINES
;        DW 0
;        DW 0
;        DW MESS
;MESS    DB "123455678890",0
;-------
HPWND   DB 4+128,0
        DB 17,20;    X,Y
        DB 44+2,1+2; W,H
        DB %01001111;PAPER+INK
        DB 0
        DW #0000;    BUFFER
        DB 0,0;      LINES
        DW 0
        DW 0
        DW HELP
;-------
TAPL    DB #9,#E,"TAP Mounter:",0
HELP    DB #E,"SPACE - Change option, "
        DB "ENTER - Start/Cancel.",0
;-------
CONFIG  DB 1:DW TALG:DB "  Loading: ",0
C1      DB 0:DW FRQX:DB " CPU Freq: ",0
C2      DB 0:DW ONOF:DB "    Cache: ",0
C3      DB 1:DW MELX:DB "   Memory: ",0
C4      DB 0:DW BASX:DB "      ROM: ",0
        DB #FF
;-------
TALG    DB 3,4
        DB "SLOW"
        DB "FAST"
        DB "REAL"
FRQX    DB 3,6
        DB "3.5MHz"
        DB "7MHz  "
        DB "14MHz "
ONOF    DB 2,3
        DB "OFF"
        DB "ON "
MELX    DB 4,5
        DB "512K "
        DB "128K "
        DB "Auto "
        DB "1024K"
BASX    DB 2,8
        DB "Basic128"
        DB "Basic48 "
;---------------------------------------
TXTBUF  DS 32
ENTRY   DS 32
;-------
SPBU    DS 2

YYY     NOP

DAHL    DS 2
DADE    DS 2
;-------
YADU    EQU $-PLUGIN
;---------------------------------------
;---------------------------------------
STB     EQU BINAR+YADU
        ORG #3CC0,STB
StB     PUSH HL,BC
        LD BC,PW2,L,TFPG:OUT L
        JP WRKORG

EXWR    LD BC,PW2,L,2:OUT L
        POP BC,HL
        LD B,A
        JP #5FA
STBL    EQU $-StB
;---------------------------------------
STB3    EQU STB+STBL
        ORG #3CC0,STB3
StB3    PUSH HL,BC
        LD BC,PW2,L,TFPG:OUT L
        JP WRK2ORG

EXWRR   LD BC,PW2,L,2:OUT L
        POP BC,HL
        LD B,A
        JP #5F6
STB3L   EQU $-StB3
;---------------------------------------
STB2    EQU STB3+STB3L
        ORG #3CC0,STB2
StB2    LD BC,PW2,L,TFPG:OUT L
        JP WRK3ORG

EXWR2   LD BC,PW2,L,2:OUT L
        XOR A:OUT (254)
        JP #5DF
STB2L   EQU $-StB2
;---------------------------------------
;---------------------------------------
WRK     EQU STB2+STB2L
        ORG WRKORG,WRK
TLOBU   EQU #9000
;-------
        LD BC,PW3:IN A:LD (OPW3),A
;-------
        LD A,(STAT)
        OR A:JR Z,LBIT
        DEC A:JP Z,PILOT1
        DEC A:JP Z,PILOT2
        DEC A:JP Z,SYN1
        DEC A:JP Z,SYN2

;NEW BLOCK
        LD HL,(TADR)
        LD A,L
        OR H:LD A,(BNK):JR NZ,LNWBN1
        LD H,#C0
        INC A:LD (BNK),A

LNWBN1  LD BC,PW3:OUT A
        LD A,(HL),(LLOW),A:INC HL
        LD A,L:OR H:LD A,(BNK):JR NZ,LNWBN2

        LD H,#C0:INC A:LD (BNK),A
LNWBN2  OUT A:LD A,(HL):INC HL:LD (TADR),HL
LLOW    EQU $+1:LD L,0,H,A,(LLLEN),HL

        XOR A:LD (STAT),A
        LD A,#55,(LBIT+1),A
LBIT    LD A,#55:RLCA:LD (LBIT+1),A
        LD B,BI0:JP NC,EXWRK
        LD A,(BYS):ADD A,A:LD (BYS),A,A,(TBY):JR NZ,YBY

        LD HL,(LLLEN)
        LD A,L:OR H:JP Z,NXWRK;PILOT1
        DEC HL:LD (LLLEN),HL

        LD HL,(TADR)
        LD A,L:OR H:LD A,(BNK):JR NZ,NWBN
        LD H,#C0:INC A:LD (BNK),A

NWBN    LD BC,PW3:OUT A
        LD A,(HL):INC HL:LD (TADR),HL
        LD L,#00:OUT L
        LD HL,BYS:LD (HL),#FF;7 BIT
YBY     ADD A,A:LD (TBY),A
        LD B,BI0:JP NC,EXWRK
        LD B,BI1
        JP EXWRK

BNK     DB SPAGE
TADR    DW #C000
LLLEN   DW #0001
TBY     DB 0
BYS     DB 0
PILW    DW 0

PILOT1  LD HL,PILLEN
        LD (PILW),HL
        LD B,BIPIL
        JP NXWRK

PILOT2  LD B,BIPIL
        LD HL,(PILW):DEC HL:LD (PILW),HL,A,H:OR L:JR NZ,EXWRK
        JP PILOT1

SYN1    LD B,BISY1:JP NXWRK
SYN2    LD B,BISY2
NXWRK   LD HL,STAT:INC (HL)
EXWRK   LD A,B,BC,PW3
Opwz    LD L,0:OUT L
        JP EXWR
STAT    DB 1
OPW3    EQU Opwz+1
;---------------------------------------
WRK2    EQU WRK+#200
        ORG WRK2ORG,WRK2
;-------
        LD BC,PW3:IN A:LD (OpwW+1),A
;-------
        LD A,(STAT)
        OR A:JP Z,LBITR
        DEC A:JP Z,PILOT1R
        DEC A:JP Z,PILOT2R
        DEC A:JP Z,SYN1R
        DEC A:JP Z,SYN2R

;NEW BLOCK
        LD HL,(TADR)
        LD A,L:OR H:LD A,(BNK):JR NZ,LNWBN1R
        LD H,#C0:INC A:LD (BNK),A

LNWBN1R LD BC,PW3:OUT A
        LD A,(HL),(LLOWR),A:INC HL
        LD A,L:OR H:LD A,(BNK):JR NZ,LNWBN2R

        LD H,#C0:INC A:LD (BNK),A
LNWBN2R OUT A:LD A,(HL):INC HL:LD (TADR),HL

LLOWR   EQU $+1:LD L,0,H,A,(LLLEN),HL

        XOR A:LD (STAT),A
        LD A,#55,(LBITR+1),A
LBITR   LD A,#55:RLCA:LD (LBITR+1),A
        LD B,BI0:JP NC,EXWRKR
        LD A,(BYS):ADD A,A:LD (BYS),A,A,(TBY):JR NZ,YBYR

        LD HL,(LLLEN),A,L:OR H:JP Z,NXWRKR
        DEC HL:LD (LLLEN),HL

        LD HL,(TADR),A,L:OR H:LD A,(BNK):JR NZ,NWBNR
        LD H,#C0:INC A:LD (BNK),A

NWBNR   LD BC,PW3:OUT A
        LD A,(HL):INC HL:LD (TADR),HL
        LD L,#00:OUT L
        LD HL,BYS:LD (HL),#FF;7 BIT
YBYR    ADD A,A:LD (TBY),A
        LD B,BI0:JP NC,EXWRKR
        LD B,BI1
        JP EXWRKR

PILOT1R LD HL,PILLENR
        LD (PILW),HL
        LD B,BIPIL
        JP NXWRKR

PILOT2R LD B,167:DJNZ $

        LD B,BIPIL
        LD HL,(PILW):DEC HL:LD (PILW),HL,A,H:OR L:JR NZ,EXWRKr
        JP PILOT1R

SYN1R   LD A,BISY1,B,SYN1T-DELTA0:JR SYNXR
SYN2R   LD A,BISY2,B,SYN2T-DELTA0
SYNXR   DJNZ $:LD B,A
NXWRKR  LD HL,STAT:INC (HL)
EXWRKr  LD A,B
        JR COMM
;-------
BIT0T   EQU 65;17
BIT1T   EQU BIT0T*2
BIT0t   EQU 10
BIT1t   EQU BIT0t*2
SYN1T   EQU 51
SYN2T   EQU 56

DELTA0  EQU 19;+19
DELTA1  EQU 9;+9
DELTA2  EQU 13;13
;-------
EXWRKR  LD A,B
        LD B,BIT0T-DELTA0-DELTA1:BIT 4,A:JR Z,PULSE1
        LD B,BIT1T-DELTA0-DELTA1
PULSE1  DJNZ $
COMM    LD BC,PW3
OpwW    LD L,0:OUT L
        JP EXWRR
;---------------------------------------
WRK3    EQU WRK2+#200
        ORG WRK3ORG,WRK3

;i:IX - Address
;  DE - Length
;
;o: DE=0
;    H=0
;    L=CRC
;    A=0
;   IX=IX+BLOCK Length
;
;   C - OK
;  NC - ERROR

WRKB3   XOR A:OUT (254)
        LD BC,PW3:IN A:LD (OPW3),A

        LD HL,(TAPPOZ)
        INC HL
        INC HL
        INC HL
        LD (TAPPOZ),HL
;-------
TOBUFF  LD BC,PW3,A,(TAPPG):OUT A
        LD HL,(TAPPOZ)
        LD BC,TLOBU

M3      LD A,H:OR A:JR NZ,MEL

        LD (TTBC),BC
        LD A,(TAPPG):INC A
        CP EPAGE:JR C,$+6:LD A,SPAGE,L,0
        LD (TAPPG),A
        LD BC,PW3:OUT A
        LD H,#C0
        LD BC,(TTBC)

MEL     LD A,(HL):INC HL
        LD (BC),A:INC BC:DEC DE
        LD A,B:CP #C0:JR NC,MELN
        LD A,D:OR E:JR NZ,M3

MELN    LD (TAPPOZ),HL
        LD (TTDE),DE
        LD (TTBC),BC

        LD (TTIX),IX
        LD DE,(TTIX)

        LD HL,TLOBU
M8      LD BC,PW3,A,(OPW3):OUT A

        LD BC,DE
        BIT 7,D:JR Z,M6
        BIT 6,D:JR NZ,M6
        LD BC,PW3,A,2:OUT A
        LD BC,DE
        SET 6,B
        SET 7,B

M6      LD A,(TTBC+0):CP L:JR NZ,M7
        LD A,(TTBC+1):CP H:JR Z,ME

M7      LD A,(HL):INC HL
        LD (BC),A:INC BC

        LD A,B:AND %00111111
        OR C:JR NZ,M6
        BIT 7,D:JR Z,MZ
        BIT 6,D:JR NZ,MZ
        LD A,B:SUB #40:LD B,A
MZ      LD DE,BC
        JR M8

ME      BIT 7,D:JR Z,M9
        BIT 6,D:JR NZ,M9
        LD A,B:SUB #40:LD B,A

M9      LD (TTIX),BC
        LD IX,(TTIX)
        LD DE,(TTDE)
;-------
        LD A,D:OR E:JP NZ,TOBUFF
        LD HL,(TAPPOZ):INC HL
        LD (TAPPOZ),HL

        LD BC,PW3
        LD A,(OPW3):OUT A

        LD DE,0,H,E
        JP EXWR2
;-------
TTDE    DS 2
TTBC    DS 2
TTIX    DS 2

TAPPOZ  DW #C000
TAPPG   DB SPAGE
        DS 255
WRKB3L  EQU $-WRKB3
;---------------------------------------
MAINPGL EQU ((WRK3+WRKB3L)/512)+1
        ORG MAINPGL*512
;-------
        INCB "TR-DOS.ROM"
        INCB "BASIC128.ROM"
        INCB "BASIC48.ROM"
;----------------------------------------
END