;TAP Mounter & SNA Launcher
;(C) BUDDER/MGN 2015
;---------------------------------------
LOBU    EQU #B000
LOB     EQU LOBU-27-4
;-------
        ORG #6000
;-------
BINAR   EQU #6200

SPAGE   EQU #C0
EPAGE   EQU #F0

D2PG    EQU #F6
D5PG    EQU #F5
;-------
WLD     EQU #6006
TMN     EQU #6009;Timer
;-------
SYC     EQU #20AF;SysConf
PE0     EQU #21AF;MemConf
Vmod    EQU #00AF
Vpag    EQU #01AF
Vfm     EQU #15AF
;-------
STS     EQU #27AF

DMASL   EQU #1AAF
DMASH   EQU #1BAF
DMASX   EQU #1CAF
DMADL   EQU #1DAF
DMADH   EQU #1EAF
DMADX   EQU #1FAF

DMA_T   EQU #28AF
DMA_N   EQU #26AF
DMA_C   EQU #27AF
;---------------------------------------
;HEADER:
        DS 16
        DB "WildCommanderMDL";    Header
        DB #04;                  Version
        DB 0;                       Type
        DB 4; Pages
        DB 0; Page to #8000
;-------
        DB 0,6;    CODE
        DB 1,32;   TRDOS
        DB 2,32;   Basic128
        DB 3,32;   Basic48

.2      DB 0,0
;-------
        DS 16
;-------
        DB "TAP"
        DB "SNA"
        DS 30*3
;-------
        DB 0
;-------
        DW #0000,#000C; MAX SIZE
;-------
        DB "TAP Mounter & SN"
        DB "A Launcher v0.5a"
;-------
        DB 0
;---------------------------------------
        ORG #8000,BINAR
;---------------------------------------
PLUGIN  LD (DAHL),HL,(DADE),DE

        CALL GEDPL

        CALL EXTCHE:JP Z,TAPZ
        DEC A:JP Z,SNAZ

TAPZ    LD IX,HPWND:CALL PRWOW
_LD HL,HELP,DE,#0100:CALL TXTPR
        LD IX,PLWND:CALL PRWOW

        LD A,1:CALL YN
;-------
MAIN    EI:HALT:XOR A:CALL YN,CURSOR
        LD DE,CONFIG:CALL PRCONF

        CALL UPPP,NZ,UPC
        CALL DWWW,NZ,DNC
        CALL SPKE,NZ,CHCO
        CALL ENKE:JR Z,MAIN

        LD IX,HPWND:CALL RRESB
        LD IX,PLWND:CALL RRESB
        LD A,#FF:CALL YN:JP NZ,EXIT
;-------
LGO     LD A,SPAGE,(PAGG),A
DADU    LD HL,PAGG,A,(HL):INC (HL)
        CP EPAGE:JP NC,EXIT:CALL MNGC
        LD HL,#C000,B,32:CALL LOAD512
        CP #0F:JR NZ,DADU

        JP TAPM
;-------
PRCONF  XOR A:LD (YYY),A
PRCON   CALL GENBUF:RET Z
        PUSH DE:LD D,A,E,1:CALL PRSRW
        POP DE
        JR PRCON

GENBUF  LD A,(DE):INC A:RET Z:DEC A

        EX DE,HL
        INC HL
        LD E,(HL):INC HL
        LD D,(HL):INC HL
        PUSH AF,DE
        LD DE,TXTBUF:CALL LDIRT:INC HL
        POP BC,AF

        PUSH HL:LD HL,BC
        INC HL:LD C,(HL):INC HL
        LD B,A:INC B
        XOR A:SUB C:ADD A,C:DJNZ $-1
        PUSH BC:LD C,A:ADD HL,BC
        POP BC
        LDIR
        LD A,32
        LD B,6,(DE),A:INC DE:DJNZ $-2

        POP HL
        EX DE,HL

        LD HL,YYY:INC (HL):LD A,(HL)
        LD HL,TXTBUF,BC,20
        OR A
        RET
LDIRT   LD A,(HL):OR A:RET Z
        LD (DE),A:INC HL,DE
        JR LDIRT
;-------
CHCO    LD HL,CONFIG
        LD A,(IX+12):DEC A:JR Z,LA
        LD E,A
COCO    LD A,(HL):CP #FF:RET Z
        INC HL,HL,HL
        XOR A:LD BC,32:CPIR:RET NZ
        DEC E:JR NZ,COCO

LA      CALL CHPRM
        RET
CHPRM   PUSH HL:INC HL
        LD E,(HL):INC HL
        LD D,(HL)
        LD A,(DE),C,A
        POP HL
        INC (HL):LD A,(HL):CP C:RET C
        LD (HL),0
        RET
;-------
UPC     LD A,(IX+12):CP 1:RET Z
        CALL CURSER
        DEC (IX+12)
        JP CURSOR
DNC     LD A,(IX+12):CP (IX+13):RET NC
        CALL CURSER
        INC (IX+12)
        JP CURSOR
;-------
EXIT    CALL GEDPL
        LD A,0
        RET
;-------
PAGG    NOP
;---------------------------------------
TAPM    DI
        LD HL,RESIDE,DE,RESID,BC,RESIDL
        LDIR

        LD A,TFPG:CALL MNGC;         SYS

        LD HL,WRK+#2000-#0200
        LD DE,#C000
        LD BC,#0400
        LDIR

        LD A,TRPG:CALL MNG0;      TR-DOS
        LD A,1:CALL MNGC_PL
        LD HL,#C000
        LD DE,#0000
        LD BC,#4000
        LDIR

        LD A,BCPG:CALL MNG0;    Basic128
        LD A,2:CALL MNGC_PL
        LD HL,#C000
        LD DE,#0000
        LD BC,#4000
        LDIR

        LD A,BAPG:CALL MNG0;     Basic48
        LD A,3:CALL MNGC_PL
        LD HL,#C000
        LD DE,#0000
        LD BC,#4000
        LDIR

        LD DE,#3CC0
        LD A,(CONFIG):OR A:JR Z,TRAP1
        LD HL,#0569
        LD (HL),#C3:INC HL
        LD (HL),E:INC HL
        LD (HL),D
        LD HL,STB2+#2000-#0200
        LD BC,STB2L:JR TRPZ
TRAP1   LD HL,#05E9
        LD (HL),#C3:INC HL
        LD (HL),E:INC HL
        LD (HL),D
        LD HL,STB+#2000-#0200
        LD BC,STBL
TRPZ    LDIR

        XOR A:CALL MNGC
        LD BC,PW0,A,#F8:OUT A
        LD A,(C3),C,#08:AND 3
.6      SLA A
        OR C:LD BC,PE0:OUT A

        LD BC,#EFF7:XOR A:OUT A
        LD A,(C2):AND 1:SLA A,A:LD C,A
        LD A,(C1):AND 3:OR C
        LD BC,SYC:OUT A

        LD A,63,I,A:IM 1
        LD IY,#5C3A

        LD HL,#5800,DE,HL:INC DE
        LD BC,#0800-1,(HL),L:LDIR

        LD BC,Vmod:XOR A:OUT A
        LD A,(C4):AND 1
.4      SLA A
        LD BC,#7FFD:OUT A
        JP RESID
;-------
RESIDE  LD BC,PW2,A,2:OUT A
        LD BC,PW3:XOR A:OUT A
        LD HL,#2758:EXX
        JP 0
RESIDL  EQU $-RESIDE
;---------------------------------------
SNA_I   EQU LOB
SNAaHL  EQU LOB+1
SNAaDE  EQU LOB+3
SNAaBC  EQU LOB+5
SNAaAF  EQU LOB+7
SNA_HL  EQU LOB+9
SNA_DE  EQU LOB+11
SNA_BC  EQU LOB+13
SNA_IY  EQU LOB+15
SNA_IX  EQU LOB+17
SNA_EI  EQU LOB+19

SNA_R   EQU LOB+20
SNA_AF  EQU LOB+21
SNA_SP  EQU LOB+23
SNA_IM  EQU LOB+25
SNA_BR  EQU LOB+26
SNA_PC  EQU LOB+27
SNA_7F  EQU LOB+29
SNA_TR  EQU LOB+30
;-------
SNA128  LD HL,(DAHL)
        LD A,L:CP #1F:JP NZ,EXIT
        LD A,H
        CP #00:JP Z,SNA7F
        CP #40:JP Z,SNA7F
        JP EXIT
;-------
SNAZ    LD HL,(DADE)
        LD A,H:OR A:JP NZ,EXIT
        LD A,L:CP 2:JR Z,SNA128
        OR A:JP NZ,EXIT
        LD HL,(DAHL)
        LD DE,#C01B
        OR A:SBC HL,DE:JP NZ,EXIT

        DI
        LD BC,Vmod,A,%00100000:OUT A
        CALL LDSNA,VROM

        LD SP,#C000:CALL DMAZ
SNAGO   DI
        LD HL,(SNA_SP),(SNASP+1),HL
        LD HL,(SNA_BC),(SNABC+1),HL
        LD HL,(SNA_HL),(SNAHL+1),HL

        XOR A:LD (SNAEI),A
        LD A,(SNA_EI)
        BIT 2,A:JR Z,NOEI
        LD A,#FB,(SNAEI),A

NOEI    LD HL,PATCH
        LD DE,#3CC0
        LD BC,EPATCH-PATCH:LDIR

        LD A,(SNA_BR):OUT (254)
        LD BC,PW0,A,#F8:OUT A
        LD BC,PE0,A,#08:OUT A
        LD BC,#EFF7:XOR A:OUT A
        LD BC,SYC,A,#00:OUT A
        LD BC,Vmod:XOR A:OUT A
        LD BC,PW3:XOR A:OUT A
        LD BC,#7FFD
SNAXX   LD A,16:OUT A

        LD A,(SNA_IM):AND 3
        OR A:JR Z,IM0
        DEC A:JR Z,IM1
IM2     IM 2:JR IMZ
IM1     IM 1:JR IMZ
IM0     IM 0
IMZ     LD A,(SNA_I),I,A
        LD HL,(SNAaAF)
        PUSH HL
        POP AF
        LD HL,(SNAaHL)
        LD DE,(SNAaDE)
        LD BC,(SNAaBC)
        EXA:EXX
        LD HL,(SNA_AF)
        PUSH HL
        POP AF
        LD DE,(SNA_DE)
        LD IX,(SNA_IX)
        LD IY,(SNA_IY)
        JP #3CC0
;-------
SNA7F   DI
        LD BC,Vmod,A,%00100000:OUT A
        CALL LDSNA2,VROM
        LD SP,#C000:CALL DMAZ

        LD A,(SNA_7F)
        BIT 4,A:JR Z,B128SNA

B48SNA  LD (SNAXX+1),A
        LD A,#C3,(SNAPC-1),A
        LD HL,(SNA_PC),(SNAPC),HL
        JP SNAGO

B128SNA PUSH AF:LD BC,PW0,A,BCPG:OUT A
        POP AF
        JR B48SNA
;-------
VROM    LD A,TRPG:CALL MNG0;      TR-DOS
        LD A,1:CALL MNGC_PL
        LD HL,#C000
        LD DE,#0000
        LD BC,#4000
        LDIR

        LD A,BCPG:CALL MNG0;    Basic128
        LD A,2:CALL MNGC_PL
        LD HL,#C000
        LD DE,#0000
        LD BC,#4000
        LDIR

        LD A,BAPG:CALL MNG0;     Basic48
        LD A,3:CALL MNGC_PL
        LD HL,#C000
        LD DE,#0000
        LD BC,#4000
        LDIR
        RET
;-------
DMAPG   CP 5:JR NZ,$+4:LD A,D5PG
        LD E,0,D,A:JR DMAz
DMAZ    LD DE,5*256+D5PG
DMAz    LD HL,0
        LD BC,DMASL:OUT L
        LD B,DMASH[:OUT H
        LD B,DMASX[:OUT E
        LD B,DMADL[:OUT L
        LD B,DMADH[:OUT H
        LD B,DMADX[:OUT D
        LD B,DMA_T[,A,#1F:OUT A
        LD B,DMA_N[,A,#FF:OUT A
        LD B,DMA_C[,A,%00000001:OUT A

        LD B,STS[:INF:JP M,$-2
        RET
;-------
LDSNA2  CALL LDSNA

        LD HL,LOBU+27,DE,LOB+27,BC,4
        LDIR

        LD A,(SNA_7F):AND %00000111
        PUSH AF:OR A:CALL NZ,DMAPG
        POP DE
        XOR A

LD128   CP 2:JR Z,SKP
        CP 5:JR Z,SKP
        CP D:JR Z,SKP:CALL MNGC,SNAPG2
SKP     INC A:CP 8:RET Z
        JR LD128

LDSNA   LD HL,LOBU,B,2:CALL LOAD512
        LD HL,LOBU,DE,LOB,BC,27:LDIR

        LD A,D5PG:CALL MNGC,SNAPG
        LD A,2:CALL MNGC,SNAPG
        LD A,0:CALL MNGC,SNAPG
        RET
;-------
SNAPG   LD DE,#C000
        LD A,32
BIKO    LD HL,LOBU+27,BC,512:LDIR
        PUSH DE
        LD DE,LOBU+27,BC,512-27:LDIR

        PUSH AF
        LD HL,LOBU+512,B,1:CALL LOAD512
        POP AF
        POP DE
        DEC A:JR NZ,BIKO
        RET
;-------
SNAPG2  PUSH DE
        LD DE,#C000
        LD B,32
BIKO2   PUSH BC
        LD HL,LOBU+27+4,BC,512:LDIR
        PUSH DE
        LD DE,LOBU+27+4,BC,512-27-4:LDIR

        PUSH AF
        LD HL,LOBU+512,B,1:CALL LOAD512
        POP AF
        POP DE
        POP BC:DJNZ BIKO2
        POP DE
        RET
;-------
PATCH   LD BC,PW1,L,5:OUT L
        LD BC,PW2,L,2:OUT L
SNAHL   LD HL,0
SNABC   LD BC,0
SNASP   LD SP,0
SNAEI   NOP
        RET
SNAPC   DS 2
EPATCH
;---------------------------------------
EXTCHE  PUSH HL,DE
        CALL TENTRY
;-------
        LD HL,ENTRY+8,DE,TAP
        CALL TN:LD A,0:JR Z,YUKSEK

        LD HL,ENTRY+8,DE,SNA
        CALL TN:LD A,1:JR Z,YUKSEK

        LD A,#FF
;-------
YUKSEK  POP DE,HL
        OR A
        RET
;-------
TN
_LD A,(DE):CP (HL):RET NZ:INC HL,DE
_LD A,(DE):CP (HL):RET NZ:INC HL,DE
_LD A,(DE):CP (HL)
        RET
;-------
TAP     DB "TAP"
SNA     DB "SNA"
;---------------------------------------
PW0     EQU #10AF
PW1     EQU #11AF
PW2     EQU #12AF
PW3     EQU #13AF
;-------
BI0     EQU #C0
BI1     EQU #D0
BISY1   EQU #D0
BISY2   EQU #D0
BIPIL   EQU #E0
PILLEN  EQU #0300
;-------
TFPG    EQU #F8;SYS      [vROM]
TRPG    EQU #F9;TR-DOS   [vROM]
BCPG    EQU #FA;BASIC128 [vROM]
BAPG    EQU #FB;BASIC48  [vROM]
;-------
RESID   EQU #4000
;---------------------------------------
MNG0    LD BC,PW0,(#6000),A:OUT A:RET
MNGC    LD BC,PW3,(#6003),A:OUT A:RET
;---------------------------------------
MNGC_PL EXA:LD A,0:JP WLD
PRWOW   LD A,1:JP WLD
RRESB   LD A,2:JP WLD
PRSRW   LD A,3:JP WLD
PRIAT   EXA:LD A,4:JP WLD
GADRW   LD A,5:JP WLD
CURSOR  LD A,6:JP WLD
CURSER  LD A,7:JP WLD
YN      EXA:LD A,8:JP WLD
ISTR    EXA:LD A,9:JP WLD

NORK    EXA:LD A,10:JP WLD
TXTPR   LD A,11:JP WLD
DMAPL   EXA:LD A,13:JP WLD
GEDPL   LD A,15:JP WLD
;-------
SPKE    LD A,16:JP WLD
UPPP    LD A,17:JP WLD
DWWW    LD A,18:JP WLD
LFFF    LD A,19:JP WLD
RGGG    LD A,20:JP WLD
TABK    LD A,21:JP WLD
ENKE    LD A,22:JP WLD
ESC     LD A,23:JP WLD
F1      LD A,29:JP WLD
F5      LD A,33:JP WLD
F10     LD A,38:JP WLD
ALT     LD A,39:JP WLD
SHIFT   LD A,40:JP WLD
CTRL    LD A,41:JP WLD
USPO    LD A,46:JP WLD
NUSP    LD A,47:JP WLD
;-------
LOAD512 LD A,48:JP WLD
LOAD256 LD A,60:JP WLD
LOADNON LD A,61:JP WLD

SAVE512 LD A,49:JP WLD
TENTRY  LD DE,ENTRY,A,51:JP WLD
MKFILE  LD A,58:JP WLD
;-------
MNGV_PL EXA:LD A,64:JP WLD
MNGCVPL EXA:LD A,65:JP WLD
GVmod   EXA:LD A,66:JP WLD
GYoff   LD A,67:JP WLD
GXoff   LD A,68:JP WLD
;---------------------------------------
PLWND   DB 2,0
        DB 29,10;    X,Y
        DB 20+2,7+2; W,H
        DB %01111111;PAPER+INK
        DB 0
        DW #0000;    BUFFER
        DB 2,0;      LINES

        DB 1,5;        CURnow,CURmax
        DB %11110001,0;CURcolor

        DW TAPL
        DW 0
        DW 0
;-------
HPWND   DB 0,0
        DB 17,20;    X,Y
        DB 44+2,1+2; W,H
        DB %01001111;PAPER+INK
        DB 0
        DW #0000;    BUFFER
        DB 0,0;      LINES
;-------
TAPL    DB #0E,"TAP Mounter:",0
HELP    DB #0E,"SPACE - Change option, "
        DB "ENTER - Start/Cancel.",0
;-------
CONFIG  DB 0:DW TALG:DB "  Loading: ",0
C1      DB 0:DW FRQX:DB " CPU Freq: ",0
C2      DB 0:DW ONOF:DB "    Cache: ",0
C3      DB 1:DW MELX:DB "   Memory: ",0
C4      DB 0:DW BASX:DB "      ROM: ",0
        DB #FF
;-------
TALG    DB 2,4
        DB "SLOW"
        DB "FAST"
FRQX    DB 3,6
        DB "3.5MHz"
        DB "7MHz  "
        DB "14MHz "
ONOF    DB 2,3
        DB "OFF"
        DB "ON "
MELX    DB 4,5
        DB "512K "
        DB "128K "
        DB "Auto "
        DB "1024K"
BASX    DB 2,8
        DB "Basic128"
        DB "Basic48 "
;---------------------------------------
TXTBUF  DS 32
ENTRY   DS 32
;-------
SPBU    DS 2

YYY     NOP

DAHL    DS 2
DADE    DS 2
;-------
YADU    EQU $-PLUGIN
;---------------------------------------
;---------------------------------------
STB     EQU BINAR+YADU
        ORG #3CC0,STB
StB     PUSH HL,BC
        LD BC,PW2,L,TFPG:OUT L
        JP #8000

EXWR    LD BC,PW2,L,#02:OUT L
        POP BC,HL
        LD B,A
        JP #05FA
STBL    EQU $-StB

STB2    EQU STB+STBL
        ORG #3CC0,STB2
StB2    LD BC,PW2,L,TFPG:OUT L
        JP #8200

EXWR2   LD BC,PW2,L,#02:OUT L
        XOR A:OUT (254)
        JP #05DF
STB2L   EQU $-StB2
;---------------------------------------
;---------------------------------------
WRK     EQU STB2+STB2L

        ORG #8000,WRK
TLOBU   EQU #9000
;-------
        LD BC,PW3:IN A:LD (OPW3),A
;-------
        LD A,(STAT)
        OR A:JR Z,LBIT
        DEC A:JP Z,PILOT1
        DEC A:JP Z,PILOT2
        DEC A:JP Z,SYN1
        DEC A:JP Z,SYN2

;NEW BLOCK

        LD HL,(TADR)
        LD A,L
        OR H:LD A,(BNK):JR NZ,LNWBN1
        LD H,#C0
        INC A:LD (BNK),A

LNWBN1  LD BC,PW3:OUT A
        LD A,(HL)
        LD (LLOW),A:INC HL
        LD A,L
        OR H:LD A,(BNK):JR NZ,LNWBN2

        LD H,#C0:INC A:LD (BNK),A

LNWBN2  OUT A
        LD A,(HL):INC HL
        LD (TADR),HL
;LD L,#00:OUT L

LLOW    EQU $+1
        LD L,0
        LD H,A
        LD (LLLEN),HL

        XOR A:LD (STAT),A
        LD A,#55,(LBIT+1),A

LBIT    LD A,#55
        RLCA
        LD (LBIT+1),A
        LD B,BI0:JP NC,EXWRK

        LD A,(BYS):ADD A,A
        LD (BYS),A
        LD A,(TBY):JR NZ,YBY

        LD HL,(LLLEN)
        LD A,L:OR H:JP Z,NXWRK;PILOT1
        DEC HL
        LD (LLLEN),HL

        LD HL,(TADR)
        LD A,L
        OR H:LD A,(BNK):JR NZ,NWBN
        LD H,#C0:INC A:LD (BNK),A

NWBN    LD BC,PW3:OUT A
        LD A,(HL):INC HL
        LD (TADR),HL
        LD L,#00:OUT L

        LD HL,BYS
        LD (HL),#FF;7 BIT

YBY     ADD A,A
        LD (TBY),A

        LD B,BI0:JP NC,EXWRK
        LD B,BI1
        JP EXWRK

BNK     DB SPAGE
TADR    DW #C000
LLLEN   DW #0001
TBY     DB 0
BYS     DB 0

PILOT1  LD HL,PILLEN
        LD (PILW),HL
        LD B,BIPIL
        JP NXWRK

PILOT2  LD B,BIPIL
        LD HL,(PILW):DEC HL
        LD (PILW),HL
        LD A,H:OR L:JR NZ,EXWRK
        JP PILOT1

PILW    DW 0

SYN1    LD B,BISY1:JP NXWRK
SYN2    LD B,BISY2
NXWRK   LD HL,STAT:INC (HL)
EXWRK   LD A,B
        LD BC,PW3
Opwz    LD L,0:OUT L
        JP EXWR
STAT    DB 1
OPW3    EQU Opwz+1
;---------------------------------------
        ORG #8200,WRK+#0200

;i:IX - Address
;  DE - Length
;
;o: DE=0
;    H=0
;    L=CRC
;    A=0
;   IX=IX+BLOCK Length
;
;   C - OK
;  NC - ERROR

        XOR A:OUT (254)
        LD BC,PW3:IN A:LD (OPW3),A

        LD HL,(TAPPOZ)
        INC HL
        INC HL
        INC HL
        LD (TAPPOZ),HL
;-------
TOBUFF  LD BC,PW3,A,(TAPPG):OUT A
        LD HL,(TAPPOZ)
        LD BC,TLOBU

M3      LD A,H:OR A:JR NZ,MEL

        LD (TTBC),BC
        LD A,(TAPPG):INC A
        CP EPAGE:JR C,$+6:LD A,SPAGE,L,0
        LD (TAPPG),A
        LD BC,PW3:OUT A
        LD H,#C0
        LD BC,(TTBC)

MEL     LD A,(HL):INC HL
        LD (BC),A:INC BC:DEC DE
        LD A,B:CP #C0:JR NC,MELN
        LD A,D:OR E:JR NZ,M3

MELN    LD (TAPPOZ),HL
        LD (TTDE),DE
        LD (TTBC),BC

        LD (TTIX),IX
        LD DE,(TTIX)

        LD HL,TLOBU
M8      LD BC,PW3,A,(OPW3):OUT A

        LD BC,DE
        BIT 7,D:JR Z,M6
        BIT 6,D:JR NZ,M6
        LD BC,PW3,A,2:OUT A
        LD BC,DE
        SET 6,B
        SET 7,B

M6      LD A,(TTBC+0):CP L:JR NZ,M7
        LD A,(TTBC+1):CP H:JR Z,ME

M7      LD A,(HL):INC HL
        LD (BC),A:INC BC

        LD A,B:AND %00111111
        OR C:JR NZ,M6
        BIT 7,D:JR Z,MZ
        BIT 6,D:JR NZ,MZ
        LD A,B:SUB #40:LD B,A
MZ      LD DE,BC
        JR M8

ME      BIT 7,D:JR Z,M9
        BIT 6,D:JR NZ,M9
        LD A,B:SUB #40:LD B,A

M9      LD (TTIX),BC
        LD IX,(TTIX)
        LD DE,(TTDE)
;-------
        LD A,D:OR E:JP NZ,TOBUFF
        LD HL,(TAPPOZ):INC HL
        LD (TAPPOZ),HL

        LD BC,PW3
        LD A,(OPW3):OUT A

        LD DE,0,H,E
        JP EXWR2
;-------
TTDE    DS 2
TTBC    DS 2
TTIX    DS 2

TAPPOZ  DW #C000
TAPPG   DB SPAGE
;---------------------------------------
        DS 255
