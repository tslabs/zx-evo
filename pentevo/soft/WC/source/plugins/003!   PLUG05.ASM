;TR-DOS MOUNTERv0.7
;(C) BUDDER/MGN/2012
;---------------------------------------
        ORG #6000
;-------
WLD     EQU #6006

PW0     EQU #10AF
PW3     EQU #13AF
VFDD    EQU #29AF

BLKZ    EQU 4
EMU     EQU #6200+(BLKZ*#0200)

NV29AF  EQU #B0
;-------
RAMD    EQU #C0
RAMDE   EQU #C0+#28
;---------------------------------------
;HEADER:
        DS 16
        DB "WildCommanderMDL";    Header
        DB #01;                  Version
        DB 0;                       Type
        DB 3; Pages
        DB 0; Page to #8000
;-------
        DB 0,BLKZ; CODE
        DB 1,32;   page to #FF
        DB 2,16;   #FE

.3      DB 0,0
;-------
        DS 16
;-------
        DB "TRD"
        DB "SCL"
        DS 30*3
;-------
        DB 0
;-------
        DW #0000,#000A; MAX SIZE
;-------
        DB "TR-DOS Mounter v"
        DB "0.7             "
;-------
        DB 3;    3 - by EXT or From menu
;-------
        DS 256
;---------------------------------------
        ORG #8000,#6200
;-------
LOBU    EQU #A000
LOBE    EQU LOBU+#1000
LOB2    EQU #B000
;---------------------------------------
PLUGIN  PUSH AF,HL,DE:CALL GEDPL
        POP DE,HL,AF

        OR A:JP Z,EXTENS
        CP 3:RET NZ
;-------
MENUS   PUSH IX

        CALL RSoDIZ:JR NZ,MOX

        LD A,(CUZ2)
        DEC A:JR Z,MORS
        DEC A:JR Z,DIZMA
MOX     POP IX
        RET
;-------
DIZMA
_LD HL,TXT2,DE,#0004,BC,12
        CALL DRIVEZ,Z,DIZMAUN:JR MOX
;-------
MORS
_LD HL,TXT1,DE,#0002,BC,15
        CALL DRIVEZ,Z,MOUNTRS:JR MOX
;-------
RSoDIZ  LD IX,MEWND:CALL PRWOW
_LD HL,ME05,DE,#0102,BC,16:CALL PRSRW
_LD HL,ME06,DE,#0202,BC,16:CALL PRSRW

MADI    EI:HALT:CALL CURSOR

        CALL UPPP,NZ,UPC
        CALL DWWW,NZ,DNC

        CALL ESC:JR NZ,ADI
        CALL ENKE:JR Z,MADI

MAD     LD IX,MEWND:CALL RRESB
        XOR A
        RET
;-------
ADI     CALL MAD:INC A:RET
;---------------------------------------
EXTENS  PUSH IX

        CALL EXTCHE:JR NZ,NOT_TRD

        LD (DAHL),HL,(DADE),DE
        LD A,E:CP #0A:JP NZ,NYA
        LD A,D:OR H,L:JP NZ,NYA

        CALL CHECK:JR NZ,YA

        LD HL,TXT0,DE,#0004,BC,13
        CALL DRIVEZ,Z,MOUNTRD

YA      LD A,(ESTAT)
NYA     POP IX
        RET
;-------
NOT_TRD LD HL,TXT3,DE,#0002,BC,16
        CALL DRIVEZ,Z,MOUNRAM
        JR YA
;---------------------------------------
DRIVEZ  PUSH HL,DE,BC
        CALL INDICA
        LD IX,PLWND:CALL PRWOW
        POP BC,DE,HL
        CALL PRSRW
        LD A,%11110111:CALL PRIAT

_LD HL,ME01,DE,#0102,BC,16:CALL PRSRW
_LD HL,ME02,DE,#0202,BC,16:CALL PRSRW
_LD HL,ME03,DE,#0302,BC,16:CALL PRSRW
_LD HL,ME04,DE,#0402,BC,16:CALL PRSRW

        LD A,1:CALL YN
MAIN    EI:HALT:XOR A:CALL YN,CURSOR

        CALL UPPP,NZ,UPC
        CALL DWWW,NZ,DNC

        CALL ESC:JR NZ,AIN
        CALL ENKE:JR Z,MAIN

        LD A,#FF:CALL YN:JR NZ,AIN

MAJ     LD IX,PLWND:CALL RRESB
        XOR A
        RET
;-------
AIN     CALL MAJ:INC A:RET
;-------
UPC     LD A,(IX+12):CP 1:RET Z
        CALL CURSER
        DEC (IX+12)
        JP CURSOR
DNC     LD A,(IX+12):CP (IX+13):RET NC
        CALL CURSER
        INC (IX+12)
        JP CURSOR
;---------------------------------------
INDICA  LD BC,#DFF7,A,NV29AF:OUT A
        LD B,#BF:IN E

        LD BC,#202A
        LD A,B:BIT 0,E:JR Z,$+3:LD A,C
        LD (ME01+12),A
        LD A,B:BIT 1,E:JR Z,$+3:LD A,C
        LD (ME02+12),A
        LD A,B:BIT 2,E:JR Z,$+3:LD A,C
        LD (ME03+12),A
        LD A,B:BIT 3,E:JR Z,$+3:LD A,C
        LD (ME04+12),A
        RET
;---------------------------------------
MOUNT   CALL MOO1
        CALL MOO2
        RET
;-------
MOUNTRD LD IX,STWND:CALL PRWOW
_LD HL,TXT5,DE,#0104,BC,23:CALL PRSRW
_LD A,%01110000:CALL PRIAT

        CALL MOO1
        CALL MOOT

        LD IX,STWND:CALL RRESB
        RET
;---------------------------------------
MOO1    LD A,#FF:CALL MNG0
        LD A,1:CALL MNGC_PL
        LD HL,#C000,DE,#0000,BC,#4000
        LDIR:RST 0
;-------
        LD A,(CUZ)
        LD HL,BITZ-1,B,0,C,A:ADD HL,BC

        LD BC,#DFF7,A,NV29AF:OUT A
        LD B,#BF:IN A
        OR A:JR Z,TMA

        PUSH HL,BC,AF
        LD A,#FE:CALL MNG0
        LD HL,#0000+8,DE,DRT,BC,4:LDIR
        POP AF,BC,HL

TMA     OR (HL):OUT A
        LD BC,VFDD:OUT A

        CALL MNG0D
        RET
;-------
MOOT    LD A,(CUZ)
        DEC A:JR Z,DRVA
        DEC A:JR Z,DRVB
        DEC A:JR Z,DRVC

DRVD    LD A,#FF,(DRT+3),A
        LD A,#FD:CALL MNGC
        JR DRVn
;-------
DRVC    LD A,#FF,(DRT+2),A
        LD A,#FD:CALL MNGC
        JR DRVN
;-------
DRVB    LD A,#FF,(DRT+1),A
        LD A,#FC:CALL MNGC
DRVn    LD DE,#E000,BC,#FFFF
        JR DRVX
;-------
DRVA    LD A,#FF,(DRT+0),A
        LD A,#FC:CALL MNGC
DRVN    LD DE,#C000,BC,#E000
DRVX    CALL CHTOSEP

MOO2    LD HL,(CUZ),H,0
        LD BC,DRT-1:ADD HL,BC
        LD A,(MCZ),(HL),A

        LD A,#FE:CALL MNG0
        LD A,2:CALL MNGC_PL

        LD HL,DRT,DE,#C000+8,BC,4:LDIR
        LD HL,#C000,DE,#0000,BC,#2000
        LDIR

        CALL MNG0D
        RET
;---------------------------------------
MOUNTRS XOR A:LD (MCZ),A;      0 - RS232
        JP MOUNT
;---------------------------------------
MOUNRAM LD IX,STWND:CALL PRWOW
_LD HL,TXT4,DE,#0103,BC,26:CALL PRSRW
_LD A,%01110000:CALL PRIAT

        CALL SCL_RAM

        LD IX,STWND:CALL RRESB
;-------
        LD A,5,(MCZ),A;     5 - RAM DISK
        CALL MOUNT
        RET
;---------------------------------------
DIZMAUN LD A,(CUZ)
        LD HL,ZITZ-1,B,0,C,A:ADD HL,BC

        LD BC,#DFF7,A,NV29AF:OUT A
        LD B,#BF
        IN A:AND (HL)
        OUT A
        RET
;---------------------------------------
SCL_RAM XOR A:LD (EOC),A

        LD HL,LOBU,B,8
        PUSH HL:CALL LOAD512
        POP HL
        LD B,8,DE,SINC:CALL CHEE:RET NZ

        LD A,(HL):DEC A:CP 128:RET NC
;-------
        LD A,RAMD,(PGRAMD),A:CALL MNGC

        EXX
        LD HL,#C000,DE,HL:INC DE
        LD BC,(256*9)-1,(HL),0:LDIR
        EXX

        LD DE,#0100,(#C000+14),DE
        LD DE,#C000
        LD B,(HL):INC HL
SCLF    PUSH BC
        LD BC,14:LDIR
        EX DE,HL
        PUSH DE
        DEC HL:LD B,(HL)
        INC HL:LD A,(HL)
        INC HL:LD D,(HL):CALL NFS
        LD C,15:ADD HL,BC
        LD (HL),A:INC HL
        LD (HL),D
        LD BC,0-15:ADD HL,BC
        POP DE
        EX DE,HL
        POP BC
        DJNZ SCLF
        XOR A:LD (DE),A
;-------
        PUSH HL
;              _
        CALL HAUDEH,CAT9C
        POP HL
;-------
        EX DE,HL
        LD HL,LOBE:OR A:SBC HL,DE
        LD BC,HL
        EX DE,HL
        LD DE,#C000+#1000:LDIR
;-------
DSCL    EX DE,HL
LDSCL   LD A,(EOC):CP #0F:RET Z
        LD B,1:CALL LOAD512
        LD (EOC),A
        LD A,H:CP #C0:JR NC,LDSCL

        LD A,(PGRAMD)
        INC A:CP RAMDE:RET NC
        LD (PGRAMD),A:CALL MNGC

        LD BC,HL,HL,0,DE,#C000:LDIR
        JR DSCL
;---------------------------------------
NFS     INC A:CP 16:JR C,JEKTOR:INC D
        XOR A
JEKTOR  DJNZ NFS
        RET

ADDSUM  LD HL,0,DE,0
        EXX
        LD HL,#C000,DE,13,B,128
DSU     LD A,(HL):OR A:RET Z
        ADD HL,DE
        LD A,(HL)
        EXX
        LD E,A
        ADD HL,DE
        EXX
        INC HL,HL,HL
        DJNZ DSU
        RET

CAT9C   EXX
        LD HL,#C8EA,DE,HL:INC DE
        LD BC,9-1,(HL),32:LDIR
        LD A,#10,(#C000+#08E7),A
        EXX

        LD A,129:SUB B
        LD (#C000+#08E4),A
        LD A,C,(#C000+#08F4),A
        DEC HL:LD D,(HL)
        DEC HL:LD A,(HL)
        DEC HL:LD B,(HL):CALL NFS
        LD E,A,(#C000+#08E1),DE
        CALL ADDSUM:EXX
        EX DE,HL:LD HL,2544
        OR A:SBC HL,DE:RET C
        LD (#C000+#08E5),HL
        XOR A
        RET
; _
HAUDEH  LD HL,#C000,DE,16,BC,#8100
HEHA    LD A,(HL):OR A:RET Z
        CP 1:JR NZ,$+3:INC C
        ADD HL,DE
        DJNZ HEHA
        OR A
        RET
;-------
CHEE    LD A,(DE):CP (HL):RET NZ
        INC HL,DE
        DJNZ CHEE
        RET
;---------------------------------------
CHECK   LD C,(IX+29)
        LD HL,CHE,B,0:ADD HL,BC
        LD A,(HL),(MCZ),A
        LD A,C
;0 - IDEnemo, 1 - SD(ZC), 2 - SD(NGS)
        CP 0:RET Z
        CP 1:RET Z

        LD IX,ERWND:CALL PRWOW
_LD HL,TE01,DE,#0101,BC,31:CALL PRSRW
        LD A,%00101010:CALL PRIAT

        CALL USPO
        CALL NUSP

        LD IX,ERWND:CALL RRESB

        LD A,1:OR A
        RET
;---------------------------------------
EXTCHE  PUSH HL,DE
        CALL TENTRY
;-------
        LD HL,ENTRY+8,DE,TRD
        CALL TN:LD A,0:JR Z,YUKSEK

        LD HL,ENTRY+8,DE,SCL
        CALL TN:LD A,1:JR Z,YUKSEK
;-------
YUKSEK  POP DE,HL
        OR A
        RET
;---------------------------------------
TN
_LD A,(DE):CP (HL):RET NZ:INC HL,DE
_LD A,(DE):CP (HL):RET NZ:INC HL,DE
_LD A,(DE):CP (HL)
        RET
;---------------------------------------
MNG0    LD BC,PW0:OUT A:RET
MNG0D   LD BC,PW0,A,(#6000):OUT A:RET
MNGC    LD (#6003),A,BC,PW3:OUT A:RET
;---------------------------------------
MNGC_PL EXA:XOR A:JP WLD

PRWOW   LD A,1:JP WLD
RRESB   LD A,2:JP WLD
PRSRW   LD A,3:JP WLD
PRIAT   EXA:LD A,4:JP WLD

CURSOR  LD A,6:JP WLD
CURSER  LD A,7:JP WLD

YN      EXA:LD A,8:JP WLD
;-------
GEDPL   LD A,15:JP WLD
;-------
UPPP    LD A,17:JP WLD
DWWW    LD A,18:JP WLD

ENKE    LD A,22:JP WLD
ESC     LD A,23:JP WLD

USPO    LD A,46:JP WLD
NUSP    LD A,47:JP WLD
;-------
LOAD512 LD A,48:JP WLD

TENTRY  LD DE,ENTRY,A,51:JP WLD
CHTOSEP LD A,52:JP WLD
;---------------------------------------
PLWND   DB 0,0
        DB 30,10;    X,Y
        DB 18+2,6+2; W,H
        DB %01111111;PAPER+INK
        DB 0
        DW #0000;    BUFFER
        DB 2,0;      LINES

CUZ     DB 1,4
        DB %11110001,0
;-------
MEWND   DB 0,0
        DB 30,11;    X,Y
        DB 18+2,2+2; W,H
        DB %01111111;PAPER+INK
        DB 0
        DW #0000;    BUFFER
        DB 0,0;      LINES

CUZ2    DB 1,2
        DB %11110001,0
;-------
ERWND   DB 0,0
        DB 23,12;    X,Y
        DB 32+2,1+2; W,H
        DB %00101111;PAPER+INK
        DB 0
        DW #0000;    BUFFER
        DB 0,0;      LINES
;-------
STWND   DB 0,0
        DB 24,12;    X,Y
        DB 32+2,1+2; W,H
        DB %01111111;PAPER+INK
        DB 0
        DW #0000;    BUFFER
        DB 0,0;      LINES
;-------
BITZ    DB %00000001
        DB %00000010
        DB %00000100
        DB %00001000

ZITZ    DB %11111110
        DB %11111101
        DB %11111011
        DB %11110111
;-------
CHE     DB 1
        DB 3
        DS 6
;-------
TXT0    DB "Mount TRD to:"
TXT1    DB "Mount RS232 to:"
TXT2    DB "Dismounting:"
TXT3    DB "SCL as RAM disk:"
TXT4    DB "Copying SCL to RAM disk!!!"
TXT5    DB "Mounting TRD to vDOS!!!"

T01     DB "Mount "
TNAME   DB "12345678.123 "

TE01    DB "This Device is NOT "
        DB "supported!!!"

ME01    DB "    Drive A     "
ME02    DB "    Drive B     "
ME03    DB "    Drive C     "
ME04    DB "    Drive D     "

ME05    DB " <Mount RS-232> "
ME06    DB "<Dismount Drive>"

IDNT    DB 0,"vTR-DOS MDLn2!",0
;---------------------------------------
TRD     DB "TRD"
SCL     DB "SCL"
SINC    DB "SINCLAIR"

DRT     DB #FF;0-RS232,1/2-HDD,3-SD(ZC)
        DB #FF;4-*SD(NGS)
        DB #FF;5-RAM DISK
        DB #FF

DAHL    DS 2
DADE    DS 2

MCZ     NOP
MCC     NOP

PGRAMD  NOP
EOC     NOP

ESTAT   NOP
ENTRY   DS 32
;---------------------------------------
        ORG EMU
        INCB "EMU"
        ORG EMU+#4000
        INCB "MN2O"
;---------------------------------------
