;Wild Player plugin v0.4
;(C) BUDDER/MGN/2012
;---------------------------------------
        ORG #6000
;-------
WLD     EQU #6006
;---------------------------------------
        DS 16
        DB "WildCommanderMDL";    Header
        DB #00;                  Version
        DB 0;                       Type
        DB 6; Pages
        DB 0; Page to #8000
;-------
        DB 0,16; CODE
        DB 2,32; PLAYERS1
        DB 3,5;  PLAYERS2

.3      DB 0,0
;-------
        DS 16
;-------
        DB "C  "
        DB "M  "
        DB "MUZ"
        DB "$C "
        DB "$M "
        DB "$P "

        DB "ASC"
        DB "SQT"
        DB "STC"
        DB "FLS"
        DB "STP"
        DB "FTC"
        DB "PSC"

        DB "PT1"
        DB "PT2"
        DB "PT3"
        DB "GTR"
        DB "TFC"
        DB "VTX"
        DB "VT "
        DB "FXM"

        DB "P_M"
        DB "P_C"
        DB "P_S"
        DB "P_A"
        DB "P_P"
        DB "P_F"
        DB "P_T"
        DB "P_G"
        DB "P_V"

        DS 3*2
;-------
        DB 0
;-------
        DW #6000,#0000; MAX SIZE
;-------
        DB "Wild Player Plug"
        DB "-in v0.333.4    "
;---------------------------------------
        ORG #8000,#6200
;-------
INSTM   EQU #C000
PLAYM   EQU #C005
STOPM   EQU #C008
;-------
PT3PL   EQU #0BE1
PT2PL   EQU #0A0C
STPPL   EQU #0768
STPL    EQU #043C
PSCPL   EQU #0BAB
FTPL    EQU #0B65
GTPL    EQU #05F5
FMPL    EQU #0743
VTPL    EQU #086E
;-------
SECBU   EQU #9E00
LOBU    EQU #A000
;---------------------------------------
WP333   PUSH IX
        LD (DADE),HL

        LD A,1
        LD (ESTAT),A
        LD (P_CH),A
        LD HL,0
        LD (P_SH),HL,(TME),HL,(P_NU),HL

        LD IX,MNWND,A,1:CALL WLD
;-------
_LD HL,TXT0,DE,#000F,BC,12,A,3:CALL WLD
_LD A,%11110000:EXA:LD A,4:CALL WLD

        LD A,(IX+5):DEC A:LD D,A
_LD HL,TXT3,E,#0F,BC,12,A,3:CALL WLD
_LD A,%11110111:EXA:LD A,4:CALL WLD
;-------
        CALL NP6
        LD B,48,HL,LOBU:CALL LOAD512

        LD A,(DETKA):OR A:CALL NZ,TFMDET

        CALL ZAPUMZ
        LD A,(MUZPL):OR A:JP Z,EXIT
;-------
        CALL GEDPL

        CALL PLRINF
_LD HL,PLT0,DE,#0601,BC,8,A,3:CALL WLD
_LD A,%01110010:EXA:LD A,4:CALL WLD
_LD HL,PL0,DE,#0609,BC,26,A,3:CALL WLD

_LD HL,PLT1,DE,#0701,BC,8,A,3:CALL WLD
_LD A,%01110010:EXA:LD A,4:CALL WLD
_LD HL,PL1,DE,#0709,BC,8,A,3:CALL WLD
;-------
        CALL ANFNT
        CALL PBCLC,PBFCLR
        LD C,0:CALL TURBO
MAIN    EI:HALT
        CALL ATIT
        CALL PMACH:LD A,2:JR NZ,EX2
        CALL CLOCK,ANALYZE,ANPR

_LD A,16+6:CALL WLD:LD A,2:JR NZ,EX2
        LD A,16+7:CALL WLD:JR NZ,EXT
        LD A,16+0:CALL WLD:JR Z,MAIN
EXT     XOR A
EX2     LD (ESTAT),A

        CALL TURBD
        CALL DEFNT
;-------
EXIT    CALL AYOFF
        LD IX,MNWND,A,2:CALL WLD

        LD A,(ESTAT)
        POP IX
        RET
;---------------------------------------
PLRINF  CALL NP1

        LD HL,PL0,B,26
        XOR A:LD (HL),A:INC HL:DJNZ $-2
        LD HL,"00",(PL2+1),HL

        LD DE,(#C000)
        LD HL,PTI,B,14
AJ      LD A,(HL):INC HL:CP E:JR NZ,AL
        LD A,(HL):CP D:JR Z,A1J
AL      INC HL,HL,HL
        DJNZ AJ
        LD HL,PTIX-1
A1J     INC HL
        LD (NOWT),BC
        LD E,(HL):INC HL
        LD D,(HL)
        EX DE,HL
        LD DE,PL0,C,255
        LDI:LD A,(HL):OR A:JR NZ,$-4

        LD HL,"MF"
        LD A,(FMMZ):OR A:JR NZ,A2J
        LD HL,"YA"
A2J     LD A,(TSMZ)
        OR A:JR Z,$+3:LD HL,"ST"
        LD (PL1),HL
        RET
;---------------------------------------
ZAPUMZ  LD HL,#0100,(MUZPL),HL
        CALL AYOFF

        LD HL,GTPR
_LD B,64,A,32,(HL),A:INC HL:DJNZ $-2

TRY0    XOR A:LD (FMMZ),A
        LD HL,LOBU,DE,HRFO
        CALL SRHMZ:JR NZ,TRY1
        LD A,(HL):AND %01111111
        CP "1":JR NZ,TRY1
        LD HL,(LOBU+4),A,H
        CP #50:JP NC,NEmUZ
        LD (DADE),HL

        LD HL,LOBU,DE,HL:CALL DEHR21

TRY1    LD HL,LOBU,DE,PTFO;          PT3
        LD A,1,(STA),A
        CALL ZATA:JP NZ,TRY1A
        XOR A:LD (VTMD),A

        LD DE,PTFO
        JP TSPT3

OTN     LD HL,0
        DEC HL
        LD DE,LOBU,BC,#4000-PT3PL
        LDIR

        LD A,(VTMD):OR A:JR Z,NVT
        LD DE,VTDL
        CALL GETMZ
        LD HL,#C000+24,BC,VTLN
        CALL GETPL

        LD HL,VTDL+30,(ONEB),HL
        LD HL,VTDL+66,(TWOB),HL
        JR JAZZ

NVT     LD A,(LOBU+98):CP #20:JR Z,NOTS
        LD A,2,(ZZMZ),A,(TSMZ),A

NOTS    LD DE,MMODUL
        CALL GETMZ

        LD HL,#C000+6,BC,PT3LN
        CALL GETPL

        LD HL,MMODUL+30,(ONEB),HL
        LD HL,MMODUL+66,(TWOB),HL

JAZZ    LD A,32,(#C00A),A

        LD A,5,(CTOL+1),A
MUZZ    CALL INSTM
;LD A,1,(P_ST),A
        LD HL,0,(TMM),HL

TRECH   LD A,(ZZMZ):OR A:JR NZ,GG
        LD HL,(TSFG),H,0
        LD (TSMZ),HL

GG      XOR A:LD (ZZMZ),A
        LD HL,1,(MUZPL),HL

        CALL KOSHI
        CALL KPAH
        RET

KPAH    LD HL,(ONEB),DE,MZNM,BC,32:LDIR
        LD HL,(TWOB),DE,MZNM+32,C,32
        LDIR

        LD IX,MNWND
_LD HL,TXT1,DE,#0301,BC,8,A,3:CALL WLD
_LD A,%01110001:EXA:LD A,4:CALL WLD
_LD HL,TXT2,DE,#0401,BC,8,A,3:CALL WLD
_LD A,%01110001:EXA:LD A,4:CALL WLD

_LD HL,MZNM,DE,#0309,BC,32,A,3:CALL WLD
_LD HL,MZN2,DE,#0409,BC,32,A,3:CALL WLD
        RET

NEmUZ   XOR A:LD (PAUS),A
        RET
;-------
KOSHI   ;LD A,1:LD (FILI),A
;XOR A:LD (ANCI),A
        RET

ZATA    LD (ZA+1),DE
        PUSH HL
        LD BC,(DADE)
        LD HL,LOBU:ADD HL,BC
        LD BC,HL
        POP HL
ZA      LD DE,PTFO
ZAT     LD A,H:CP B:JR NC,NTY
        LD A,(DE)
        CP (HL):INC HL:JP NZ,ZAT
        LD (OTN+1),HL
MZMD    INC DE
        LD A,(DE):OR A:RET Z
        CP (HL):JR NZ,ZA
        INC HL
        JP MZMD
NTY     LD A,1:OR A
        RET
PTFO    DB "ProTracker 3.",0
VORT    DB "Vortex Tracker II 1.",0
TFMF    DB "TFMcom1.",0

TRY1A   LD HL,LOBU,DE,VORT;          VTX
        CALL ZATA:JP NZ,TRY2
        LD A,1,(VTMD),A
        LD DE,VORT
TSPT3   LD HL,(OTN+1)
        PUSH HL
        LD BC,52:ADD HL,BC
        CALL ZATA:LD DE,(OTN+1)
        POP HL:LD (OTN+1),HL
AYPT3   JP NZ,OTN
        EX DE,HL
        DEC HL

        PUSH HL
        CALL NP8
        LD HL,LOBU,DE,#F000,BC,#1000
        LDIR

        LD HL,NP8,(LAG+1),HL
        LD HL,#C000+24,BC,VTLN
        CALL GETPL
        LD HL,NP1,(LAG+1),HL

        LD HL,#F000,DE,LOBU,BC,#1000
        LDIR
        POP HL

        EXX:LD DE,VTDL:EXX
        CALL ASS

        CALL INSTM
        LD A,1,(TSMZ),A,(TSFG),A
        LD HL,#C005,(CTOL2+1),HL

        CALL NP6
        JP OTN
ASS     LD B,24
CSS     PUSH BC
        CALL NP6
        LD DE,SECBU,BC,#0200:LDIR
        CALL NP8
        EXX:LD HL,SECBU,BC,#0200:LDIR
        EXX
        POP BC
        DJNZ CSS
        RET

TRY2    LD HL,LOBU,DE,TFMF;          TFC
        CALL ZATA:JP NZ,TRY2A

        LD A,2,(STA),A

        PUSH HL
        LD HL,(DADE),DE,LOBU
        ADD HL,DE
        POP DE
        OR A:SBC HL,DE
        EX DE,HL
        LD A,D:CP #38:JP NC,NEmUZ

        LD B,6
        LD A,(HL):INC HL
        CP "0":JP C,NEmUZ
        LD A,(HL)
        CP 50:JR Z,FFM
        CP 60:JP NZ,NEmUZ

FFM     INC HL,HL
        LD A,(HL):CP #38:JP NC,NEmUZ
        DJNZ FFM

        LD A,3,(STA),A
        LD A,(TSFM):OR A:JP Z,NEmUZ
        LD (TRIG),A

        LD HL,(OTN+1)
        DEC HL
        LD DE,LOBU,BC,#4000-FMPL
        LDIR

        LD DE,FMDL
        CALL GETMZ

        LD HL,#C000+20,BC,FMLN
        CALL GETPL

        LD HL,FMDL+#22
        LD A,(FMDL+8)
        CP "1":JR Z,$+5:LD HL,FMDL+#32

        LD DE,GTPR
        LD B,32:CALL TFDFLL
        LD B,32:CALL TFDFLL
        LD A,5,(FMMZ),A
        JP LUZZ+2

TFDFLL  LD A,(HL):OR A:JR Z,$+3:INC HL
        LD (DE),A:INC DE
        DJNZ TFDFLL
        INC HL
        RET

TRY2A   LD IX,LOBU;                  STC
        LD A,(IX+#00):CP #CD:JR NZ,AST
        LD A,(IX+#01):CP #52:JR NZ,AST
        LD A,(IX+#02):CP #00:JR NZ,AST
        LD DE,#06E9
        JR STwPL
AST     LD A,(IX+#00):CP #21:JR NZ,BST
        LD A,(IX+#03):CP #C3:JR NZ,BST
        LD A,(IX+#06):CP #C3:JR NZ,BST
        LD A,(IX+#0A):CP #7E:JR NZ,BST
        LD DE,#043C
STwPL   ADD IX,DE

BST     LD A,(IX)
        OR A:JP Z,TRY3
        CP 24:JP NC,TRY3

        LD A,(IX+6):CP #28:JP NC,TRY3
        LD A,(IX+4):CP #20:JP NC,TRY3
        LD A,(IX+2):CP #10:JP NC,TRY3

        PUSH IX
        POP HL
        LD DE,7:ADD HL,DE
        LD B,18
SFT     LD A,(HL)
        CP #18:INC HL:JR C,MRK
        CP #20:JP C,TRY3
        CP #7B:JP NC,TRY3
MRK     DJNZ SFT

        PUSH IX
        POP HL
        LD E,27:ADD HL,DE
        LD A,(HL)
        OR A:JP Z,TRY3
        CP #12:JP NC,TRY3

KSA     CALL DETPT2:JR Z,TRY3

        PUSH IX
        POP HL
        LD DE,LOBU,BC,#4000-STLN
        LDIR

        LD DE,STDL
        CALL GETMZ

        LD HL,#C000+2,BC,STLN
        CALL GETPL

        LD HL,STDL+7,DE,GTPR,C,18;B=0
        LDIR
        JP LUZZ

DETPT2  LD A,(LOBU+131):INC A:JR Z,NET2
_LD HL,(LOBU+3),A,H:OR L:JR NZ,NET2

        LD HL,LOBU+3,B,32
ESAMP   LD A,(HL)
        INC HL:OR (HL):JR NZ,DAA2
        INC HL
        DJNZ ESAMP
        JR NET2

DAA2    LD D,(HL):DEC HL
        LD E,(HL)

        LD HL,(LOBU+67)
        LD BC,(LOBU+99)
        OR A:SBC HL,DE:JR C,NET2
        EX DE,HL
        XOR A:SBC HL,BC:JR C,NET2

        LD HL,LOBU+100,B,30-1
        INC HL:CP (HL):JR NZ,Daa2
        DJNZ $-4
        XOR A
        RET

Daa2    LD HL,LOBU+100
        LD A,30,B,A
DZDY    INC HL:CP (HL):JR NC,NET2
        DJNZ DZDY
        XOR A
        RET
NET2    LD A,1:OR A
        RET
TRY3    CALL DETPT2:JP NZ,TRY4;      PT2

        LD DE,PT2DL
        CALL GETMZ

        LD HL,#C000+4,BC,PT2LN
        CALL GETPL

        LD HL,PT2DL+101,DE,GTPR,C,30;B=0
        LDIR
LUZZ    LD A,6
        LD HL,GTPR,(ONEB),HL
        LD HL,GTPR+32,(TWOB),HL

        LD (CTOL+1),A
        JP MUZZ

AHHA    LD BC,HL
        LD DE,PSCDL
        ADD HL,DE
        ADD IX,DE
        EX DE,HL
        DEC IX,IX
AHH     LD A,(DE),L,A:INC DE
        LD A,(DE),H,A:DEC DE
        OR A:SBC HL,BC
        LD A,L,(DE),A:INC DE
        LD A,H,(DE),A:INC DE
        PUSH IX
        POP HL
        OR A:SBC HL,DE:JR NC,AHH
        RET

TRY4    LD HL,LOBU,DE,PSCFO;         PSC
        CALL SRHMZ:JR NZ,TRY5

        LD DE,PSCDL
        CALL GETMZ

        LD A,(PSCDL+8):CP "4":JR NC,PSC4

        LD HL,#4C,IX,(PSCDL+74)
        CALL AHHA
        LD HL,(PSCDL+74),IX,(PSCDL+69)
        CALL AHHA

PSC4    LD HL,#C000+8,BC,PSCLN
        CALL GETPL

        LD HL,PSCDL+25,DE,GTPR,C,20;B=0
        LDIR
        LD C,4
        ADD HL,BC
        LD DE,GTPR+32,C,20;B=0
        LDIR
        JP LUZZ
PSCFO   DB "PSC V1.0",0

TRY5    LD HL,LOBU,DE,FTFO;           FT
        CALL SRHMZ:JP NZ,TRY6
        LD HL,LOBU+50
        INC DE
        CALL SRHMZ:JP NZ,TRY6

        LD DE,FTDL
        CALL GETMZ

        LD HL,#C000+10,BC,FTLN
        CALL GETPL

        LD HL,FTDL+8,DE,GTPR,C,42;B=0
        LDIR
        JP LUZZ
FTFO    DB "Module: ",0
        DB ";Fast Tracker v1.",0

TRY6    LD HL,LOBU+10,DE,STPFO;      STP
        CALL SRHMZ:JP NZ,TRY7a
SUPA    LD A,(LOBU+9):OR A:JR Z,TRY8

        LD DE,STPDL
        CALL GETMZ

        LD HL,#C000+12,BC,STPLN
        CALL GETPL

        LD HL,STPDL+38,DE,GTPR,C,25;B=0
        LDIR

        JP LUZZ
STPFO   DB "KSA SOFTWARE COMPILATION OF"
        DB 0

TRY7a   LD HL,LOBU
        LD A,(HL)
        OR A:JR Z,TRY8
        CP 24:JR NC,TRY8

        LD B,4
TBS     INC HL,HL
        LD A,(HL)
        OR A:JR Z,TRY8
        CP #20:JR NC,TRY8
        DJNZ TBS
        JP SUPA

TRY8    LD HL,LOBU+1,DE,GTFO;         GT
        CALL SRHMZ:JP NZ,TRY9

        LD DE,GTDL
        CALL GETMZ

        LD HL,#C000+14,BC,GTLN
        CALL GETPL

        LD HL,GTDL+7,DE,GTPR,C,32;B=0
        LDIR
        JP LUZZ
GTFO    DB "GTR",0

TRY9    LD HL,LOBU;                  ASC
        LD A,(HL):OR A:JP Z,TRYA
        DEC A:CP #40:JP NC,TRYA
        INC HL
        LD A,(HL):CP #60:JP NC,TRYA
        INC HL

        LD BC,#0320
ASQ     INC HL
        LD A,(HL):CP C:JP NC,TRYA
        LD A,C:ADD A,#10:LD C,A
        INC HL
        DJNZ ASQ

        LD A,(HL):CP #80:JP NC,TRYA

        LD HL,(LOBU+2)
        LD DE,LOBU:ADD HL,DE

        LD C,(HL):INC HL
        LD B,(HL):INC HL
        LD E,(HL):INC HL
        LD D,(HL)
        EX DE,HL
        OR A:SBC HL,BC:JP C,TRYA

        LD DE,ASCDL
        CALL GETMZ

        LD HL,#C000+16,BC,ASCLN
        CALL GETPL

        LD HL,ASCDL,BC,128
TRB     LD A,B:OR C:JR Z,TRABL
        LD DE,ASCFO
        LD A,(DE)
        CPIR:JR NZ,TRABL
SRCT    INC DE
        LD A,(DE):OR A:JR Z,TRABL+3
        CP (HL):JR NZ,TRB
        INC HL
        JR SRCT
TRABL   LD HL,BELY
        LD DE,GTPR,BC,20
        LDIR
        LD C,4
        ADD HL,BC
        LD DE,GTPR+32,C,20;B=0
        LDIR
        JP LUZZ
ASCFO   DB "ASM COMPILATION OF ",0

TRYA    LD HL,LOBU+1;                FLS
        LD B,64
PY      LD A,(HL):INC HL,HL
        CP #60:JR C,PYC
        DJNZ PY
PYC     LD A,B:CP 64-4:JR NC,TRYB
        LD A,(HL):CP #60:JR C,TRYB

        LD HL,(LOBU)
        LD DE,(LOBU+2)
        SBC HL,DE:JR C,TRYB

        LD DE,FLSDL
        CALL GETMZ

        LD HL,#C000+26,BC,FLSLN
        CALL GETPL
        JP LUZZ

TRYB    LD HL,LOBU,DE,FXFO;          FXM
        CALL SRHMZ:JR NZ,TRYC

        INC HL
        LD A,(HL):CP #60:JR C,TRYC

AYFXM   LD DE,FXDL
        CALL GETMZ

        LD HL,#C000+2,BC,FXLN
        CALL GETPL2
        JP LUZZ
FXFO    DB "FXSM",0

TRYC    LD HL,LOBU;                  PT1
        LD A,(HL):CP 24:JR NC,TRYD
.3      INC HL
        LD A,(HL):INC HL
        OR (HL):JR NZ,TRYD

        LD HL,LOBU+69,B,30-1
BHG     LD A,(HL):INC HL
        CP #20:JR C,TRYD
        DJNZ BHG

AYPT1   LD DE,PT1DL
        CALL GETMZ

        LD HL,#C000+4,BC,PT1LN
        CALL GETPL2

        LD HL,PT1DL+69,DE,GTPR,C,30:LDIR
        JP LUZZ

TRYD    CALL NP6;                    SQT
        CALL SQTIDEN:JP NZ,NEmUZ

        LD HL,(DADE)
        LD DE,(LOBU),(DAR+1),DE
        SBC HL,DE:JR C,NTS
        LD A,H:CP 3
AYSQT   JR C,NTS

        CALL NP8
        LD HL,LOBU,DE,#E000,BC,#2000
        PUSH HL,DE,BC
        LDIR
        CALL GSQT,NP8
        POP BC,HL,DE
        LDIR
        CALL NP6

DAR     LD HL,0,DE,LOBU
        ADD HL,DE
        LD BC,#4000-SQLN
        LDIR

        CALL SQTIDEN:JR NZ,NTS+3
        LD HL,LOBU
        EXX:LD DE,SQDL:EXX
        CALL ASS

        LD HL,NP8,(LAG+1),HL
        LD HL,#C000+18,BC,SQLN
        CALL GETPL
        LD HL,NP1,(LAG+1),HL

        CALL INSTM
        LD A,1,(TSMZ),A,(TSFG),A
        LD HL,#C064,(CTOL2+1),HL
        JR NTS+3

NTS     CALL GSQT,NP1

        LD A,#64
        JP LUZZ+2

GSQT    LD DE,SQDL
        CALL GETMZ

        LD HL,#C000+18,BC,SQLN
        JP GETPL

SRHMZ   LD A,(DE):OR A:RET Z
        CP (HL):RET NZ
        INC HL,DE
        JR SRHMZ


GETPL2  CALL NPe:JR $+2+3
GETPL   CALL STN
        LD A,(HL):INC HL
        LD H,(HL),L,A
        LD DE,LOBU
        PUSH DE,BC
        DI
        CALL #C000;!
        EI
LAG     CALL NP1
        POP BC,HL
        LD DE,#C000
        LDIR
        RET

GETMZ   CALL NP1
        LD HL,LOBU,BC,#2000
        PUSH HL
        LDIR
        LD (DAHL),DE
        CALL NP6
        POP DE
        LD HL,#C000,BC,#1C00
        PUSH BC
        LDIR
        CALL NP1
        POP BC
        LD HL,LOBU,DE,(DAHL)
        LDIR
        RET
;---------------------------------------
NOSQT   LD A,1:OR A
        RET
;IDENTIF
SQTIDEN LD IX,LOBU
        LD A,(IX+#00):CP #3E:JR NZ,NOPLR
        LD A,(IX+#02):CP #32:JR NZ,NOPLR
        LD A,(IX+#05):CP #32:JR NZ,NOPLR
        LD A,(IX+#08):CP #32:JR NZ,NOPLR
        LD A,(IX+#0B):CP #01:JR NZ,NOPLR
        LD HL,LOBU+SQLN
        LD DE,LOBU
        LD BC,#4000-SQLN
        LDIR

NOPLR   LD DE,(LOBU)
        LD A,D:CP #40:JR NC,NOSQT
        OR E:JR Z,NOSQT

        LD HL,LOBU-1:ADD HL,DE

        LD A,(HL):CP 9:JR NC,NOSQT
        DEC HL
        LD B,6
SQ1     LD A,(HL):OR A:JR NZ,NOSQT
        DEC HL
        DJNZ SQ1
        LD A,(HL)
        OR A:JR Z,NOSQT
        CP #21:JR NC,NOSQT

        XOR A
        RET
;---------------------------------------
ANPR    LD IX,MNWND
_LD HL,SLINE,DE,#0201,BC,40,A,3:CALL WLD
_LD HL,VZL1,DE,#0901,BC,40,A,3:CALL WLD
_LD HL,VZL2,DE,#0A01,BC,40,A,3:CALL WLD
        RET
;-------
FRQSRL  LD HL,VZL1,DE,40,B,40
JAJA    LD A,(HL)
        OR A:JR Z,AJA
        DEC (HL)
A_A     INC HL
        DJNZ JAJA
        RET
AJA     ADD HL,DE
        LD A,(HL)
        OR A:JR Z,$+3:DEC (HL)
        SBC HL,DE
        JR A_A
;-------
ANALYZE CALL FRQSRL

        LD A,(TSMZ):OR A:JR Z,LYZA
        LD BC,#FFFD,A,#FE:OUT A
        CALL LYZA
        LD BC,#FFFD,A,#FF:OUT A

LYZA    LD A,1:CALL REDR:LD (ROR+1),HL
        LD A,8,(ROR),A
        LD A,3:CALL REDR:LD (ROR+4),HL
        LD A,9,(ROR+3),A
        LD A,5:CALL REDR:LD (ROR+7),HL
        LD A,10,(ROR+6),A

PAw     LD DE,ROR+1,A,3
PAW     DEC A:JR Z,ESO
        EX DE,HL
        LD (VLHL),HL
        LD E,(HL):INC HL
        LD D,(HL):INC HL,HL
        LD (VLDE),HL
        LD C,(HL):INC HL
        LD B,(HL):DEC HL

        EX DE,HL
        OR A:SBC HL,BC:JR C,PAW,Z,PAW
        CALL SWAP
        JR PAw

ESO     LD HL,ANALYZR,(VLHL),HL
        LD A,1,(VLA),A

        LD BC,(ROR+1)
        LD A,(ROR),(CHNL),A:CALL CHANL

        LD BC,(ROR+4)
        LD A,(ROR+3),(CHNL),A:CALL CHANL

        LD BC,(ROR+7)
        LD A,(ROR+6),(CHNL),A
        JP CHANL

SWAP    LD HL,(VLHL),DE,(VLDE)
        DEC HL,DE
        LD B,3
SWP     LD C,(HL),A,(DE),(HL),A
        LD A,C,(DE),A
        INC HL,DE
        DJNZ SWP
        RET
CHNL    NOP
VLA     NOP
VLHL    DS 2
VLDE    DS 2
ROR     DS 9

CHANL   LD A,B:OR C:JR Z,$+3:DEC BC
        LD HL,(VLHL),A,(VLA)
        DEC A
PYZDEK  INC A
        LD E,(HL):INC HL
        LD D,(HL):INC HL
        EX DE,HL
        SBC HL,BC
        EX DE,HL
        JP C,PYZDEK

DETAN   LD (VLHL),HL,(VLA),A
        EXA:LD A,(CHNL)
;-------
ANI     LD BC,#FFFD
        OUT A
        IN A
ANNI    AND %00001111:RET Z
        EXA:LD B,0,C,A
        EXA

        LD HL,VZL1:ADD HL,BC:LD C,40
        CP 9:JR C,TYN
        SUB 8
        LD (HL),A
        LD A,8
TyN     ADD HL,BC
        LD (HL),A
        RET
TYN     LD (HL),0
        JR TyN
;-------
REDR    LD BC,#FFFD
        OUT A
        EXA:IN A:AND 15:LD H,A:EXA
        DEC A
        OUT A
        EXA:IN A:LD L,A:EXA
        RET
;-------
ANFNT   LD A,#FF:EXA:XOR A:CALL WLD
        LD HL,#C000,DE,#C800,BC,8*20
        LDIR

        LD HL,#C000,DE,#C001,BC,8*9-1
        LD (HL),L
        LDIR

        LD HL,#C000+8+7,DE,8
        LD C,%01111110
        LD A,1
AFN     PUSH HL
        LD B,A,(HL),C:DEC HL:DJNZ $-2
        POP HL
        ADD HL,DE
        INC A:CP 9:JR C,AFN
;-------
_LD HL,PBRMK,DE,#C000+8*9,BC,8*3:LDIR
        LD HL,DE,BC,0-8:ADD HL,BC
        LD BC,8*8:LDIR

        LD A,%10000000
        LD B,8,HL,#C000+8*12+3,DE,8-1
BUR     LD C,A
        OR (HL):LD (HL),A:INC L
        LD A,C
        OR (HL):LD (HL),A
        LD A,C
        ADD HL,DE
        SCF:RRA
        DJNZ BUR
        RET

DEFNT   LD A,#FF:EXA:XOR A:CALL WLD
        LD HL,#C800,DE,#C000,BC,8*20
        LDIR
        RET
;-------
ANALYZR DW 20,25
        DW 28,33,40,45,50
        DW 56,67,79,89,100
        DW 112,126,141,159,178,200
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        DW 65535

PBRMK   DB %00000000
        DB %00000111
        DB %00000110
        DB %00000110
        DB %00000110
        DB %00000110
        DB %00000111
        DB %00000000

        DB %00000000
        DB %11100000
        DB %01100000
        DB %01100000
        DB %01100000
        DB %01100000
        DB %11100000
        DB %00000000

        DB %00000000
        DB %11111111
        DB %00000000
        DB %10101010
        DB %01010101
        DB %00000000
        DB %11111111
        DB %00000000
;---------------------------------------
ATIT    LD A,(TSFG):OR A:JR NZ,NEPL
        LD BC,(MUZPL)
        LD A,(GXMO):OR C:JR Z,NEPL
        LD A,C:OR A:JR Z,NEPL
        LD A,B:OR A:JR NZ,NEPL

        LD HL,(TME):INC HL:LD (TME),HL
        LD HL,(TMM):INC HL:LD (TMM),HL

        CALL NP1
CTOL    CALL PLAYM
        LD A,(TSMZ):OR A:JR Z,NEPL
        CP 1:JR NZ,NEPL
        CALL NP8
        LD BC,#FFFD,A,#FE:OUT A
CTOL2   CALL PLAYM
        LD BC,#FFFD,A,#FF:OUT A
NEPL    RET
;---------------------------------------
CLOCK   LD HL,(TMM),DE,CLOK
        LD BC,50*60,A,255
        OR A:INC A:SBC HL,BC:JP NC,$-3
        LD (DE),A:INC DE
        ADD HL,BC
        LD BC,50,A,255
        OR A:INC A:SBC HL,BC:JP NC,$-3
        LD (DE),A:INC DE
        ADD HL,BC
        LD A,L:ADD A,A
        LD (DE),A

        LD HL,CLK
_LD A,(CLOK):CALL DEC0:LD (HL),C
        INC HL:LD (HL),A:INC HL,HL
_LD A,(CLOK+1):CALL DEC0:LD (HL),C
        INC HL:LD (HL),A:INC HL,HL
_LD A,(CLOK+2):CALL DEC0:LD (HL),C
        INC HL:LD (HL),A

_LD IX,MNWND
_LD HL,CLK,DE,#0120,BC,8,A,3:CALL WLD
        RET

DEC0    LD C,#2F
        INC C:SUB 10:JR NC,$-3
        ADD A,10+#30
        RET
;---------------------------------------
PBLNE   LD A,(NOWT+1)
        CP 2:JR Z,PBVT
        CP 4:JR C,PBFCLR

PBVT    LD A,(P_NU):DEC A:CALL Z,PBCLR
        INC A
        LD H,0,L,A
.4      SLA L:RL H
        PUSH HL;*16
        SLA L:RL H
        PUSH HL;*32
.3      SLA L:RL H
;               *256
.2      POP BC:ADD HL,BC

PBSTP   LD DE,0
        LD A,D:OR E:JR Z,PBCLR
        LD BC,0-1
        OR A:INC BC:SBC HL,DE:JP NC,$-3

        LD HL,304
        OR A:SBC HL,BC
        JR NC,$+5:LD BC,304

        LD HL,PBLINE
        LD A,C
.3      SRL B:RR C
        JR Z,PBL
        LD B,C
FLPB    LD (HL),19:INC HL:DJNZ FLPB

PBL     AND 7:RET Z
        LD DE,PBTBL-1
        LD B,A:INC DE:DJNZ $-1
        LD A,(DE),(HL),A
        RET

PBFCLR  LD HL,PBLINE
        PUSH AF
        LD B,38,A,11
CFPB    LD (HL),A:INC HL:DJNZ CFPB
        POP AF
        RET

PBCLR   LD HL,PBLINE
        LD B,38
CLPB    LD (HL),11:INC HL:DJNZ CLPB
        RET

PBTBL   DB 12,13,14,15,16,17,18

PBCLC   CALL NP1
        LD A,(NOWT+1)
        CP 14:JP Z,PT1
        CP 13:JP Z,PB11
        CP 12:JP Z,PB10
        CP 11:JP Z,PB9
        CP 10:JR Z,PB8
        CP 9:JR Z,PB7
        CP 8:JR Z,PB6
        CP 7:JR Z,PB5
        CP 6:JR Z,PB4
        CP 5:JR Z,PB3
        CP 4:JR Z,GTR
        CP 2:JR Z,FLS
        RET
;-------
FLS     LD HL,(FLSDL),DE,1:INC HL
        XOR A
        JR H0H-2

PB3     LD A,(VTDL+101)
        JR PB

PB4     LD HL,FTDL+212
        LD DE,2
        JR H00

PB5     LD HL,(PSCDL+71)
        LD DE,PSCDL+1:ADD HL,DE

        LD DE,8
H00     LD A,#FF
        LD B,0
H0H     CP (HL):JR Z,OH0
        ADD HL,DE
        DJNZ H0H
OH0     XOR A
        SUB B
        JR PB

PB6     LD HL,(SQDL+8),DE,6
        LD B,0
HoH     LD A,(HL):INC HL
        OR (HL)
        JR Z,$+5:ADD HL,DE:DJNZ HoH
        XOR A
        SUB B
        DEC A
.2      ADD A,A
        JR PB

PB7     LD IX,STPDL,E,0
        JR PB78
PB8     LD IX,STDL,E,1
PB78    LD C,(IX+1)
        LD B,(IX+2)
        ADD IX,BC
        LD A,(IX):ADD A,E
        JR PB

PB9     LD A,(ASCDL+8):DEC A
        JR PB

GTR     LD A,(GTDL+293)
        JR PB

PB10    LD A,(PT2DL+1)
        JR PB

PB11    LD A,(MMODUL+101)
PB      LD (PBSTP+1),A
        RET

PT1     LD A,(PT1DL+1)
        JR PB
;---------------------------------------
PMACH   ;LD A,(P_CH):OR A:RET Z
;LD A,(BLIH):DEC A:JR NZ,SKSTC
;LD A,(P_ST):OR A:JP Z,NXM

SKSTC   LD HL,(MUZPL)
        LD A,L:OR A:RET Z
        LD A,H:OR A:JR NZ,NNX
        LD A,(PL0):OR A:RET Z
        CALL NP1
        LD A,(NOWT+1)
        CP 14:JP Z,PT1_A
        CP 13:JR Z,PT3_A
        CP 12:JR Z,PT2_A
        CP 11:JP Z,ASC_A
        CP 10:JP Z,STC_A
        CP 9:JP Z,STP_A
        CP 8:JP Z,SQT_A
        CP 7:JP Z,PSC_A
        CP 6:JR Z,FTC_A
        CP 5:JR Z,VTX_A
        CP 4:JP Z,GTR_A
        CP 3:JP Z,TFC_A
        CP 2:JP Z,FLS_A
;CP 1:JP Z,FXM_A
NNX     XOR A
        RET
BACKZ   LD HL,(P_SH)
        OR A:SBC HL,DE:JR Z,BCZ
        LD HL,0,(TME),HL
        LD HL,P_NU:INC (HL)

        LD A,(HL)
        LD HL,PL2+2:CALL NORK
;HL,PL2,DE,#C826
;B,2,A,7:CALL STRPR

        CALL PBLNE

BCZ     LD A,(TME+1):CP 5:JR C,NNX
NXM     LD A,1:OR A
        RET

PT3_A   LD HL,(#C98B)
        CALL PKZ:JR C,NXM
        JR BACKZ
PT2_A   LD HL,(#C2AB)
        CALL PKZ:JR C,NXM
        JR BACKZ
SQT_A   LD HL,(#C08B+#34)
        CALL PKZ:JR C,NXM
        JR BACKZ
PSC_A   LD HL,(#C0B6)
        CALL PKZ:JR C,NXM
        JR BACKZ
FTC_A   LD HL,(#C0DA)
        CALL PKZ:JR C,NXM
        JR BACKZ
VTX_A   LD HL,(#C00B)
        CALL PKZ:JR C,NXM
LAZ     JR BACKZ

ASC_A   LD HL,(#C17C)
Laa     CALL PKz:JR C,NXM
        JR LAZ
STC_A   LD HL,(#C0A0)
        JR Laa
STP_A   LD HL,(#C675):INC L
        JR Laa

TFC_A   LD A,(#C008)
        OR A:JR NZ,NXM
        JP NNX

FLS_A   LD HL,(#C299)
        JR Laa
GTR_A   LD HL,(#C23C+1):INC L
        JR Laa

;FXM_A HL,(#C109),DE,(P_SH)
;(P_SH),HL
;A,(#C009):OR A:JP NZ,NXM
;JP BACKZ

PT1_A   LD HL,(#C318+6)
        JR Laa
;-------
PKz     LD H,0
PKZ     LD DE,(P_SH),(P_SH),HL
        OR A:SBC HL,DE
        RET
P_SH    DW 0
P_NU    DW 0
P_CH    NOP

ADiH    DW 0

BLIH    NOP ;0-STOP,1-ALL,2-ONE
;---------------------------------------
GEDPL   LD A,15:JP WLD
TURBO   LD B,0,A,14:JP WLD
TURBD   LD B,#FF,A,14:JP WLD
NORK    EXA:LD A,10:JP WLD
LOAD512 LD A,48:JP WLD

NPe     LD A,3:EXA:XOR A:JP WLD
STN     LD A,2:EXA:XOR A:JP WLD

NP6     LD A,1:EXA:XOR A:JP WLD;BUFER
NP1     LD A,4:EXA:XOR A:JP WLD;MODULE1
NP8     LD A,5:EXA:XOR A:JP WLD;MODULE2
;---------------------------------------
TFMDET  XOR A:LD (DETKA),A

        LD BC,#FFFD,A,%11111000:OUT A
        EI:HALT
        XOR A:OUT A
        EI:HALT
        LD B,#BF:OUT B
        EI:HALT
        LD B,#FF:INF
        LD A,1:JP P,FM_EN
        XOR A
FM_EN   LD (TSFM),A
;-------
AYOFF   LD BC,#FFFD,A,#FE:OUT A
        PUSH BC
        CALL AYFF
        POP BC
        LD A,#FF:OUT A

AYFF    LD BC,#FFFD
        LD E,B,D,8
        XOR A
        OUT D
        LD B,#BF:OUT A
        LD B,E
        INC D:OUT D
        LD B,#BF:OUT A
        LD B,E
        INC D:OUT D
        LD B,#BF:OUT A
        RET
;---------------------------------------
MNWND   DB 0,0
        DB 19,9;     X,Y
        DB 42,12;    W,H
        DB %01111111;PAPER+INK
        DB 0
        DW #0000;    BUFFER
        DB 3,6;      LINES
;---------------------------------------
PTI     DB #21,#C6:DW PLIE;PT1
        DB #21,#E1:DW PLI1;PT3
        DB #21,#0C:DW PLI2;PT2
        DB #18,#0A:DW PLI4;ASC
        DB #21,#3C:DW PLI5;STC
        DB #21,#68:DW PLI6;STP
        DB #3E,#08:DW PLI7;SQT
        DB #21,#AB:DW PLI8;PSC
        DB #21,#65:DW PLI9;FTC
        DB #21,#6E:DW PLI3;VTX
        DB #21,#9A:DW PLIA;GTR
        DB #21,#3D:DW PLIB;TFC
        DB #21,#E6:DW PLIC;FLS
        DB #C3,#09:DW PLID;FXM
PTIX    DW PLIX
NOWT    DW 0
;-------
PLI1    DB "Pro Tracker v3.x",0
PLI2    DB "Pro Tracker 2",0
PLI3    DB "Vortex Tracker II",0
PLI4    DB "ASC Sound Master",0
PLI5    DB "Sound Tracker",0
PLI6    DB "Sound Tracker Pro",0
PLI7    DB "SQ Tracker",0
PLI8    DB "Pro Sound Creator v1.0x",0
PLI9    DB "Fast Tracker v1.00",0
PLIA    DB "Global Tracker",0
PLIB    DB "TFM Compiler v1.x",0
PLIC    DB "FLASH Tracker",0
PLID    DB "Fuxoft AY Language",0
PLIE    DB "Pro Tracker 1",0
PLIX    DB 32,0
;---------------------------------------
PLT0    DB " Editor:"
PL0     DB "                          "
PLT1    DB "   Mode:"
PL1     DB "AY track"
PLT2    DB "Positio:"
PL2     DB "#00"

CLOK    DB 0,0,0

SLINE   DB 9
PBLINE  DS 38,32
        DB 10
CLK     DB "00:00.00"

BELY    DS 64,32
MZNM    DS 32
MZN2    DS 32
GTPR    DS 64

TXT0    DB "Wild Player:"
TXT3    DB "Plug-in v0.4"
TXT1    DB "   Name:"
TXT2    DB " Author:"

TME     DS 2
TMM     DS 2

ESTAT   NOP
DETKA   DB 1

P_ST    NOP

TSFM    NOP
TRIG    NOP

GXMO    NOP
STA     NOP
FMMZ    NOP
TSMZ    NOP
TSFG    NOP
ZZMZ    NOP
VTMD    NOP

MUZPL   NOP
PAUS    NOP
ONEB    DS 2
TWOB    DS 2

DAHL    DS 2
DADE    DS 2

HRFO    DB "hr2",0
;-------
DEHR21  INCB "DEHR21"
;-------
VZL1    DS 40,8
VZL2    DS 40,8
;---------------------------------------
        ORG #8200
        INCB "PLAYERZ7"
        ORG #8200+#4000
        INCB "PLAYERS8"
;---------------------------------------
STLN    EQU 1084
PT2LN   EQU 2459
PT3LN   EQU #0BE1
PSCLN   EQU 2987
FTLN    EQU 2917
STPLN   EQU 1896
GTLN    EQU 1690
ASCLN   EQU 1458
SQLN    EQU 1348;1296
FMLN    EQU #073D;43
VTLN    EQU #0651
FLSLN   EQU #05E6
FXLN    EQU #0511
PT1LN   EQU #06C6
;-------
MMODUL  EQU #C000+PT3PL
PT2DL   EQU #C000+PT2PL
STPDL   EQU #C000+STPLN
STDL    EQU #C000+STLN
PSCDL   EQU #C000+PSCLN
FTDL    EQU #C000+FTLN
GTDL    EQU #C000+GTLN
ASCDL   EQU #C000+ASCLN
SQDL    EQU #C000+SQLN
FMDL    EQU #C000+FMLN
VTDL    EQU #C000+VTPL
FLSDL   EQU #C000+FLSLN
FXDL    EQU #C000+FXLN
PT1DL   EQU #C000+PT1LN
;---------------------------------------
