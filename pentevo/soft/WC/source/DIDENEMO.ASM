;IDE Nemo Driver
;(C) BUDDER/MGN 2015
;---------------------------------------
        ORG #3800,$
;-------
STATUS  EQU #00AF

CMD     EQU #F0;Command/State
DRV     EQU #FFD0;Drive/Head
CYLH    EQU #B0;CYL High
CYLL    EQU #90;CYL Low
SECR    EQU #70;SEC
BLKS    EQU #50;Counter
ERRO    EQU #30;Error/Ext
DATH    EQU #11;Data High
DATL    EQU #10;Data Low

LOBU    EQU #3000
;---------------------------------------
        JP SELDEV
        JP NEMOini
        JP REINI

        JP XPOZI
        JP PROZ

        JP RDDSE
        JP SDDSE

        JP RDD256

.16     DS 3
;---------------------------------------
NSDC    NOP ;\ SEC number in CLUS
EOC     NOP ;/ EndOfChain (Flag)

ABT     NOP

BZN     DB 4
NR0     DW 4;number of Sectors

CAHL    DS 2
CADE    DS 2

LSTSE   DS 4

REZDE   DS 2

PR      DS 4

CLHL    DS 2
CLDE    DS 2

LLHL    DS 4

LTHL    DS 2;LAST
LTDE    DS 2
;------Entry Pattern:-------------------
ENTRY   DS 11
EFLG    DB 0,0
        DB #00;ms
        DW #0000:DW #0000;time,date
        DW #0000;acc date
CLSDE   DS 2
        DW #0000:DW #0000;time,date
CLSHL   DS 2
SIZIK   DS 4
        NOP
;---------------------------------------
BREZS   DS 2;+14          FAT PARAMETERS
FSINF   DS 4;[+48(2)]+[ADDTOP]

BFATS   NOP
BFTSZ   DS 4
BSECPC  DS 2;USE 1
BROOTC  DS 4

FSTFRC  DW 2,0

ADDTOP  DS 4

SFAT    DS 2
SDFAT   DS 4

CUHL    DS 2
CUDE    DS 2

NXDE    DS 2
NXHL    DS 2

LDHL    DS 2;Address

COUNT   NOP
DUHL    DS 2
DUDE    DS 2

DUBA    NOP
UUHL    DS 2
BUHL    DS 2
GARY    DS 2;AAA
CLCNT   DS 2;counter
FCTS    DS 4
BUTS    DS 4

LSTCAT  DS 4;Active DIR
RECCAT  DS 4;RECYCLED BIN DIR

;---------------------------------------
;INTERNAL VARIABLES:
BLKNUM  DS 4
DRVRE   NOP
;---------------------------------------
XPOZI   LD (LTHL),HL,(LTDE),DE
PROZ    LD A,H,H,D,D,E,E,A
;DE,cyl H,head L,sec

        LD (BLKNUM),HL
        LD (BLKNUM+2),DE
REINI   RET

REREG   PUSH HL,DE
        LD HL,(BLKNUM)
        LD DE,(BLKNUM+2)

        LD A,H:AND %00001111:LD H,A
        LD A,(DRVRE)
        OR H
        LD BC,DRV:OUT A
        LD BC,SECR:OUT L
        LD BC,CYLH:OUT D
        LD BC,CYLL:OUT E
        POP DE,HL
        RET

;---------------------------------------
RPOZ    LD BC,DRV:IN A:AND #0F
        LD H,A
        LD BC,SECR:IN L
        LD BC,CYLH:IN D
        LD BC,CYLL:IN E
        RET

;---------------------------------------
;i:HL - Address
;   A - Sectors

RDDSE   EXA:CALL DRDY
        EXA
        LD BC,BLKS:OUT A
        EXA
        CALL REREG
        LD A,#20:CALL COMD
        EXA
RDH1    EXA
        CALL WAITDRQ
        CALL READS
        CALL READY
        EXA:DEC A:JR NZ,RDH1
        RET

;---------------------------------------
SDDSE   EXA:CALL DRDY
        EXA
        LD BC,BLKS:OUT A
        EXA
        CALL REREG
        LD A,#30:CALL COMD
        EXA
SDH1    EXA
        CALL WAITDRQ
        CALL SAVDS
        CALL READY
        EXA:DEC A:JR NZ,SDH1
        RET

;---------------------------------------

COMM    LD BC,CMD:OUT A:RET
COMD    LD BC,CMD:OUT A
READY   CALL LOLL:RLCA:RET NC
        JR READY

LOLL    LD BC,CMD:IN A:RET

WAITDRQ CALL LOLL:AND 8:RET NZ
        JR WAITDRQ

DRDY    CALL LOLL:RLCA:JR C,DRDY
        LD BC,DRV,A,(DRVRE):OUT A
DRD     CALL LOLL
        AND %11000000
        CP %01000000:RET Z
        JR DRD

ERROR_7 CALL LOLL:RRCA:RET

YDET    CALL LOLL:BIT 7,A:RET Z
        EI:HALT
        DEC HL:LD A,H:OR L:JR NZ,YDET
        INC A
        RET

DRQWT   CALL LOLL:AND 8:RET NZ
        EI:HALT
        DEC HL:LD A,H:OR L:JR NZ,DRQWT
        RET

SELDEV  OR A:JR NZ,SEL_SLA
SEL_MAS LD A,#E0:JR SEL_SLA+2
SEL_SLA LD A,#F0
        LD (DRVRE),A
        LD BC,DRV:OUT A
        RET
SET_CHA LD A,(DRVRE)
        LD BC,DRV:OUT A
        RET

;---------------------------------------
NEMOini CALL SET_CHA
        LD A,#08:CALL COMM

        LD HL,256:CALL YDET:JR NZ,RU

        LD DE,0
        LD HL,2
        CALL XPOZI,REREG
        LD A,#EC:CALL COMM

        LD HL,256:CALL YDET:JR NZ,RU
        LD HL,32:CALL DRQWT:JR Z,RU
        CALL RPOZ
        PUSH HL,DE:LD HL,LOBU:CALL READS
        POP DE,HL

        LD A,D:OR E,H:JR NZ,RU
        LD A,L:CP 2:JR Z,KRU

RU      LD A,1:OR A
        RET
;-------
KRU     XOR A
        RET

;---------------------------------------
;READ 512b from IDE Device BUFFER
READS   LD BC,STATUS:IN A
        AND %00000011:JR NZ,OLDRDS
        LD A,L:OR A:JR NZ,OLDRDS
        BIT 0,H:JR NZ,OLDRDS

        LD BC,#4000
        LD A,H
        SUB B:JR C,MAK:INC C
        SUB B:JR C,MAK:INC C
        SUB B:JR C,MAK:INC C
        SUB B
MAK     ADD A,B:LD D,A
        LD B,#60,A,(BC)

        LD BC,STS:INF:JP M,$-2

        LD B,DMADX[:OUT A
        DEC B:OUT D
        DEC B:OUT L

        LD B,DMA_T[:XOR A:OUT A
        LD B,DMA_N[:DEC A:OUT A

        LD B,DMA_C[,A,%01000011:OUT A
        LD DE,512:ADD HL,DE
        INF:JP M,$-2
        RET

OLDRDS  LD E,DATL]
        LD D,DATH]
        LD A,#20
RE1
.8      LD C,E:INI:LD C,D:INI
        DEC A:JP NZ,RE1
        RET

;---------------------------------------
;SAVE 512b to IDE Device BUFFER
SAVDS   LD BC,STATUS:IN A
        AND %00000011:JR NZ,OLDSVS
        LD A,L:OR A:JR NZ,OLDSVS
        BIT 0,H:JR NZ,OLDSVS

        LD BC,#4000
        LD A,H
        SUB B:JR C,MA3:INC C
        SUB B:JR C,MA3:INC C
        SUB B:JR C,MA3:INC C
        SUB B
MA3     ADD A,B:LD D,A
        LD B,#60,A,(BC)

        LD BC,STS:INF:JP M,$-2

        LD B,DMASX[:OUT A
        DEC B:OUT D
        DEC B:OUT L

        LD B,DMA_T[:XOR A:OUT A
        LD B,DMA_N[:DEC A:OUT A

        LD B,DMA_C[,A,%11000011:OUT A
        LD DE,512:ADD HL,DE
        INF:JP M,$-2
        RET

OLDSVS  LD C,DATH]
        LD A,#80
SA1     INC HL
        OUTD:DEC C:OUTI:INC C
.2      INC HL
        OUTD:DEC C:OUTI:INC C
        INC HL
        DEC A:JP NZ,SA1
        RET
;---------------------------------------
RDD256  EXA:CALL DRDY
        EXA
        LD BC,BLKS:OUT A
        EXA
        CALL REREG
        LD A,#20:CALL COMD
        EXA

RDS256  EXA
        CALL WAITDRQ
;-------
        LD BC,STATUS:IN A
        AND %00000011:JR NZ,OLDR256

        LD BC,#4000
        LD A,H
        SUB B:JR C,MA2:INC C
        SUB B:JR C,MA2:INC C
        SUB B:JR C,MA2:INC C
        SUB B
MA2     ADD A,B:LD D,A
        LD B,#60,A,(BC)

        LD BC,STS:INF:JP M,$-2

        LD B,DMADX[:OUT A
        DEC B:OUT D
        DEC B:OUT L

        LD B,DMA_T[,A,1:OUT A
        LD B,DMA_N[,A,127:OUT A

        LD B,DMA_C[,A,%01011011:OUT A
.4      INC H
        INF:JP M,$-2
;-------
ENDR256 CALL READY
        EXA:DEC A:JR NZ,RDS256
        RET
;-------
OLDR256 LD D,2
HU2     LD A,#20
        LD C,DATL]
HUD
.4      INI:INC C:INI:DEC C
        DEC A:JP NZ,HUD
        INC H
        DEC D:JR NZ,HU2
        JR ENDR256
;---------------------------------------
STS     EQU #27AF

DMASL   EQU #1AAF
DMASH   EQU #1BAF
DMASX   EQU #1CAF
DMADL   EQU #1DAF
DMADH   EQU #1EAF
DMADX   EQU #1FAF

DMA_T   EQU #28AF;0=1, 255=256
DMA_N   EQU #26AF;255=512
DMA_C   EQU #27AF;RW 1 - - - 0 0 1
;---------------------------------------
