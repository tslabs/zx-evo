;---------------------------------------
VIMG    EI:HALT
        LD HL,0
        LD (GOY),HL
        LD (GOX),HL

        CALL Vv
        LD A,%11100010,(VVmod),A
        LD D,GVvPG,E,GVvPG+9:CALL GROB

        CALL GFXLOAD:JP NZ,GED

GFXM    EI:HALT
        CALL UPPP,NZ,GUP
        CALL DWWW,NZ,GDN
        CALL RGGG,NZ,GRG
        CALL LFFF,NZ,GLF

        CALL ENKE:JR NZ,NXTFL

        CALL SPKE:JP NZ,GED
        CALL ESC:JR Z,GFXM
        JP GED
;-------
NXTFL   CALL CRDN
        JP VIEW
;-------
GUP     LD HL,(GOY),DE,GSTP
        OR A:SBC HL,DE:RET C
GGY     LD (GOY),HL
        LD (VYofL),HL
        RET
;-------
GDN     LD HL,(GOY),DE,GSTP
        ADD HL,DE
        LD DE,(GMY)
        OR A:SBC HL,DE:RET NC
        ADD HL,DE
        JR GGY
;-------
GRG     LD HL,(GOX),DE,GSTP
        ADD HL,DE
        LD DE,(GMX)
        OR A:SBC HL,DE:RET NC
        ADD HL,DE
        JR GGX
GLF     LD HL,(GOX),DE,GSTP
        OR A:SBC HL,DE:RET C
GGX     LD (GOX),HL
        LD (VXofL),HL
        RET
;-------
GFFA    LD A,1:OR A
        RET
;-------
GFXLOAD LD A,GVvPG,(GPGC),A:CALL MNGC
        XOR A:LD (EOC),A

        LD HL,LOBU
        LD B,8:CALL LOAD512

        LD A,(LOBU),(GDLA),A
        LD HL,LOBU+1
        LD A,(HL):OR A:JR Z,GFFA:INC HL
        LD A,(HL):CP 1:RET NZ
        LD HL,(LOBU+12)
        LD DE,513
        OR A:SBC HL,DE:JR NC,GFFA
        LD HL,(LOBU+14)
        OR A:SBC HL,DE:JR NC,GFFA

        LD HL,LOBU+12
        LD E,(HL):INC HL;W
        LD D,(HL):INC HL
        LD C,(HL):INC HL;H
        LD B,(HL)

        EX DE,HL
        LD (GRAB+1),HL
        LD (GRAA+1),BC
        LD DE,360:CALL GWH:LD (GMX),HL
        LD HL,BC
        LD DE,288:CALL GWH:LD (GMY),HL

        CALL PABE
        LD HL,LOBU+18,DE,(GDLA)
        ADD HL,DE:LD DE,0:CALL PALCNV
        CALL PAED

        EI:HALT
        LD A,GVvPG,(VVpag),A
        LD A,%11000010,(VVmod),A

        LD HL,LOBU+786
        LD DE,(GDLA):ADD HL,DE
        LD DE,#C000

GRAB    LD BC,0
        LDIR
        EX DE,HL
        LD A,L:OR A:JR Z,GGG
Gln     LD (HL),C:INC L:JP NZ,Gln:INC H
GGG     BIT 0,H:JR NZ,Gln
        EX DE,HL
GRAA    LD BC,0,A,B:OR C:RET Z
        DEC BC:LD (GRAA+1),BC
        LD A,D:OR A:CALL Z,GPGN:RET Z

        LD A,H:CP LOBU[+#0E:JR C,GRAB
        LD A,(EOC):CP #0F:RET Z

        PUSH HL,DE
        LD A,#02
        LD HL,LOBU+#0E00-#8000
        LD DE,LOBU-#8000

        LD BC,DMASL:OUT L
        LD B,DMASH[:OUT H
        LD B,DMASX[:OUT A
        LD B,DMADL[:OUT E
        LD B,DMADH[:OUT D
        LD B,DMADX[:OUT A

        LD B,DMA_T[:XOR A:OUT A
        LD B,DMA_N[,A,255:OUT A
        LD B,DMA_C[,A,%00000001:OUT A

        LD HL,LOBU+#0200
        LD B,7:CALL LOAD512:LD (EOC),A
        POP DE,HL

        LD A,H:SUB #0E:LD H,A
        JR GRAB

GPGN    LD A,(GPGC):INC A
        LD (GPGC),A
        CP GVvPG+16:JR NC,GPE
        CALL MNGC
        LD A,#C0:ADD A,D:LD D,A
        LD A,1:OR A
        RET
GPE     XOR A
        RET
;-------
PALCNV  EXX
        LD E,0
        EXX

        LD B,0
CNV     PUSH BC
        LD A,(HL):INC HL:CALL DEL10
        LD A,C
        EXX:LD L,A,H,E
        EXX
        LD A,(HL):INC HL:CALL DEL10
        LD A,C
        EXX:LD B,E,C,A
.5      SLA C:RL B
        ADD HL,BC
        EXX
        LD A,(HL):INC HL:CALL DEL10
        LD A,C
        EXX
.2      SLA A
        OR H:EXA:LD A,L
        EXX
        LD (DE),A:INC DE
        EXA
        LD (DE),A:INC DE
        POP BC
        DJNZ CNV
        RET

DEL10   LD BC,#0AFF
DEL     INC C
        SUB B:RET C
        JP DEL

GWH     OR A:SBC HL,DE:RET NC
        LD HL,0
        RET
;-------
GROB    EI:HALT
        LD A,D:CALL MNGC
        LD HL,0,(#C000),HL
        LD BC,DMASL:OUT L:INC L,L
        LD B,DMASH[:OUT H
        LD B,DMASX[:OUT A

        LD B,DMADL[:OUT L
        LD B,DMADH[:OUT H
        LD B,DMADX[:OUT A

        LD B,DMA_N[,A,255:OUT A
        LD B,DMA_T[,A,31:OUT A

BOB     LD B,DMA_C[,A,%01000001:OUT A
        LD B,STS[:INF:JP M,$-2
        INC D:LD A,D:CP E:JR C,BOB
        RET
;---------------------------------------
VMG     LD A,GVvPG,(GPGC),A
        LD A,TVBPG:CALL MNGC
        LD HL,#CB00,B,#25:CALL LOAD512

        LD HL,#CC00,DE,#C000

        LD A,(#CB00+4)
        CP 2:JR Z,MG2
        CP 4:JR Z,MG4
        CP 8:JP NZ,GED

        LD BC,#1800:LDIR
        LD DE,#C000+#1B00
        LD BC,#1800:LDIR
        LD DE,#C000+#1800
        LD BC,#0300:LDIR
        LD DE,#C000+#1B00+#1800
        LD BC,#0300:LDIR
        JP OCC

MG4     LD BC,#1800:LDIR
        LD DE,#C000+#1E00
        LD BC,#1800:LDIR
        LD DE,#C000+#1800
        LD BC,#0600:LDIR
        LD DE,#C000+#1E00+#1800
        LD BC,#0600:LDIR

        LD A,#1E
        LD (U1+2),A
        LD (U2+2),A
        LD A,4
        LD (U3+1),A
        LD HL,GSCGB2
        LD (U4+1),HL
        JP OCC

MG2     LD BC,#1800:LDIR
        LD DE,#C000+#2400
        LD BC,#1800:LDIR
        LD DE,#C000+#1800
        LD BC,#0C00:LDIR
        LD DE,#C000+#2400+#1800
        LD BC,#0C00:LDIR

        LD A,#24
        LD (U1+2),A
        LD (U2+2),A
        LD A,2
        LD (U3+1),A
        LD HL,GSCGB3
        LD (U4+1),HL
        JP OCC

VZAD    LD A,#1B
        LD (U1+2),A
        LD (U2+2),A
        LD A,8
        LD (U3+1),A
        LD HL,GSCGB
        LD (U4+1),HL
        RET

MGBRD   LD A,(#CB00+5):AND %00000111
        LD C,A
        LD A,(#CB00+6):AND %00000111
.4      SLA A
        OR C

        LD BC,BORDER:OUT A
        RET

GSCGB2  PUSH AF
        PUSH BC
        CALL ZNAK
_LD A,E:ADD A,32:JR NC,$+3:INC D:LD E,A
        CALL ZNAK
        EX DE,HL
        LD BC,31:OR A:SBC HL,BC
        EX DE,HL
        POP BC
.8      INC BC
        LD A,H:SUB 8:LD H,A
        INC L
        POP AF
        DEC A:JR NZ,GSCGB2
        EX DE,HL
        LD DE,32:ADD HL,DE
        EX DE,HL
        RET

GSCGB3  PUSH AF
        PUSH BC
        CALL ZNAK
_LD A,E:ADD A,32:JR NC,$+3:INC D:LD E,A
        CALL ZNAK
_LD A,E:ADD A,32:JR NC,$+3:INC D:LD E,A
        CALL ZNAK
_LD A,E:ADD A,32:JR NC,$+3:INC D:LD E,A
        CALL ZNAK
        EX DE,HL
        LD BC,95:OR A:SBC HL,BC
        EX DE,HL
        POP BC
.8      INC BC
        LD A,H:SUB 8:LD H,A
        INC L
        POP AF
        DEC A:JR NZ,GSCGB3
        EX DE,HL
        LD DE,96:ADD HL,DE
        EX DE,HL
        RET
;-------
VSC2    CP #11:JP NZ,EXTSEL:LD A,C
        CP #1B:JP NZ,EXTSEL
        LD A,GVvPG:CALL MNGC
        LD HL,#BFEF,B,#0E:CALL LOAD512
        JR SC2
VSCR    LD A,GVvPG:CALL MNGC
        LD HL,#C000,B,#0E:CALL LOAD512

SC2     DI
        LD A,GVvPG,(VVpag),A
        XOR A:LD (VVmod),A
        CALL DDD

SSSR    EI:HALT
        CALL ENKE:JP NZ,NXTFL

        CALL ESC:JP NZ,GED
        CALL SPKE:JR Z,SSSR
        JP GED
;-------
VGS     LD HL,ARRR+3
        LD A,(HL):DEC HL
        OR (HL):DEC HL:JP NZ,EXTSEL
        LD C,(HL):DEC HL
        OR (HL):JR NZ,VSC2
        LD A,C
        CP #1B:JR Z,VSCR
        CP #1B*2:JP NZ,EXTSEL

        LD A,GVvPG,(GPGC),A
        LD A,TVBPG:CALL MNGC
        LD HL,#C000,B,#1B:CALL LOAD512

OCC     EI:HALT
        CALL Vv
        LD A,%00100010,(VVmod),A
        LD A,GVvPG,(VVpag),A

        LD D,GVvPG,E,GVvPG+6:CALL GROB

        LD A,%00011011
        CALL PABE+2
_LD HL,GIG_PAL,DE,#B000,BC,512:LDIR
        CALL PAED

        LD A,%00000010,(VVmod),A
;-------
        LD HL,ZXADR,DE,#D800
        EXX

        LD BC,DMA_T,A,7:OUT A
        XOR A
        LD B,DMADL[:OUT A
        LD B,DMADH[:OUT A
        LD A,(GPGC)
        LD B,DMADX[:OUT A

        LD B,6*4
SSR     PUSH BC
        EXX
        LD A,TVBPG:CALL MNGC

        LD C,(HL):INC HL
        LD B,(HL):INC HL
        PUSH HL
        LD HL,BC

        LD BC,LOBU,A,32
U4      CALL GSCGB

        POP HL
        EXX

        LD A,#02
        LD DE,LOBU-#8000
        LD BC,DMASL:OUT E
        LD B,DMASH[:OUT D
        LD B,DMASX[:OUT A

        LD B,DMA_N[,A,255:OUT A
        LD B,DMA_C[,A,%00000001
        OUT A

        POP BC
        DJNZ SSR

        CALL VZAD
        JP SSSR
;-------
GSCGB   PUSH AF
        PUSH BC
        CALL ZNAK:INC DE
        POP BC
.8      INC BC
        LD A,H:SUB 8:LD H,A
        INC L
        POP AF
        DEC A:JR NZ,GSCGB
        RET
;-------
ZNAK    PUSH BC
        EX DE,HL

        LD A,(HL)
        EXX
        LD L,A:AND %01111000
.3      SRL A
        LD H,A:AND %00001000
        LD (HAT+1),A
        LD A,L:AND %00000111
HAT     OR %00000000
        LD L,A
        EXX

U1      LD BC,#1B00:ADD HL,BC

        LD A,(HL)
        EXX
        LD C,A:AND %01111000:SLA A
        LD B,A:AND %10000000
        LD (HAt+1),A
        LD A,C:AND %00000111
.4      SLA A
HAt     OR %00000000
        LD C,A
        EXX

        OR A:SBC HL,BC

        EX DE,HL
        POP BC

U3      LD A,8
        PUSH DE
Ur      EXA
U2      LD DE,#1B00

        SLA (HL)
        EXX:LD A,H:JR NC,$+3:LD A,L
        EXX:ADD HL,DE
        SLA (HL)
        EXX:LD E,B:JR NC,$+3:LD E,C:OR E
        EXX:SBC HL,DE
        LD (BC),A:INC C
        SLA (HL)
        EXX:LD A,H:JR NC,$+3:LD A,L
        EXX:ADD HL,DE
        SLA (HL)
        EXX:LD E,B:JR NC,$+3:LD E,C:OR E
        EXX:SBC HL,DE
        LD (BC),A:INC C
        SLA (HL)
        EXX:LD A,H:JR NC,$+3:LD A,L
        EXX:ADD HL,DE
        SLA (HL)
        EXX:LD E,B:JR NC,$+3:LD E,C:OR E
        EXX:SBC HL,DE
        LD (BC),A:INC C
        SLA (HL)
        EXX:LD A,H:JR NC,$+3:LD A,L
        EXX:ADD HL,DE
        SLA (HL)
        EXX:LD E,B:JR NC,$+3:LD E,C:OR E
        EXX:SBC HL,DE
        LD (BC),A:INC C
        SLA (HL)
        EXX:LD A,H:JR NC,$+3:LD A,L
        EXX:ADD HL,DE
        SLA (HL)
        EXX:LD E,B:JR NC,$+3:LD E,C:OR E
        EXX:SBC HL,DE
        LD (BC),A:INC C
        SLA (HL)
        EXX:LD A,H:JR NC,$+3:LD A,L
        EXX:ADD HL,DE
        SLA (HL)
        EXX:LD E,B:JR NC,$+3:LD E,C:OR E
        EXX:SBC HL,DE
        LD (BC),A:INC C
        SLA (HL)
        EXX:LD A,H:JR NC,$+3:LD A,L
        EXX:ADD HL,DE
        SLA (HL)
        EXX:LD E,B:JR NC,$+3:LD E,C:OR E
        EXX:SBC HL,DE
        LD (BC),A:INC C
        SLA (HL)
        EXX:LD A,H:JR NC,$+3:LD A,L
        EXX:ADD HL,DE
        SLA (HL)
        EXX:LD E,B:JR NC,$+3:LD E,C:OR E
        EXX:SBC HL,DE
        LD (BC),A

        INC B,B
        LD A,C:SUB 7:LD C,A
        INC H
        EXA:DEC A:JP NZ,Ur
        POP DE
        RET
;---------------------------------------
EXTZEL  CALL GETEN:RET Z
        LD HL,BRRR:CALL GIPAG

EXTSEL  CALL GED

        PUSH IX
        POP HL
        LD DE,WINDC,BC,30:LDIR

        PUSH IX
        LD IX,WINDC

        LD (IX+1),0
.2      INC (IX+2)
        LD A,(IX+3)
        ADD A,(IX+12)
        SUB 3:JR NC,$+3:XOR A
        LD (IX+3),A

        LD (IX+4),19+2
        LD (IX+5),4+2
        LD (IX+6),%01001111
        LD (IX+8),B
        LD (IX+9),B
        LD (IX+10),B
        LD (IX+11),B

        LD A,(EXTN),(IX+12),A
        LD (IX+13),4

        LD (IX+14),%11110000
        CALL PRWOW

_LD HL,TBIN,DE,#0101,BC,19:CALL PRSRW
_LD HL,TTXT,DE,#0201,BC,19:CALL PRSRW
_LD HL,TSCR,DE,#0301,BC,19:CALL PRSRW
_LD HL,TTGA,DE,#0401,BC,19:CALL PRSRW

ET      EI:HALT:CALL CURSOR
        CALL UPPP,NZ,CrUP
        CALL DWWW,NZ,CrDN

        CALL ENKE:JR NZ,ES
        CALL ESC:JR Z,ET

        CALL RRESB
        POP IX
        RET
;-------
ES      CALL RRESB:LD A,(IX+12),(EXTN),A
        POP IX
        LD A,(WINDC+12)
        DEC A:JP Z,VBIN
        DEC A:JP Z,RE
        DEC A:JP Z,VGS
        JP VIMG
;-------
CHEXT   LD A,(DE):OR A:RET Z
        CP (HL):JR NZ,HE
        INC HL,DE
        LD A,(DE):CP (HL):JR NZ,H2
        INC HL,DE
        LD A,(DE):CP (HL):JR Z,S7
        DEC HL,DE
H2      DEC HL,DE
HE      INC DE,DE,DE,DE,DE
        JR CHEXT

S7      INC DE:LD A,(DE),L,A
        INC DE:LD A,(DE),H,A
        LD A,1:OR A
        RET

CHext   LD BC,0,(HE),BC
        CALL CHEXT
        LD BC,#1313,(HE),BC
        RET
;-------
HEoff   EQU LOBU+3
H2off   EQU HEoff+8+2
H3off   EQU H2off+16+2

VBIN    CALL REK
        CALL ATTGN
        LD HL,LOBU,B,128:CALL NOPING
        LD A,"#"
        LD (HEoff-1),A
        LD A,#BA
        LD (HEoff-3),A
        LD (H3off+48),A
        LD A,#B3
        LD (H2off-1),A
        LD (H3off-2),A

        LD HL,0
        LD (CURD),HL
        LD (CURU),HL
        CALL PGPRB,THE

MBI     EI:HALT
        CALL UPPP,NZ,CRBUP
        CALL DWWW,NZ,CRBDN

        CALL SPKE:JP NZ,GED
        CALL ESC:JR Z,MBI
        JP GED
;-------
GUPB    OR A:SBC HL,BC:JR NC,GUP_
        LD A,(CUPG):DEC A:LD (CUPG),A
GUP_    LD A,H:CP #C0:JR NC,GUPP
        LD A,(CUPG):DEC A
        CP TVBPG:RET C:LD (CUPG),A
        LD A,H:ADD A,#40:LD H,A
GUPP    LD (THL),HL
        PUSH HL
        LD HL,(CURD),DE,(CURU)
        OR A:SBC HL,BC:JR NC,$+3:DEC DE
        LD (CURD),HL,(CURU),DE
        POP HL
        XOR A
        RET

CRBUP   LD HL,(THL),A,(CUPG),(CUPU),A
        PUSH HL
        LD BC,16*HEI+16
        CALL GUPB:JR C,BUpp
        LD A,0-1
        CALL YoRN
        CALL ZBUB
        CALL HGIR

        LD BC,16*HEI
        LD HL,(CURD),DE,(CURU)
        ADD HL,BC:JR NC,$+3:INC DE
        LD (CURD),HL,(CURU),DE
        POP HL
        LD A,(CUPU),(CUPG),A
        LD BC,16:CALL GUPB

        LD HL,(Yoff),DE,(YoX):ADD HL,DE
        EX DE,HL
        JP YoCH

BUpp    POP HL
        RET
;-------
CRBDN   LD DE,(LNFL),HL,(LNFL+2)
        LD BC,(CURU)
        OR A:SBC HL,BC:RET C
        EX DE,HL
        LD BC,(CURD)
        OR A:SBC HL,BC:JR NC,RBN
        DEC DE
        INC E:JR NZ,RBN
        INC D:RET Z

RBN     LD HL,(THL)
        LD A,HEI
        CALL YoRN
        CALL ZBUB
        CALL HGIR
        LD DE,(Yoff)
.8      INC DE
        JP YoCH
;-------
PGPRB   LD B,HEI,HL,#C000,DE,#C000
BCD     PUSH BC
        CALL ZBUB
        CALL HGIR
        LD HL,(THL)
        POP BC
        DJNZ BCD
        RET

ZBUB    PUSH DE
        LD A,(CUPG):CALL MNGC

        LD A,H:CP #C0:JR NC,BUB
        LD A,(CUPG):INC A
        CP TVEPG+1:JR NC,BuB
        LD (CUPG),A:CALL MNGC
        LD HL,#C000
BUB     LD DE,H2off,BC,16:LDIR
        LD (THL),HL

        LD DE,H2off,HL,H3off,B,4
B_B
.4      LD A,(DE):CALL NORK:INC L,E
        DJNZ B_B

        LD HL,HEoff
        LD DE,(CURU)
        LD A,D:CALL NORK
        LD A,E:CALL NORK
        LD DE,(CURD)
        LD A,D:CALL NORK
        LD A,E:CALL NORK

        LD DE,(CURU)
        LD HL,(CURD),BC,16
        ADD HL,BC:JR NC,$+3:INC DE
        LD (CURD),HL
        LD (CURU),DE

        LD A,TVvPG:CALL MNGC
        LD HL,LOBU,BC,80
BuB     POP DE
        RET

HGIR    LDIR:INC D:LD E,0
        RET
;-------
ATTGN   LD A,TVvPG:CALL MNGC
        LD A,%00000101
        LD HL,#C080
        EXX
        LD B,64
ATGN    EXX
_LD A,%00011111,(HL),A:INC L
_LD A,%00010111,B,11:CALL NOPING+1

        LD A,%00011111,(HL),A:INC L
        LD B,8
        LD (HL),%00010111:INC L
        LD (HL),%00010101:INC L
        DJNZ $-6

        LD A,%00011111,(HL),A:INC L
        LD A,%00010000,(HL),A:INC L

        LD C,8
ATG     LD A,%00010111,B,3:CALL NOPING+1
        LD A,%00010101,B,3:CALL NOPING+1
        LD A,%00011111,(HL),A
        DEC C:JR NZ,ATG
        INC H:LD L,#80
        EXX
        DJNZ ATGN
        RET
;-------
VIEW    CALL GETEN:JP Z,GED

VIE     LD HL,BRRR:CALL GIPAG

        CALL GOPLG
        OR A:JP Z,GED
        DEC A:JR Z,VIK
        DEC A:JP Z,NXTFL

VIK     LD HL,ENTRY+8
        LD DE,EXTZ
        CALL CHEXT:JP Z,EXTSEL,(HL)

RE      CALL REK,AWK,PGPR,THE

VV      EI:HALT
        CALL UPPP,NZ,PGUP
        CALL DWWW,NZ,PGDN
        CALL PGU,NZ,PgUP
        CALL PGD,NZ,PgDN


        CALL ENKE:JP NZ,NXTFL

        CALL SPKE:JP NZ,Vv
        CALL ESC:JR Z,VV
        JP Vv
;-------
REK     LD A,TVvPG+1:CALL MNGC
        LD DE,#C000+#0400
        LD HL,#C000+#0800,BC,#0400:LDIR
        LD HL,#C000,B,8:CALL NOPING

        LD A,TVvPG:CALL MNGC

;LD C,HEI,HL,#C000
;ITD LD B,0:CALL NOPING
;DEC C:JR NZ,ITD

        LD HL,ARRR,DE,LNFL,BC,4:LDIR

        LD HL,0
        LD (Yoff),HL
        LD (YoX),HL
        XOR A
        LD (EDFL),A
        LD A,TVBPG
        LD (CUPG),A
        LD (CUPU),A
        LD A,13
        LD (#C000-2),A
        LD (#C000-1),A
        LD (#FFFF+1),A
        LD HL,#C000,(CURU),HL

        CALL TLOAD:LD A,TVBPG,(CUPG),A
        RET

THE     DI
        LD A,TVvPG,(VVpag),A:CALL DED
        RET
;-------
AWK     LD A,TVBPG:CALL MNGC
        LD HL,#C000,DE,LOBU,BC,#1000-1
        LDIR
        LD A,TVvPG+1:CALL MNGC

        LD HL,LOBU,BC,#1000:XOR A:CPIR
        LD HL,#1000:OR A:SBC HL,BC
        LD BC,HL
        LD A,B:OR A:JR NZ,REE
        LD A,C:CP 16:JR NC,$+3:XOR A
REE     LD HL,LOBU:CALL NZ,DEF_COD
        LD DE,#C000+#0800
        OR A:RET Z
        CP 1:JR Z,SWIN
        CP 2:JR Z,SKOI
        RET

SWIN    EXX
        LD DE,#C000+#0800+#0400+#0100
        LD BC,0
        EXX
        JR BDR
SKOI    EXX
        LD DE,#C000+#0800+#0400
        LD BC,0
        EXX

BDR     EXX:LD HL,DE:ADD HL,BC:LD A,(HL)
        EXX
        CP #80:JR NC,$+3:XOR A
        LD H,0,L,A
.3      ADD HL,HL
        LD BC,#C000:ADD HL,BC
        EX DE,HL
.8      LDI
        EX DE,HL
        EXX
        INC C:LD A,C:CP #80:JR C,BDR+1
        RET
;-------
TLOAD   LD A,(CUPG):CP TVEPG+1:RET NC
        CALL MNGC
        CALL PGLOAD:OR A:RET NZ
        LD A,(CUPG):INC A:LD (CUPG),A
        JR TLOAD
;-------
PGLOAD  LD B,32,HL,#C000
PGL     PUSH BC
        LD B,1:CALL LOAD512
        POP BC
        CP #0F:RET Z
        DJNZ PGL
        XOR A
        RET
;---------------------------------------
ZBUF    PUSH DE
        LD A,(CUPG):CALL MNGC
        LD (THL),HL
        LD BC,128:ADD HL,BC:JR C,DUO

        SBC HL,BC:LD DE,LOBU:LDIR

DO      LD A,13,(LOBU+128),A
        LD A,TVvPG:CALL MNGC
        POP DE
        LD HL,LOBU,B,1
        RET

DUO     EX DE,HL
        LD HL,BC
        OR A:SBC HL,DE:LD BC,HL
        LD HL,(THL)
        PUSH DE
        LD DE,LOBU:LDIR
        LD A,H:ADD A,#C0:LD H,A
        LD A,(CUPG):INC A:CALL MNGC
        POP BC
        INC BC
        LDIR
        JR DO
;-------
NWHL    LD A,(CUPG):CALL MNGC
        LD HL,(CURD)
VjD2    CALL SER13D
        LD A,H:CP #C0:JR C,VJD2
        LD (CURD),HL
        RET

VJD2    LD A,(CUPG):INC A
        CP TVEPG+1:RET NC
        LD (CUPG),A:CALL MNGC
        LD HL,#C000
        JR VjD2
;-------
VJD     LD A,(CUPU):INC A
        CP TVEPG+1:RET NC
        LD (CUPU),A:CALL MNGC
        LD HL,#C000
        JR VjD

PGDN    LD A,(EDFL):OR A:RET NZ
        LD A,(CUPG):CALL MNGC

        LD HL,(CURD)
        LD A,(HL):INC HL:OR A:RET Z
        LD A,(HL):OR A:RET Z

        LD A,(CUPU):CALL MNGC
        LD HL,(CURU)
VjD     CALL SER13D
        LD A,H:CP #C0:JR C,VJD
        LD (CURU),HL

        LD A,HEI:CALL YoRN

        LD HL,(CURD)
        CALL ZBUF
        CALL GIRL
        CALL NWHL

        LD DE,(Yoff)
.8      INC DE
YoCH    LD A,D:AND %00111111
        LD (VYofL),DE
        LD (Yoff),DE
        RET
;-------
TU      LD A,(CUPU):CALL MNGC
        LD HL,(CURU)
Vj      CALL SER13U
        LD A,H:CP #C0:JR C,VJ
        LD (CURU),HL
        LD A,1:OR A
        RET

VJ      LD A,(CUPU):CP TVBPG:RET Z
        DEC A:LD (CUPU),A:CALL MNGC
        LD HL,0-1
        JR Vj
VJ2     LD A,(CUPG):DEC A:LD (CUPG),A
        CALL MNGC
        LD HL,0-1
        JR Vj2

EJ      LD HL,(CURD)
Vj2     CALL SER13U
        LD A,H:CP #C0:JR C,VJ2
        LD (CURD),HL
        RET
IZS     DEC A:LD (EDFL),A
        LD A,1:OR A
        RET
;-------
PGUP    CALL TU:RET Z

        LD A,0-1:CALL YoRN

        LD A,(CUPG)
        PUSH AF
        LD A,(CUPU),(CUPG),A
        CALL ZBUF
        CALL GIRL
        POP AF
        LD (CUPG),A:CALL MNGC

        LD A,(EDFL):OR A
        CALL NZ,IZS,Z,EJ

        LD DE,(Yoff)
.8      DEC DE
        JP YoCH
;---------------------------------------
PgDN    LD A,(EDFL):OR A:RET NZ
        LD A,(CUPG),(CUPU),A
        LD HL,(CURD),(CURU),HL
        LD A,HEI
        JR PGpr

PgUP    XOR A:LD (EDFL),A
        LD B,HEI
OG      PUSH BC
        CALL TU
        POP BC
        LD A,0-HEI:JR Z,Og
        DJNZ OG
        LD HL,(CURU),(CURD),HL
        JR PGpr
Og      LD HL,0,(Yoff),HL
        LD HL,#C000,(CURU),HL
;-------
PGPR    LD HL,(CURU),(CURD),HL

        XOR A
PGpr    CALL YoRN
        LD A,(CUPU),(CUPG),A
        LD B,HEI
ABC     PUSH BC
        CALL ZBUF
        CALL GIRL
        CALL NWHL
        POP BC
        DJNZ ABC

        EI:HALT
        PUSH HL
        LD HL,(Yoff),DE,(YoX):ADD HL,DE
        EX DE,HL
        POP HL
        JP YoCH
;-------
GIRL    PUSH BC

        LD A,(DCOL),(COLR),A

        PUSH HL
        CALL SER13D:DEC HL
        OR A:JR Z,$+3:DEC HL
        LD A,(HL)
        POP HL
        CP 9:JR NC,DDT

        LD (COLR),A

DDT     LD A,(HL):CP 14:JR C,TTL
PLC     SET 7,E
        LD A,(COLR)
        LD (DE),A
        RES 7,E

        LDI
        JP DDT
TTL     CP 13:JR Z,NXTL
        OR A:JR Z,NXTP
        INC HL:CP 10:JR Z,DDT
        CP (HL):JR Z,BRT
        LD B,A
        LD A,(HL):CP 13:JR Z,NXTL,NC,DNN
        INC HL
        DEC B,A
.4      SLA A
        OR B

DON     LD (COLR),A
        JP PLC
;-------
DNN     DEC HL
        LD A,B
        CP 8:JR NZ,$+5:LD A,(DCOL)
        LD (COLR),A
        SET 7,E
        LD (DE),A
        RES 7,E

        LD A,32,(DE),A:INC HL,E
        JP DDT
;-------
BRT     INC HL
        OR %00001000
        LD (COLR),A
        JP PLC
;-------
NXTL    INC HL
        BIT 7,E:JR NZ,TOR

        EX DE,HL
        LD B,C
        LD A,(DCOL),C,A
        LD A,32
KKL     LD (HL),A
        SET 7,L
        LD (HL),C
        RES 7,L
        INC L
        BIT 7,L:JR Z,KKL
        EX DE,HL

TOR     INC D:LD E,0:JR NZ,$+4:LD D,#C0
        POP BC
        DEC B:JP NZ,GIRL
        RET

NXTP    LD A,(EDFL):INC A:LD (EDFL),A
        JR NXTL

YoRN    PUSH AF
        LD DE,(Yoff)
        RRC D:RR E
.2      SRL E
        ADD A,E
        AND %00111111
        ADD A,#C0
        LD D,A
        LD E,0
        POP AF

        PUSH HL
        LD L,A,H,0
        CP #80:JR NC,YoN
.3      SLA L:RL H
YoR     LD (YoX),HL
        POP HL
        RET

YoN     XOR A:SUB L:LD L,A
.3      SLA L:RL H
        PUSH BC
        LD BC,HL,HL,0:OR A:SBC HL,BC
        POP BC
        JR YoR
;---------------------------------------
SER13D  LD C,13
SER     LD A,(HL)
        OR A:RET Z:INC HL
        CP C:RET Z
        JP SER

SER13U  LD A,13
        CP (HL)
        DEC HL
        JR Z,UBED
SER13u  CP (HL)
        DEC HL
        JP NZ,SER13u
        CP (HL)
        INC HL
        RET Z
        DEC HL
SER13T  DEC HL
        CP (HL)
        JP NZ,SER13T
        INC HL
        RET
UBED    DEC HL
        CP (HL)
        JR NZ,SER13T
        INC HL
        RET
;---------------------------------------
FSM     CALL GED

        PUSH IX
        LD HL,F5WND,DE,WINDC,BC,30:LDIR
        LD IX,WINDC
        LD (IX+2),30
        LD (IX+3),10

        LD (IX+4),18+2
        LD (IX+5),5+2

        LD (IX+12),1
        LD (IX+13),3
        LD (IX+14),%11110000:CALL PRWOW

_LD HL,TXTA,DE,#0005,BC,9:CALL PRSRW
        LD A,%11110111:CALL PRIAT

_LD HL,TF35,DE,#0105,BC,8:CALL PRSRW
_LD HL,TF70,DE,#0205,BC,8:CALL PRSRW
_LD HL,TF14,DE,#0305,BC,8:CALL PRSRW

        LD A,1:CALL YN
MSPG    EI:HALT:CALL CURSOR
        XOR A:CALL YN

        CALL UPPP,NZ,CrUP
        CALL DWWW,NZ,CrDN

        CALL ESC:JR NZ,CSPG
        CALL ENKE:JR Z,MSPG
;-------
        LD A,#FF:CALL YN:JR NZ,CSPG

        LD A,(IX+12)
        LD C,0
        DEC A:JR Z,AS
        LD C,1
        DEC A:JR Z,AS
        LD C,2
AS      LD A,C,(BOF+1),A

        CALL RRESB
        POP IX

        LD A,1:OR A
        RET
;-------
CSPG    CALL RRESB
        POP IX
        XOR A
        RET
;---------------------------------------
RUNHOB  CALL FSM:RET Z

        LD HL,0,B,1:CALL LOAD512
        LD HL,(#0B),A,H:CP #A0:RET NC
        LD DE,(#09),A,D:CP #60:RET C

        CALL DINT
        LD A,%00100000,(VVmod),A
        XOR A:CALL MNGC,TURBOof
        EXX
        LD HL,HOBAT,DE,#5B00,BC,48:LDIR
        LD HL,MNG0D,DE,#5B30,BC,32:LDIR
        EXX
        LD HL,17,BC,512-17:PUSH DE
        JP #5B00

HOBAT   LDIR:EX DE,HL

THG     LD B,1:CALL LOAD512
        CP #0F:JR NZ,THG

        DI
        LD A,63,I,A:IM 1
        LD IY,#5C3A

        LD BC,Vmod:XOR A:OUT A
        CALL #5B30
        LD BC,#7FFD,A,16:OUT A
        RET
;---------------------------------------
PAGER   EQU #5000
LOB2    EQU #A000
STPBL   EQU #5B00
;-------
RUNSPG  CALL FSM:RET Z

        LD A,%00100000,(VVmod),A

        LD HL,LOB2,B,4:CALL LOAD512

        LD HL,LOB2+32,DE,IDNT,B,12
        CALL RAZ:JP NZ,GED

        LD A,(HL):CP 3:JP NC,GED
        CP 2:JR C,OF4
;SPGv0.2:
        LD A,15,(VrS+1),A
        LD A,16,(V2A+1),A,(V2F+1),A
        LD A,4,(V2B+1),A
        LD A,15,(V2C+1),A
;SPGv0.0/0.1:
OF4     ;HL,SPGLOG:CALL SPGLOG
        CALL DINT
        LD HL,LOB2,DE,PAGER,BC,#0800
        LDIR

        LD HL,MANAG0,DE,PAGER,BC,32:LDIR
        XOR A:CALL PAGER
;-------
V2A     LD A,8,(STUS),A;        COUNTER!
        LD HL,(PAGER+64),(SAR+1),HL

        LD A,(PAGER+66),(SPA+1),A
        LD HL,(PAGER+74)
        LD A,H:CP #40:JR NC,NSPZ
        LD HL,(SPBU)
NSPZ    LD (SSPA+1),HL

        LD HL,(PAGER+68),(V2E+1),HL

        LD HL,(PAGER+76)
        LD A,H:OR L:JR Z,V2Di
        LD (V2D+1),HL
V2Di    LD BC,(PAGER+78)
        LD A,B:OR C:JR Z,MAA
        LD A,B:OR A:JR Z,MAA:LD B,1
        LD A,C:CP #41:JR C,MAA:LD C,0
MAA     LD (LAA+1),BC

        LD IX,PAGER+128
GROP    LD A,(IX+2):CP 14:JR C,NSPL
        LD A,13
NSPL    LD (SPGL+1),A

;LD A,1,(PAUS),A
        LD A,(IX+3)
VrS     AND 7
        DI:CALL PAGER;LD (STRANIC),A

        LD HL,PAGER+512,E,(IX),D,(IX+1)
        LD BC,#0600
        CALL LC
        EX DE,HL
        LD A,H:CP #A0:JR C,DIPL
        PUSH IX
SPGL    LD B,1:SLA B,B
        LD A,B:OR A:CALL NZ,LOAD512
        POP IX

V2B     LD DE,8:ADD IX,DE

        LD A,(STUS):DEC A
        LD (STUS),A:JR NZ,GROP
;-------
DIPL    DI
        LD A,63,I,A:IM 1
        LD IY,#5C3A

        LD BC,Vmod:XOR A:OUT A
        CALL MNG0D
        LD BC,#7FFD,A,16:OUT A

        LD HL,#5800,DE,#5801,BC,#02FF
        LD (HL),L
        LDIR

        LD HL,PAGER
V2E     LD DE,0
        LD BC,32
        LDIR

LAA     LD BC,0,A,B:OR C:JR Z,SPA
        LD HL,PAGER+192
V2D     LD DE,#5B00
        LDIR

SPA     LD A,0
V2C     AND 7
        CALL PAGER

;LD A,(PAGER+67)
;CP 1:JR NZ,NNx
;LD A,(DRVE),(#5CF6),A

NNx     LD A,(V2C+1):CP 7:JR Z,SSPA
        LD HL,PAGER+49,E,5
OUTZ    LD C,(HL):INC HL
        LD B,(HL):INC HL
        LD A,B:OR C:JR Z,OUTz
        LD A,(HL)
        OUT A
OUTz    INC HL
        DEC E:JR NZ,OUTZ

SSPA    LD SP,0
SAR     JP 0
;-------
LC      LD A,(STUS)
V2F     CP 8:RET NZ
        LD A,D:CP #A0:JR NC,V01

        LD (SREZ+4),DE
        ADD A,6:LD D,A
        PUSH DE
        LD HL,(SAR+1),(SR1+1),HL
        LD DE,PAGER+#20,(SAR+1),DE
        LD HL,SREZ,BC,16:LDIR
        POP DE
        RET
V01     LDIR
        RET
SREZ    LD HL,PAGER+512
        LD DE,0
        LD BC,#0600
        LDIR
SR1     JP 0
;-------
MANAG0  ;I:A - num of PAGE (VALID: 0-15)
        PUSH BC
        LD BC,PW4:OUT A
        POP BC
        RET
;---------------------------------------
PLER    LD HL,TER4,DE,#0114,BC,24
        JP ERR0
;---------------------------------------
LDPLG   CALL GED:XOR A
LDPL2   LD (PPFR),A

        LD HL,LOBU,B,1:CALL LOAD512

        LD A,(LOBU+32):CP #02:JR NZ,PLER

        LD HL,IDNT2,DE,LOBU+16,B,16
        CALL RAZ:RET NZ
;-------
        LD A,(PPGM),(PPGP),A,(LOBU),A
        LD HL,(LOBU+34):ADD A,L
        RET C:CP PLEPG-PLGPG:RET NC
        LD (PPG2),A

        LD A,PLHPG:CALL MNGC
;-------
        CALL PDCHECK:RET C
;-------
        LD HL,LOBU,DE,(PHED)
        LD A,D:CP #40:RET C
        LD BC,512:LDIR:LD (PHED),DE
        EX DE,HL:LD B,0:CALL NOPING

        LD HL,LOBU+36
WALK    LD A,(HL):INC HL:CALL MNGC_PL
        LD A,(HL):INC HL:OR A:JR Z,LGW
        PUSH HL
        LD B,A,HL,#C000:CALL LOAD512
        POP HL
        JR WALK

LGW     LD A,(PPG2),(PPGM),A
        LD A,(PPFR):OR A:RET NZ

        PUSH IX
        LD IX,LGWND:CALL PRWOW

        LD HL,LOBU+512,B,32:CALL NOPING
        LD HL,LOBU+165+31
        LD B,32,A,B:CALL NOMI
        LD C,B:SUB B:SRL A:LD B,A
        LD DE,LOBU+512,A,31:SUB B
        LD E,A,B,0
        LD A,C:OR A:JR Z,$+4:LDDR

_LD HL,LOBU+512,DE,257,BC,32:CALL PRSRW
        LD A,%01110001:CALL PRIAT
_LD HL,TEM0,DE,#020D,BC,9:CALL PRSRW

        CALL USPO
        CALL NUSP

        CALL RRESB
        POP IX

        LD A,(LOBU+197)
        CP #01:CALL Z,RAJT
        RET
;-------
PDCHECK LD HL,#C000+165
PDC     LD BC,(PHED)
        OR A:SBC HL,BC:RET NC
        ADD HL,BC

        PUSH HL
        LD DE,LOBU+165
        LD B,32
DCH     LD A,(DE):CP (HL):JR NZ,PDCH
        INC HL,DE
        DJNZ DCH
        POP HL
        SCF
        RET

PDCH    POP HL
        LD BC,512:ADD HL,BC
        JR PDC
;-------
PLGCL   LD A,PLHPG:CALL MNGC
        LD HL,#C000,(PHED),HL
        LD B,0:CALL NOPING
        XOR A
        LD (PPGP),A
        LD (PPGM),A
;LD (PPG2),A
        RET
;-------
NOMI    CP (HL):RET NZ:DEC HL:DJNZ $-3
        RET
;---------------------------------------
F11MENU PUSH IX
        LD HL,(PHED),A,H:CP #C2:JP C,F1E

        LD A,PLHPG:CALL MNGC
        LD HL,#C000+165,DE,LOBU

ZkL     LD BC,32:LDIR
        LD BC,512-32:ADD HL,BC
        LD A,(PHED+1):CP H:JR NZ,ZkL

        EX DE,HL:LD BC,0-LOBU:ADD HL,BC
.5      SRL H:RR L
        LD A,L

        LD HL,F11WND,DE,WINDC,BC,15:LDIR
        LD IX,WINDC

        PUSH AF
        LD (IX+13),A
        ADD A,2:LD (IX+5),A:CALL PRWOW

_LD HL,TXTH,DE,#000B,BC,11:CALL PRSRW
_LD A,%11110101:CALL PRIAT
        POP BC

        LD HL,LOBU,DE,#0101
SPIG    PUSH BC
        PUSH HL,DE
        LD BC,32:CALL PRSRW
;LD A,%01010000:CALL PRIAT
        POP DE,HL
        LD BC,32:ADD HL,BC:INC D
        POP BC
        DJNZ SPIG
;-------
F11MC   EI:HALT:CALL CURSOR

        CALL UPPP,NZ,PSUP
        CALL DWWW,NZ,PSDN

        CALL DELE:JR NZ,PSDEL

        CALL ESC:JR NZ,F1e
        CALL ENKE:JR NZ,PSEXE
        JR F11MC
;-------
F1e     CALL RRESB
F1E     POP IX
        RET
;---------------------------------------
PSUP    LD A,(IX+12):DEC A:RET Z
        CALL CURSER
        DEC (IX+12)
        JR PSA
PSDN    LD A,(IX+12):CP (IX+13):RET NC
        CALL CURSER
        INC (IX+12)
PSA     JP CURSOR
;-------
PSEXE   LD A,PLHPG:CALL MNGC

        LD A,(IX+12),(PSY),A:DEC A
        LD H,0,L,A
.9      ADD HL,HL
        LD BC,#C000:ADD HL,BC
        LD DE,LOBU,BC,512:LDIR

        CALL RRESB
        POP IX

        LD A,(LOBU+197):CP 3:JR NZ,PSER
        LD A,3:CALL AJT
        RET
;-------
PSER    LD HL,TER3,DE,#010C,BC,37
        JP ERR0
;---------------------------------------
PSDEL   LD HL,TXTK,DE,#010E,BC,14
        CALL DLME:JP Z,F1e

        LD A,PLHPG:CALL MNGC

        LD HL,0,DE,1,BC,512-1
        LD (HL),L
        LDIR

        LD A,(IX+12)
        LD H,0,L,A
.9      ADD HL,HL
        LD BC,#C000:ADD HL,BC
        LD DE,HL:DEC D,D
        PUSH HL
        LD HL,0:SBC HL,DE:LD BC,HL
        POP HL
        LDIR

        LD HL,(PHED)
        LD BC,0-512:ADD HL,BC
        LD (PHED),HL
        JP F1e
;---------------------------------------
FINI    LD A,INIPG:CALL MNG0
        LD BC,#DFF7,A,#B2:OUT A
        LD B,#BF:IN A

        CP 3:JR C,$+3:XOR A
        OR A:JR Z,BDSD
        DEC A:JR Z,BDSD+2
        DEC A:RET NZ
        CALL DOS_SWP
        LD A,1
        JR BDIS

BDSD    LD A,1:CALL DOS_SWP

        CALL IDE_INI
        XOR A
BDIS    CALL SEL_DEV:RET NZ
        CALL HDD:RET NZ
;-------
        LD HL,WCDIR:CALL GENTRY
        CALL SRHDRN:RET Z
        LD (BRRR),HL,(BRRR+2),DE
        LD HL,BRRR:CALL GLSTCAT

        LD HL,WCINI:CALL GENTRY
        CALL SRHDRN:RET Z

        LD (BRRR),HL,(BRRR+2),DE
        LD HL,BRRR:CALL GIPAG

        LD HL,0,B,1:CALL LOAD512

        LD HL,0,DE,IDNT3,B,37
        CALL RAZ:RET NZ
;-------
        LD IX,INIWND:CALL PRWOW

        CALL PARSING
;-------
        LD HL,ENTRY,B,32:CALL NOPING

;CALL USPO
;CALL NUSP
        JP F7F
;---------------------------------------
PARSING LD HL,0,DE,#0101
RSI     CALL SER13D
        LD A,(HL):CP #0A:INC HL
        LD A,(HL)
        OR A:RET Z
        CP #0D:RET Z

        PUSH HL
        PUSH DE:CALL SERNLOD
        POP DE
        CALL NZ,PLPRNAM
        POP HL
        JR RSI
;-------
SERNLOD CALL GENNAM
        CALL GENTRY
        CALL SRHDRN:RET Z
        LD (BRRR),HL,(BRRR+2),DE
        LD HL,BRRR:CALL GIPAG

        LD A,1:CALL LDPL2
        LD A,1:OR A
        RET
;-------
GENNAM  LD DE,LOBU,BC,8:LDIR:INC HL
        LD C,3:LDIR
        LD HL,LOBU
        RET
;-------
PLPRNAM PUSH DE
        LD IX,INIWND
        LD HL,LOBU+165,BC,32:CALL PRSRW
        LD A,%01110000:CALL PRIAT
        POP DE
        INC D
        RET
;---------------------------------------
DINT    DI:LD HL,INTM+2,(INTM),HL:RET
;-------
RAZ     LD A,(DE):CP (HL):RET NZ
        INC HL,DE
        DJNZ RAZ
        RET
;-------
F7F     XOR A:IN (#FE)
        AND %00011111:CP %00011111
        JR NZ,F7F
        RET
;---------------------------------------
IDNT    DB "SpectrumProg"
IDNT2   DB "WildCommanderMDL"
IDNT3   DB "Wild Commander "
        DB "configuration file v0.1"
;---------------------------------------
