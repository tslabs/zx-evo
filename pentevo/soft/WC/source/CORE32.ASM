        ORG #C000;    WildDOSFileCore#32

        LD HL,CORE32,DE,#4000
        LD BC,END-START
        LDIR
        RET

        INCL "KERNEL"
;---------------------------------------
RMFL2   LD A,L:AND #F0:LD L,A
        LD C,32:ADD HL,BC
        JP NXFL2
;-------
NXTETY2 ;i:DE - Address
;A -   [7]:1 - only short names
;    [6-5]:reserved
;      [4]:1 - enable created time field
;      [3]:1 - enable created date field
;      [2]:1 - enable size field
;    [1-0]:%00 find next Entry
;          %01 find next File
;          %10 find next DIR
;          %11 reserved
;
;        o: Z - End Of Dir
;          NZ - Buffer updated:
;          DE - [size(4)],
;               [date(2)],
;               [time(2)],
;               flag(1),Entry Name,#00

        LD C,A
        XOR A:BIT 7,C:JR Z,$+3:INC A
        LD (BT7+1),A
        XOR A:BIT 4,C:JR Z,$+3:INC A
        LD (BT4+1),A
        XOR A:BIT 3,C:JR Z,$+3:INC A
        LD (BT3+1),A
        XOR A:BIT 2,C:JR Z,$+3:INC A
        LD (BT2+1),A
        LD A,C:AND %00000011
        LD (BT0+1),A

        PUSH DE
        LD A,(CGFL):OR A:CALL Z,NXTINI
        POP DE

        LD HL,NXFF2,(NxMR+1),HL
NXFF2   LD HL,(CGPZ),B,0
NXFL2   LD A,H:CP NXTBE[:JR NC,NXMR
        LD A,(HL)
        OR A:RET Z
        CP #E5:JR Z,RMFL2

        LD C,11:ADD HL,BC
        LD A,(HL):BIT 3,A:JR NZ,RMFL2
        EXA
BT0     LD A,0
        OR A:JR Z,BT1
        DEC A:JR NZ,BT01
        EXA:BIT 4,A:JR NZ,RMFL2,Bt1
BT01    EXA:BIT 4,A:JR Z,RMFL2

Bt1     EXA
BT1     LD C,16-11:ADD HL,BC
BT2     LD A,0:OR A:JR Z,BT3
        LD C,28-16:ADD HL,BC
.4      LDI
        LD C,16:SBC HL,BC

BT3     LD A,0:OR A:JR Z,BT4
.2      LDI
.2      DEC L

BT4     LD A,0:OR A:JR Z,BT8
.2      DEC L
.2      LDI

BT8     RES 4,L:CALL LNCRC

        EXA:LD (DE),A:INC DE
BT7     LD A,0:OR A:JP Z,NXTE2
        LD A,L:AND #F0:LD L,A
        JP Snm

;---------------------------------------
NXMR    LD A,(EOC):CP #0F:RET Z

        PUSH DE
        LD HL,NXTBE-#0300
        LD DE,NXTBM-#0300
        LD BC,#0300:LDIR

        LD HL,DE,(CGPZ),HL
        LD B,NXTBZ/2:CALL LOAD512
        LD (HL),0
        POP DE
NxMR    JP 0

RMFL    LD C,32-11:ADD HL,BC:JP NXFL
RMFL1   LD C,32:ADD HL,BC:JP NXFL
;-------
NXTETY  ;i:DE - Address
;        o:DE - New Value
;           Z - End Of Dir
;          NZ - OK
;
;fclus(4),size(4),date(2),time(2),
;!flag(1),name(X),#00

        PUSH DE
        LD A,(CGFL):OR A:CALL Z,NXTINI
        POP DE

        LD HL,NXFF,(NxMR+1),HL
NXFF    LD HL,(CGPZ),B,0
NXFL    LD A,H:CP NXTBE[:JR NC,NXMR
        LD A,(HL)
        OR A:RET Z
        CP #E5:JR Z,RMFL1

        LD C,11:ADD HL,BC
        LD A,(HL):BIT 3,A:JR NZ,RMFL
        EXA
        LD C,15:ADD HL,BC
.2      LDI
        LD C,8:SBC HL,BC
.2      LDI
        ADD HL,BC
.4      LDI
        LD C,16:SBC HL,BC

.2      LDI
.2      DEC L

.2      DEC L
.2      LDI

        RES 4,L:CALL LNCRC

        EXA
        AND #10
        XOR #10:LD (DE),A:INC DE

NXTE2   OR A:LD C,32:SBC HL,BC:JP C,SNM
        LD A,(HL):CP #0F:JP NZ,SNM
        EXA

.2      INC L
        CP (HL):JP NZ,SNM2

        LD C,1
        LD (CGHL),HL,(CGDE),DE
        LD A,L:AND #F0:LD L,A

LNPARS  LD A,(HL)
        BIT 6,A:JR Z,$+4:SET 6,C
        CP C:JR NZ,SNM3:INC C

        INC L
.5      CALL UCH:JR NC,SNMX
.3      INC L
.6      CALL UCH:JR NC,SNMX
.2      INC L
.2      CALL UCH:JR NC,SNMX
        DEC L

        LD A,C:CP #40:JR NC,NXLEXI

        OR A:LD C,64-1:SBC HL,BC
        LD C,A:JR C,SNM3
        JP LNPARS

NXLEXI  XOR A:LD (DE),A:INC DE
        LD HL,(CGHL)
        LD C,32+16+3:ADD HL,BC
        LD (CGPZ),HL
        LD A,1:OR A
        RET

SNMX    JR NZ,NXLEXI
SNM3    LD HL,(CGHL),DE,(CGDE)
SNM2    LD A,L:AND #F0:LD L,A
        LD C,32:JR SNM+2
SNM     LD C,21:ADD HL,BC

Snm     LD B,8
SNA     LD A,(HL)
        CALL Acs:LD (DE),A:INC DE,L
        DJNZ SNA

        LD B,8
SNM_    DEC DE:LD A,(DE)
        CP " ":JR NZ,$+4:DJNZ SNM_
        INC DE

        LD A,L:AND #F0:OR 8:LD L,A
        PUSH DE
        LD A,".",(DE),A:INC DE
_LD A,(HL):CALL Acs:LD (DE),A:INC DE,L
_LD A,(HL):CALL Acs:LD (DE),A:INC DE,L
_LD A,(HL):CALL Acs:LD (DE),A:INC DE,L
        POP BC
        BIT 4,(HL):JR Z,SNMD
.3      DEC DE:LD A,(DE):CP 32:JR NZ,SNm
        LD DE,BC
        JR SNMD
SNm     INC DE

SNMD    XOR A:LD (DE),A:INC DE
        LD BC,21:ADD HL,BC

        LD (CGPZ),HL
        LD A,1:OR A
        RET
;-------
UCH     INC L
        LD A,(HL):OR A:JR NZ,UCHX
        DEC L:LD A,(HL):INC L,L
        OR A:JR Z,UCHE
        LD (DE),A:INC DE
        CP #80:RET C
UCH_    XOR A:RET
UCh_    INC L:XOR A:RET
UCHE    LD A,1:OR A:RET

UCHX    CP 4:JR NZ,UCh_
        DEC L:LD A,(HL):INC L,L
        CP #01:JR Z,HYO
        CP #10:JR C,UCH_
        CP #3F+1:JR C,DGG
        CP #4F+1:JR C,DEE
        CP #51:JR Z,LYO
        XOR A
        RET
DGG     ADD A,#70:LD (DE),A:INC DE
        SCF:RET
DEE     ADD A,#A0:LD (DE),A:INC DE
        SCF:RET
HYO     LD A,#F0,(DE),A:INC DE:SCF:RET
LYO     LD A,#F1,(DE),A:INC DE:SCF:RET
;-------
Acs     CP #80:JR NC,RU3
        CP #40+1:RET C
        CP #5B:RET NC
        SET 5,A
        RET
RU3     CP #F0:JR NZ,$+3:INC A
        CP #F1:RET Z
        CP #A0:RET NC
        CP #90:JR NC,RU4
        SET 5,A:RET
RU4     ADD A,#50:RET
;-------
LNCRC   XOR A
.11     RRCA:ADD A,(HL):INC L
        RET
;-------
NXTINI  LD HL,1
        LD (CGFL),HL

        LD HL,LSTCAT:CALL GIPAG

        LD HL,NXTBU,(CGPZ),HL,B,NXTBZ
        CALL LOAD512
        LD (HL),0
        RET

;---------------------------------------
GENTRY  ;i:HL(32) -> ENTRY
        LD DE,ENTRY,BC,32:LDIR
        RET

TENTRY  ;i:DE(32) <- ENTRY
        LD HL,ENTRY,BC,32:LDIR
Z0      RET

;GIVE/TAKE Active DIR:
GLSTCAT ;i:HL(4) - CLUS num
        LD DE,LSTCAT,BC,4:LDIR
        LD (CGFL),BC
        RET

TLSTCAT ;i:DE(4) - Addres of value
        LD HL,LSTCAT,BC,4:LDIR
        RET

;---------------------------------------
;READ SECTORS WITH POSITIONING:
RDD     ;i:[DE,HL] - SEC number
;               BC - Address
;                A - number
        PUSH BC
        CALL XPOZI
        POP HL
        JP RDDSE

;SAVE SECTORS WITH POSITIONING:
SDD     ;i:[DE,HL] - SEC number
;               BC - Address
;                A - number
        PUSH BC
        CALL XPOZI
        POP HL
        JP SDDSE

;---------------------------------------
;SKIP DATA from FAT32:
LOADNON LD DE,Z0,(NW0+1),DE
        CALL LOAD512
        LD DE,RDDSE,(NW0+1),DE
        RET

;READ DATA from FAT32(256+256):
LOAD256 LD DE,RDD256,(NW0+1),DE
        CALL LOAD512
        LD DE,RDDSE,(NW0+1),DE
        RET

;SAVE DATA to FAT32 (STREAM):
SAVE512 LD DE,SDDSE,(NW0+1),DE
        CALL LOAD512
        LD DE,RDDSE,(NW0+1),DE
        RET

;---------------------------------------
;READ DATA from FAT32 (STREAM):
LOAD512 ;i:HL - Address
;           B - lenght (512b blocks)
;     CUHL(4) - CLUSnum (if EOC+NSDC=0!)
;        o:HL - New value
;           A - EndOfChain

        XOR A:LD (ABT),A
        CALL LPREX:JR NZ,RH

        LD A,B:CALL NEWCLA

RH      LD HL,(LDHL)
        LD A,(EOC)
        RET

;Positioning to Cluster, if needed:
LPREX   LD (LDHL),HL
        LD A,(EOC):OR A:RET NZ
        LD A,(NSDC):OR A:JR NZ,RX

        PUSH BC:LD HL,CUHL:CALL GIPAG
        POP BC
        RET
RX      XOR A
        RET
;-------
NEWCLA  LD (BZN),A

NXTC    LD HL,(LTHL),DE,(LTDE):CALL PROZ

        LD HL,BZN
        LD A,(BSECPC),BC,(NSDC)
        SUB C:LD B,A
        LD A,(HL):OR A:RET Z
        SUB B:JR NC,KN
        ADD A,B:LD B,A:XOR A
KN      LD (HL),A

        LD A,B,(NR0),A
        LD HL,(LDHL)
NW0     CALL RDDSE;       READ Sector(s)
        LD (LDHL),HL;   updating Address

        LD HL,LTHL,DE,LLHL,BC,4:LDIR

        LD HL,(LTHL),DE,(LTDE)
_LD BC,(NR0):ADD HL,BC:JR NC,$+3:INC DE
        LD (LTHL),HL,(LTDE),DE

        LD HL,NSDC,A,C:ADD A,(HL)
        LD (HL),A

        LD BC,(BSECPC)
        CP C:JP C,NXTC;  End OF Cluster?
;                        YES!

        LD HL,(CUHL),DE,(CUDE)
        CALL CURIT,GIPAG:JP Z,NXTC
        RET

;------Searching for free Cluster:------
SRHFCL  LD HL,FSTFRC,DE,CAHL,BC,4:LDIR
SRHFC   ;i:[CADE,CAHL]-Cluster number
;        o:[DE,HL]- Cluster number
;          EXX HL - position in BUFFER+4

        LD HL,(CAHL),DE,(CADE)
        CALL CURIT:RET C

FC      LD A,(HL):INC HL
        OR (HL):INC HL
        OR (HL):INC HL
        OR (HL):INC HL:JR Z,GETZE

        EX DE,HL
        LD HL,CAHL
        INC (HL):JP NZ,AGA:INC HL
        INC (HL):JR NZ,AGA:INC HL
        INC (HL):JR NZ,AGA:INC HL
        INC (HL)
AGA     EX DE,HL
        LD A,H:CP SECBE[:JP C,FC

        LD HL,(LTHL),DE,(LTDE):INC HL
        LD A,H:OR L:JR NZ,$+3:INC DE
        CALL XPOZI

        LD HL,SECBU,A,1:CALL RDDSE
        LD HL,SECBU
        JP FC
;-------
GETZE   EXX
        LD HL,(CAHL),DE,(CADE)
        PUSH HL:LD HL,CAHL:CALL INC4b
        POP HL
        XOR A
        RET

;------Read Sector from FAT:------------
CURIT   ;i:[DE,HL]-Cluster number
;        o:SECBU(512)
;          HL-poz in SECBU where Cluster

        CALL DEL128
.2      SLA C:RL B

        PUSH BC
        LD (LSTSE+2),DE,(LSTSE),HL

        LD BC,(BFTSZ+2)
        LD A,D:CP B:JR C,JK
        LD A,E:CP C:JR C,JK
        LD BC,(BFTSZ)
        LD A,H:CP B:JR C,JK
        LD A,L:CP C:JR NC,FATEND

JK      LD BC,(SFAT)
        CALL ADD4B
        CALL XSPOZ
        CALL XPOZI
        LD HL,SECBU,A,1:CALL RDDSE
        POP BC
        LD HL,SECBU:ADD HL,BC
        XOR A
        RET
;-------
FATEND  POP BC
        SCF
        RET

;----Pos. to First Sector of Cluster:---
GIPAG   ;i:HL(4) - Cluster number
        CALL TOS

        LD E,(HL):INC HL
        LD D,(HL):INC HL
        LD A,(HL):INC HL
        LD H,(HL),L,A:OR H,E,D:JR Z,RDIR

        LD A,H:AND #0F:CP #0F:JR Z,MDC
        EX DE,HL
POM     LD (CUHL),HL,(CUDE),DE

_LD BC,2:OR A:SBC HL,BC:JR NC,$+3:DEC DE

        LD A,(BSECPC):CALL UMNOX2
        LD BC,(SDFAT):CALL ADD4B
        EX DE,HL
        LD BC,(SDFAT+2):ADD HL,BC
        EX DE,HL
        CALL XSPOZ
        CALL XPOZI
        XOR A
        RET

RDIR    LD HL,(BROOTC),DE,(BROOTC+2)
        JR POM

MDC     LD (EOC),A
        OR A
        RET

;---Getting Absolute Position of SEC:---
XSPOZ   LD BC,(ADDTOP),(CLHL),BC
        LD BC,(ADDTOP+2),(CLDE),BC
        JP ADD4BF

;-----ADD NEW ENTRY TO ACTIVE DIR:------
SVHDFL  ;i:HL - name(1-255),0
;          EFLG(1) - flag
;          LSTCAT(4)-active DIR
;          FCTS(4)-cluster num
;        o:[DE,HL]=FCTS(4)

        LD A,(EFLG):AND #10
        CALL ENTREZ:RET NZ
        LD (CGDE),HL

        LD HL,(LSTCAT),DE,(LSTCAT+2)
SHDFL   LD (CUHL),HL,(CUDE),DE
        CALL TOS
NXDCL   LD HL,LOBU,B,1:CALL LOAD512
        LD HL,LOBU,DE,32,B,16
        XOR A
FIEL    CP (HL):JP Z,FELD
        ADD HL,DE
        DJNZ FIEL
FIIL    LD A,(EOC):CP #0F:JR NZ,NXDCL
        CALL SRHFCL:JR C,IEL
        LD (BUTS),HL,(BUTS+2),DE
        EXX
        LD A,#FF
        DEC HL:LD (HL),#0F
        DEC HL:LD (HL),A
        DEC HL:LD (HL),A
        DEC HL:LD (HL),A
        LD HL,SECBU,A,1:CALL SDDSE

        LD HL,(CUHL),DE,(CUDE)
        CALL CURIT:JR C,IEL
        EX DE,HL
        LD HL,BUTS,BC,4:LDIR
        LD HL,SECBU,A,1:CALL SDDSE

        LD HL,BUTS
        CALL GIPAG:LD A,255:RET NZ

        LD HL,SECBU,B,0
.2      CALL NOPING

        LD HL,(LTHL),DE,(LTDE)
        PUSH HL,DE
        LD HL,SECBU,A,1:CALL SDDSE

        LD A,(BSECPC)
        LD HL,SECBU:CALL NOPCLA
        POP DE,HL
        CALL XPOZI
        JP NXDCL

IEL     LD A,16:OR A:RET

FELD    EX DE,HL
        LD HL,(CGDE)
VYG     LD BC,32:LDIR
        LD BC,0-64:ADD HL,BC
        LD A,H:CP NXTBM[:JR C,FFLD

        LD A,E:OR A:JR NZ,VYG
        BIT 0,D:JR NZ,VYG
        LD (CGDE),HL
        CALL FFld
        JP FIIL

FFLD    XOR A:LD (DE),A
FFld    LD HL,(LLHL),DE,(LLHL+2)
        CALL PROZ
        LD HL,LOBU
        LD A,1:CALL SDDSE

        LD HL,(FCTS),DE,(FCTS+2)
        XOR A
        RET

;-------ETRY'S GENERATING:
ENTREZ  ;i: A - flag
;          HL - name(1-255),0
;     FCTS(4) - cluster
;
;        o: Z - OK
;          NZ - error
;               A:1 - ln not valid
;                 2 - sn index fatality
;                 3 - ln already exists

        LD DE,NXTBU
        LD BC,255+1
        PUSH DE
        LD (DE),A,(ENTRY+11),A:INC DE
        LDIR
        POP HL
        LD (CGDE),HL
        INC HL:CALL ENVAL:LD A,1:RET NZ

        LD HL,(FCTS),(CLSHL),HL
        LD HL,(FCTS+2),(CLSDE),HL

        LD HL,(CGDE):CALL LNLNG
        JP Z,ENnvl

        LD B,11,HL,ENTRY
SNCC    LD A,(HL):OR A:JR Z,LONG
        CALL SNCEN:JR Z,LONG
        INC HL:DJNZ SNCC

        LD HL,ENTRY
        LD DE,NXTBM
        PUSH DE:LD BC,33:LDIR
        LD HL,NXTBU:CALL SRHDRN:LD A,4
        POP HL:RET NZ
        XOR A
        RET
;-------
LONG    LD DE,ENTRY

        LD B,8,HL,NXTBU
FO      INC HL:LD A,(HL)
KO      CALL ACS
        CALL ENCEN:JR Z,KZ
        CALL SNCEN:JR NZ,KC
KZ      LD A,R:AND %01111111:JR KO
KC      CP " ":JR NZ,$+4:LD A,"_"
        LD (DE),A:INC DE:DJNZ FO
        PUSH DE:LD B,3:CALL NOP32
        POP DE

        LD HL,NXTBU:BIT 4,(HL):JR NZ,NN
        INC HL
        XOR A:LD BC,256:CPIR:DEC HL

        LD B,4
UR      DEC HL:LD A,(HL)
        OR A:JR Z,NN
        CP ".":JR Z,NB
        DJNZ UR:JR NN

NB      LD B,3
Nb      INC HL:LD A,(HL)
        CALL ACS,SNCEN:JR Z,NN
        LD (DE),A:INC DE:DJNZ Nb
;-------
NN      LD HL,ENTRY,DE,NXTBM,BC,32:LDIR

        LD HL,ENTRY
        LD DE,NXTBM-32,(CGDE),DE
        LD A,(NXTBU),(DE),A:INC DE
        LD BC,#08FF
ATB     LDI:DJNZ ATB:BIT 4,A:JR NZ,AT
        LD A,".",(DE),A
        LD A," ":CP (HL):JR Z,AT:INC DE
        LD B,3
ATb     LDI:CP (HL):JR Z,$+4:DJNZ ATb
AT      XOR A:LD (DE),A

        LD HL,NXTBM-64,A,#30
        LD B,5,(HL),A:INC HL:DJNZ $-2

BURA    LD HL,NXTBM-64+3
        PUSH HL:CALL INDEX:LD A,2
        POP HL:RET NZ

        LD DE,NXTBM-32+7+1
        LD BC,#03FF,A,#30
ZZBZ    LDD:CP (HL):JR Z,$+4:DJNZ ZZBZ
        LD A,#7E,(DE),A

        LD HL,NXTBM-32+1,DE,ENTRY
        LD BC,8:LDIR:INC HL:LD C,3:LDIR
        CALL FNDSN:JR NZ,BURA

        LD HL,NXTBM-32+1
        LD DE,NXTBM
        PUSH DE:LD BC,8:LDIR
        POP HL:CALL LNCRC:LD (CRC+1),A

        LD HL,NXTBM+32
        LD DE,NXTBU+1
        LD BC,#0001
DNB     LD (HL),C:INC C,HL
.5      CALL OEM2UC
        LD (HL),#0F:INC HL
        LD (HL),#00:INC HL
CRC     LD (HL),0:INC HL
.6      CALL OEM2UC
        LD (HL),#00:INC HL
        LD (HL),#00:INC HL
.2      CALL OEM2UC
        LD A,(DE):OR A:JR NZ,DNB

        LD (HL),0
        LD BC,0-32:ADD HL,BC:SET 6,(HL)

        PUSH HL
        LD HL,NXTBU
        CALL SRHDRN:LD A,3
        POP HL:RET NZ
        XOR A
        RET
;-------
INDEX   LD B,3
XED     LD A,(HL):CP #39:JR C,DEX
        LD (HL),#30:DEC HL:DJNZ XED
        XOR A:INC A
        RET
DEX     INC (HL):XOR A:RET
;-------
FNLZ    LD (HL),B:INC HL
        LD (HL),B:INC HL
        LD B,#FF
        RET
OEM2UC  LD A,(DE):OR A:JR Z,FNLZ:INC DE
        PUSH BC
        LD C,A,B,0:CP #80:CALL NC,ORU
        LD (HL),C:INC HL
        LD (HL),B:INC HL
        POP BC
        RET
ORU     LD B,4
        CP #F0:LD C,#01:RET Z
        CP #F1:LD C,#51:RET Z
        CP #B0:JR NC,OR2
        SUB #70:LD C,A:RET
OR2     CP #F0:RET NC
        CP #E0:RET C
        SUB #A0:LD C,A:RET
;-------
ENVAL   LD B,255
ENval   LD A,(HL):OR A:JR Z,ENvld
        CALL ENCEN:JR Z,ENnvl
        INC HL:DJNZ ENval
ENnvl   XOR A:INC A
        RET
ENvld
CHI     INC B:JR Z,ENnvl
        DEC HL:LD A,(HL):CP " ":JR Z,CHI
        DEC B
Chi     INC B:JR Z,ENnvl
        LD A,(HL):DEC HL:CP ".":JR Z,Chi
        INC HL,HL
        XOR A:LD (HL),A
        RET
;-------
SNCEN   CP #2B:RET Z;+
        CP #2C:RET Z;,
        CP #2E:RET Z;.
        CP #3B:RET Z;;
        CP #3D:RET Z;=
        CP #5B:RET Z;[
        CP #5D:RET Z;]
        RET

ENCEN   CP #20:JR C,MU

        CP #22:RET Z
        CP #2A:RET Z
        CP #2F:RET Z
        CP #3A:RET Z
        CP #3C:RET Z
        CP #3E:RET Z
        CP #3F:RET Z
        CP #5C:RET Z
        CP #7C
        RET
MU      CP A
        RET

;-----Generate Chain in FAT:------------
ERG2    LD HL,FCTS:CALL DLSG
        LD HL,FCTS,DE,FSTFRC,BC,4:LDIR
ERG1    LD A,16:OR A
        RET
;-------
MKSG    ;i:[DE,HL] - Number of Bytes
;       FSTFRC - First free Cluster
;o:FCTS(4)-First Cluster in New Chain
;FSTFRC(4)-New value

        CALL DEL512
        LD A,(BSECPC):CALL DELITX2

        LD (CLCNT+2),DE
        LD (CLCNT+0),HL

        CALL SGENBU:JR C,ERG1
ROSTIK  CALL PREPFC:JR C,ERG2
        CALL BUtoFAT:RET Z
        CALL SGENB2:JR C,ERG2
        JR ROSTIK
;---------------------------------------
SGENBU  LD HL,GENBU,(GARY),HL

        CALL SRHFCL:RET C
        LD (FCTS),HL,(FCTS+2),DE
GENB    LD (FSTFRC),HL,(FSTFRC+2),DE

        LD A,H,C,L
        LD HL,(GARY)
        LD (HL),C:INC HL
        LD (HL),A:INC HL
        LD (HL),E:INC HL
        LD (HL),D:INC HL
        LD (GARY),HL
        XOR A
        RET
;-------
SGENB2  CALL SRHFC:RET C
        JR GENB
;-------
PREPFC  LD HL,(CLCNT):DEC HL
        LD (CLCNT),HL
        LD A,H:OR L:JR Z,EOFG

AMM     EXX
        LD A,H:CP SECBE[
        JR C,ARM
        CALL SRHFC:RET C
        JR AR2
ARM     CALL FC
AR2     LD (FSTFRC),HL,(FSTFRC+2),DE
;-------
        LD A,H,C,L
        LD HL,(GARY)
        LD (HL),C:INC HL
        LD (HL),A:INC HL
        LD (HL),E:INC HL
        LD (HL),D:INC HL
        LD A,H:CP GENBE[:RET NC
        LD (GARY),HL
        JP PREPFC
;-------
EOFG    LD HL,(CLCNT+2)
        LD A,H:OR L:JR NZ,AmM

        LD DE,#0FFF
        LD HL,(GARY)
        LD (HL),E:INC HL
        LD (HL),E:INC HL
        LD (HL),E:INC HL
        LD (HL),D:INC HL
        LD (GARY),HL
        RET
;-------
AmM     DEC HL:LD (CLCNT+2),HL:JP AMM
;---------------------------------------
BUtoFAT LD HL,GENBU
GENFC   LD C,(HL):INC HL
        LD B,(HL):INC HL
        LD E,(HL):INC HL
        LD D,(HL):INC HL
;-------
        PUSH HL
        LD HL,BC:CALL CURIT:EX DE,HL
        POP HL

GNFC    LD (UUHL),HL
        LD BC,4:LDIR

_DEC HL:LD A,(HL):CP #0F:JR Z,LSTSR
_INC HL:LD A,H:CP GENBE[:JR NC,LSTsr

        LD HL,(UUHL)
        LD C,(HL):INC HL
        LD B,(HL):INC HL
        LD E,(HL):INC HL
        LD D,(HL):INC HL
        LD (BUHL),HL

        LD HL,BC:CALL DEL128
        LD BC,(LSTSE)
        OR A:SBC HL,BC:JR NZ,GGC
        EX DE,HL:LD BC,(LSTSE+2)
        OR A:SBC HL,BC:JR Z,GFC

GGC     LD HL,SECBU,A,1:CALL SDDSE
        LD HL,(UUHL)
        JP GENFC

GFC     LD H,0,L,A
.2      SLA L:RL H
        LD BC,SECBU:ADD HL,BC
        EX DE,HL
        LD HL,(BUHL)
        JR GNFC
;-------
LSTSR   LD HL,SECBU:LD A,1:CALL SDDSE
;CALL RFRH
        XOR A
        RET
;-------
LSTsr   CALL LSTSR
        LD HL,(UUHL),DE,GENBU,BC,4:LDIR
        LD (GARY),DE

        LD A,1:OR A
        RET

;-----Delete Chain from FAT:------------
DLSG    ;i:HL(4) - Cluster number

        LD DE,LOBU,BC,4:LDIR
        LD HL,0
        LD (FSTFRC),HL
        LD (FSTFRC+2),HL
LWT     LD HL,(LOBU),DE,(LOBU+2)
        LD A,D:CP #0F:RET Z
        OR E,H,L:RET Z

        CALL CURIT:RET C
GOCE    LD DE,LOBU,C,0
.3      LD A,(HL),(HL),C,(DE),A:INC L,E
        LD A,(HL),(HL),C,(DE),A

        LD HL,(LOBU),DE,(LOBU+2)
        LD A,D:CP #0F:JR Z,Ne
        CALL DEL128
        LD BC,(LSTSE)
        OR A:SBC HL,BC:JR NZ,NE:EX DE,HL
        LD BC,(LSTSE+2)
        OR A:SBC HL,BC:JR NZ,NE

        LD H,0,L,A
.2      SLA L:RL H
        LD BC,SECBU:ADD HL,BC
        JP GOCE

NE      LD HL,SECBU,A,1:CALL SDDSE
        JP LWT
Ne      LD HL,SECBU,A,1:JP SDDSE

;-----Searching ENTRY in Active DIR:----
SRHDRN  ;i:LSTCAT(4) - Active DIR
;          HL - Buffer with Name
;               [flag(1),name(1-255),0]
;        o: Z: NOT FOUNT
;          NZ: ENTRY(32)
;              [DE,HL] - Cluster Number
;              BC - Address in LOBU/LOB2

        LD (CGDE),HL:CALL LNLNG:RET Z

FNDSN   LD HL,LSTCAT,DE,CUHL,BC,4:LDIR
        CALL TOS

        LD HL,LOBU,B,1:CALL LOAD512

        LD HL,LOBU
ANNA    CALL ENTCH:JR Z,FND
        LD BC,32:ADD HL,BC
        LD A,H:CP LOBU2[:JR C,ANNA

HDR     LD A,(EOC):CP #0F:RET Z
        PUSH HL
        LD HL,LOBU2,B,1:CALL LOAD512
        POP HL
AnnA    CALL ENTCH:JR Z,FND
        LD BC,32:ADD HL,BC
        LD A,H:CP LOBE2[:JR C,AnnA

        EXX
        LD HL,LOBU2,DE,LOBU,BC,512:LDIR
        EXX:LD BC,0-512:ADD HL,BC
        JR HDR

FND     OR A:RET Z
        LD HL,(CLSHL)
        LD DE,(CLSDE)
        XOR A:INC A
        RET
;-------
NOP32   LD A," ",(DE),A:INC DE:DJNZ $-2
        RET
LNe     XOR A:RET
LNLNG   LD A,(HL):INC HL
        AND %11101111:JR NZ,LNe

        LD BC,256:XOR A:CPIR:JR NZ,LNe
        LD A,256-1:SUB C:JR Z,LNe

        LD HL,(CGDE)
        BIT 4,(HL):JR NZ,KAT

MURMUR  LD C,12+1:SUB C:JR NC,NESN
        ADD A,C
        LD C,A:ADD HL,BC

        EXA
        LD B,4,DE,ENTRY+8
FEL     LD A,(HL):DEC C:JR Z,FEL4
        CP ".":JR Z,FELE
        DEC HL:DJNZ FEL
FEL4    EXA
        LD C,A
        LD B,3
FEL3    CALL NOP32
FEL2    LD DE,ENTRY
        LD A,C:CP 8+1:JR NC,NESN

        LD B,A,A,8:SUB B:LD C,A
        LD HL,(CGDE)
FEEL    INC HL:LD A,(HL):CALL ACS
        LD (DE),A:INC DE:DJNZ FEEL

        LD B,C,A,B:OR A:CALL NZ,NOP32
        JR ENTch

FELE    LD B,3
FEL5    INC HL:LD A,(HL):OR A:JR Z,FEL3
        CALL ACS
        LD (DE),A:INC DE
        DJNZ FEL5
        JR FEL2
;-------
KAT     CP 3+1:JR NC,MURMUR
        LD C,A
        INC HL:LD A,(HL):CP "."
        DEC HL:LD A,C:JR NZ,MURMUR
        INC HL,HL:LD A,(HL):CP "."
        DEC HL,HL:LD A,C:JR NZ,MURMUR

;LD C,8+1:SUB C:JR NC,NESN
;ADD A,C

        LD DE,ENTRY
        LD B,A,A,11:SUB B:LD C,A
KaT     INC HL:LD A,(HL):CALL ACS
        LD (DE),A:INC DE:DJNZ KaT

        LD B,C:CALL NOP32
        JR ENTch

NESN    XOR A:LD (ENTRY),A
ENTch   LD A,1:OR A:RET
;-------
ENTCH   LD A,(HL)
        OR A:RET Z
        CP #E5:JR Z,ENTch

        LD A,L:ADD A,11:LD L,A
        BIT 3,(HL):JP NZ,ENTCHe

        LD DE,(CGDE)
        LD A,(HL):AND #10:LD B,A
        LD A,(DE):CP B:JP NZ,ENTCHe

        LD A,(ENTRY):OR A:JR Z,LNEB
        LD A,L:AND #F0:LD L,A
        LD B,11,DE,ENTRY
SNCH    LD A,(DE):CP (HL):JR NZ,LNEB
        INC DE,L:DJNZ SNCH
        JP ENTFND

LNEB    LD A,L:AND #F0:LD L,A
        CALL LNCRC
        LD (CGHL),HL

        LD BC,0-30:ADD HL,BC
        CP (HL):JR NZ,ENTCHE
        LD A,H:CP LOBU[:JR C,ENTCHE
.2      DEC L
        LD A,(HL):CP #0F:JR NZ,ENTCHE

        LD DE,(CGDE):INC DE
        LD A,L:AND #F0:LD L,A

        LD B,1
LNPARZ  LD A,(HL)
        BIT 6,A:JR Z,$+4:SET 6,B
        CP B:JR NZ,ENTCHE:INC B

        INC L
.5      CALL ULNP:JR NC,ENTST
.3      INC L
.6      CALL ULNP:JR NC,ENTST
.2      INC L
.2      CALL ULNP:JR NC,ENTST
        DEC L

        LD A,B:CP #40:JP NC,ENTFNDL

        LD BC,0-(64-1):ADD HL,BC:LD B,A
        LD A,H:CP LOBU[:JR C,ENTCHE
        JP LNPARZ
;-------
ENTST   JR NZ,ENTFNDL
ENTCHE  LD HL,(CGHL)
ENTCHe  LD A,L:AND #F0:LD L,A
        LD A,1:OR A
        RET

ENTFNDL LD HL,(CGHL)
ENTFND  LD A,L:AND #F0:LD L,A
        PUSH HL:LD DE,ENTRY,BC,32:LDIR
        POP BC
        XOR A:LD A,1
        RET
;-------
ULNP    LD A,(DE):INC DE:OR A:JR Z,UlnP
        CALL ACS:LD C,A
        CALL UCS:OR A:RET Z
        CALL ACS:CP C:JR Z,ULNp
ULNz    XOR A:RET
ULNp    SCF:RET
UlnP    CALL UCS:INC A:JR NZ,ULNz
        LD A,1:OR A
        RET
;-------
ACS     CP #80:JR NC,RUS
        CP #60+1:RET C
        CP #7B:RET NC
        RES 5,A
        RET
RUS     CP #A0:RET C
        CP #B0:JR NC,RU2
        RES 5,A
        RET
RU2     CP #E0:RET C
        CP #F2:RET NC
        CP #F1:JR NZ,$+3:DEC A
        CP #F0:RET Z
        SUB #50
        RET
;-------
UCS     INC L
        LD A,(HL):OR A:JR NZ,UCSX
        DEC L:LD A,(HL):INC L,L
        OR A:JR Z,UCSE
        CP #80:RET C
UCS_    XOR A:RET
UCSE    LD A,#FF:RET

UCSX    CP 4:JR NZ,UCS_
        DEC L:LD A,(HL):INC L,L
        CP #01:JR Z,Hyo
        CP #10:JR C,UCS_
        CP #3F+1:JR C,Dgg
        CP #4F+1:JR C,Dee
        CP #51:JR Z,Lyo
        JR UCS_
Dgg     ADD A,#70:RET
Dee     ADD A,#A0:RET
Hyo     LD A,#F0:RET
Lyo     LD A,#F1:RET

;---------------------------------------
;DELETE FILE/DIR:
DELFL   ;i:HL - flag(1),name(1-255),0
;        o: Z - not found
;          NZ - file deleted

        CALL DELEN:RET Z
DELCHA  PUSH AF:LD HL,FCTS:CALL DLSG
        POP AF
        RET

DELEN   CALL SRHDRN:LD A,8:RET Z

        LD (FCTS+0),HL
        LD (FCTS+2),DE

        LD A,#E5,(BC),A
        LD H,B,L,0:RES 0,H:CALL STAMP
        XOR A:INC A
        RET
;-------
STAMP   PUSH HL
        LD HL,(LLHL),DE,(LLHL+2)
        CALL PROZ
        POP HL

        LD A,1:JP SDDSE
;---------------------------------------
;RENAME ENTRY:
RENAME  ;i:HL - flag(1),oldname(1-255),0
;          DE - newname(1-255),0
;        o: Z - not found
;          NZ - success

        PUSH HL,DE
        CALL SRHDRN:LD A,8
        LD (FCTS+0),HL
        LD (FCTS+2),DE
        POP HL,DE:RET Z

        PUSH DE:CALL SVHDFL
        POP HL:JR NZ,ZIR

        CALL DELEN:RET Z

        XOR A:INC A:RET
ZIR     CP A:RET
;---------------------------------------
;MAKE NEW FILE:
MKFILE  ;i:HL - flag(1),ln(4),name,0

        LD A,(HL),(EFLG),A:INC HL
        LD DE,SIZIK,BC,4:LDIR
        LD (CGHL),HL

        LD HL,(SIZIK),DE,(SIZIK+2)
        CALL MKSG:RET NZ
        LD HL,(CGHL)
        CALL SVHDFL:JP NZ,DELCHA
        XOR A
        RET

;---------------------------------------
;MAKE NEW DIRECTORY:
MKDIR   ;i:HL - DirName(1-255),0

        LD (CGHL),HL
        LD HL,0,(SIZIK),HL,(SIZIK+2),HL
        LD A,#10,(EFLG),A
        LD DE,0,HL,512
        CALL MKSG:RET NZ
        LD HL,(CGHL)
        CALL SVHDFL:JP NZ,DELCHA
        LD HL,FCTS
        CALL GIPAG

        LD HL,ENTRY
        LD (HL),".":INC HL
        LD (HL),#20:INC HL
        LD A,32,B,9:CALL NOPING+1
        LD HL,(CUHL),(CLSHL),HL
        LD HL,(CUDE),(CLSDE),HL
        LD HL,ENTRY,DE,LOBU,BC,32:LDIR

        LD HL,ENTRY+1
        LD (HL),"."
        LD HL,(LSTCAT),(CLSHL),HL
        LD HL,(LSTCAT+2),(CLSDE),HL
        LD HL,ENTRY,BC,32:LDIR

        LD HL,DE:INC DE
        LD BC,512;-64-1
        LD (HL),0
        LDIR
        LD HL,LOBU
        LD A,1:CALL SDDSE

        LD A,(BSECPC)
        LD HL,LOBU+64
        CALL NOPCLA
        XOR A
        RET

RFRH    LD HL,(FSINF),DE,(FSINF+2)
        CALL XPOZI
        LD HL,LOBU
        LD A,1:CALL RDDSE
        LD HL,FSTFRC,DE,LOBU+492,BC,4
        LDIR
        LD HL,LOBU
        LD A,1:CALL SDDSE
        RET
;---------------------------------------
;CHAIN->SECTORS:
CHTOSE  ;i:HL(4) - First Cluster number
;             DE - BUFFER Address
;             BC - End Of BUFFER

        LD (DABC),BC
        LD (DADE),DE
CKAGO   LD (DAHL),HL

        CALL GIPP:RET Z
        CALL CLUSSEC
        LD DE,(DABC)
        OR A:SBC HL,DE:RET NC

        LD HL,(DAHL)
        LD E,(HL):INC HL
        LD D,(HL):INC HL
        LD A,(HL):INC HL
        LD H,(HL),L,A:EX DE,HL

        CALL CURIT
        JR CKAGO

;-------
CLUSSEC ;i:  (DADE) - Buffer Address
;          (BSECPC) - Sectors per CLUS
;           [DE,HL] - Sector number
;
;        o:  (DADE) - New Value

        LD BC,HL
        LD A,(BSECPC)
        LD HL,(DADE)
USS     LD (HL),C:INC HL
        LD (HL),B:INC HL
        LD (HL),E:INC HL
        LD (HL),D:INC HL
        LD (DADE),HL:DEC A:RET Z

        INC BC
        EXA:LD A,B:OR C:JR NZ,$+3:INC DE
        EXA
        JR USS

;-------
GIPP    ;i:  HL(4) - Cluster number
;        o:[DE,HL] - Sector number
;                Z - EndOfChain

        LD E,(HL):INC HL
        LD D,(HL):INC HL
        LD A,(HL):INC HL
        LD H,(HL),L,A:OR H,E,D:RET Z
        LD A,H:CP #0F:RET Z
        EX DE,HL

_LD BC,2:OR A:SBC HL,BC:JR NC,$+3:DEC DE

        LD A,(BSECPC):CALL UMNOX2
        LD BC,(SDFAT):CALL ADD4B
        EX DE,HL
        LD BC,(SDFAT+2):ADD HL,BC
        EX DE,HL
        CALL XSPOZ

        LD A,1:OR A
        RET

;---------------------------------------
;SEARCH PARTITION:
HDD     ;i:none
;        o:NZ - FAT32 not found
;           Z - all FAT32 vars are
;               initialized

        LD HL,0,DE,HL
        LD (CUHL),HL,(CUDE),HL
        LD (DAHL),HL,(DADE),HL
        LD (DUHL),HL,(DUDE),HL
        CALL XPOZI
        LD HL,LOBU,A,1:CALL RDDSE

        LD A,3,(COUNT),A,(ZES),A

        LD HL,LOBU+446+4,DE,16,B,4
KKO     LD A,(HL)
        CP #05:JR Z,OKK
        CP #0B:JR Z,OKK
        CP #0C:JR Z,OKK
        CP #0F:JR Z,OKK
        ADD HL,DE
        DJNZ KKO

FHDD    LD A,(ZES):OR A:JP Z,Nhdd

        LD DE,(DADE),HL,(DAHL)
        CALL XPOZI

        LD HL,LOBU:LD A,1:CALL RDDSE

        LD HL,COUNT:DEC (HL):JP Z,NHDD

        LD HL,LOBU+446+16,B,16
        XOR A:OR (HL):INC HL:DJNZ $-2
        JP NZ,NHDD

        LD HL,(LOBU+446+16+8)
        LD DE,(LOBU+446+16+8+2)
        LD (CLHL),HL,(CLDE),DE
        LD HL,(DAHL),DE,(DADE)
        CALL ADD4BF
        LD (DADE),DE,(DAHL),HL
        CALL XPOZI

        LD HL,LOBU,A,1:CALL RDDSE

        LD HL,(LOBU+446+8)
        LD DE,(LOBU+446+8+2)
        CALL ADD4BF
        JR LDBPB

OKK     INC HL,HL,HL,HL
        LD E,(HL):INC HL
        LD D,(HL):INC HL
        LD A,(HL):INC HL
        LD H,(HL),L,A
        EX DE,HL

LDBPB   LD (ADDTOP),HL,(ADDTOP+2),DE
        CALL XPOZI

        LD HL,LOBU;LOAD BPB SECTOR
        LD A,1:CALL RDDSE

        LD HL,(LOBU+11)
        LD A,H:DEC A,A:OR L:JP NZ,FHDD
        LD A,(LOBU+13):OR A:JP Z,FHDD
        LD A,(LOBU+14):OR A:JP Z,FHDD
        LD A,(LOBU+16):OR A:JP Z,FHDD

        LD HL,(LOBU+17),A,H:OR L
        LD HL,(LOBU+22):OR H,L
        JP NZ,FHDD
        LD HL,(LOBU+36):OR H,L
        LD HL,(LOBU+36+2):OR H,L
        JP Z,FHDD

        LD A,(LOBU+13),(BSECPC),A
_LD B,8:SRL A:JR C,NER:DJNZ $-4:LD A,1
NER     OR A:JP NZ,FHDD
        LD HL,(LOBU+14),(BREZS),HL
        LD HL,(LOBU+48),DE,0
        CALL XSPOZ
        LD (FSINF),HL,(FSINF+2),DE

        LD A,(LOBU+16),(BFATS),A
        LD HL,(LOBU+36),(BFTSZ),HL
        LD HL,(LOBU+36+2),(BFTSZ+2),HL
        LD HL,(LOBU+44),(BROOTC),HL
        LD HL,(LOBU+44+2),(BROOTC+2),HL

        LD HL,(BFTSZ),DE,(BFTSZ+2)
        LD BC,(BFATS),B,0
        CALL UMN4B
        PUSH HL,DE
        LD HL,(BREZS)
        LD (SFAT),HL
        POP DE,BC
        CALL ADD4B
        LD (SDFAT),HL,(SDFAT+2),DE

        LD HL,0
        LD (CUHL),HL
        LD (CUDE),HL
        LD (LSTCAT),HL
        LD (LSTCAT+2),HL
        LD (CGFL),HL;4 NXTETY

;LD HL,(FSINF),DE,(FSINF+2)
;CALL XPOZI
;LD HL,LOBU
;LD A,1:CALL RDDSE
;LD HL,LOBU+492,DE,FSTFRC
;LD BC,4:LDIR
        LD HL,FSTFRC,B,4:CALL NOPING

        CALL TOS

        XOR A
        RET

NHDD    LD HL,(DUHL),DE,(DUDE)
        XOR A:LD (ZES),A
        JP LDBPB

Nhdd    LD A,1:OR A
        RET

;---------------------------------------
;ACTIVATE DRIVER:
DOS_SWP ;i:A - device number
;              0 - IDE NemoMaster
;              1 - SD ZC
;              2 - SD NGS
;              3 - IDE SmucMaster
;              4 - IDE SmucSlave
;              5 - IDE NemoSlave

        LD B,0
        LD HL,DR1:OR A:JR Z,DRR;  0
        LD HL,DR2:DEC A:JR Z,DRR; 1
        LD HL,DR3:DEC A:JR Z,DRR; 2
        LD HL,DR4:DEC A:JR Z,DRR; 3
        INC B:DEC A:JR Z,DRR;     4
        LD HL,DR1:DEC A:JR Z,DRR; 5
        LD HL,DR2

DRR     PUSH IX
        LD DE,DRVR
        PUSH BC:CALL DEHR
        POP AF:CALL SELDEV
        POP IX
        RET

;---------------------------------------
;ARITHMETICS BLOCK:
DEL128  ;i:[DE,HL]/128
;        o:[DE,HL]
;          BC - Remainder

        LD A,L:EXA
        LD A,L,L,H,H,E,E,D,D,0
        RLA
        RL L,H,E,D
        EXA
        AND 127
        LD B,0,C,A
        RET

DEL512  ;i:[DE,HL]/512
        LD A,L,L,H,H,E,E,D,D,0
        LD BC,1:OR A:CALL NZ,ADD4B
        LD A,2

DELITX2 ;i:[DE,HL]/A
;                A - Power of Two
;        o:[DE,HL]

        CP 2:RET C
        LD C,0
        SRL A
L33T    SRL D:RR E,H,L,C
        SRL A:JR NC,L33T

        LD A,C:OR A:RET Z
        LD BC,1:CALL ADD4B
        RET

UMNOX2  ;i:[DE,HL]*A
;                A - Power of Two
;        o:[DE,HL]

        CP 2:RET C
        SRL A
L33t    SLA L:RL H,E,D
        SRL A:JR NC,L33t
        RET

UMNOG   ;HL*BC=HL DEdest
        LD DE,HL
        LD A,B,B,C,C,A:INC C
        XOR A:DEC B:JR Z,ODN
BSR     ADD HL,DE
        DJNZ BSR
ODN     LD B,A
        DEC C
        JR NZ,BSR
        RET

INC4b   LD B,4
EkE     INC (HL):RET NZ:INC HL:DJNZ EkE
        RET

ADD4B   ADD HL,BC:RET NC:INC DE
        RET

ADD4BF  ;i:[DE,HL]+[CLDE,CLHL]
;        o:[DE,HL]
        EX DE,HL
        LD BC,(CLDE)
        ADD HL,BC
        EX DE,HL
        LD BC,(CLHL)
        ADD HL,BC:JR NC,KNH
        INC DE
KNH     LD (CLHL),HL
        LD (CLDE),DE
        RET

UMN4B   ;i:[DE,HL]*BC o:[DE,HL]
        LD A,B,B,C,C,A:INC C
        OR A:JR NZ,TEKNO
        DEC B:JR Z,UMN1
        INC B
TEKNO   XOR A
        CP B:JR NZ,TYS
        DEC C
TYS     DEC B
        PUSH HL,BC
        LD HL,DE
        CP B:JR Z,NEGRY
EFRO    ADD HL,DE
        DJNZ EFRO
        LD B,A
NEGRY   DEC C:JR NZ,EFRO
        LD (REZDE),HL
        POP BC,HL
        LD DE,HL
        CP B:JR Z,NEGRA
OFER    ADD HL,DE
        JR C,INCDE
ENJO    DJNZ OFER
        LD B,A
NEGRA   DEC C:JR NZ,OFER
        LD DE,(REZDE)
UMN1    RET
INCDE   EXX
        LD HL,(REZDE)
        INC HL
        LD (REZDE),HL
        EXX
        JR ENJO
;---------------------------------------
TOS     XOR A:LD (NSDC),A,(EOC),A
        RET

NOPCLA  LD (NOPCA+1),HL
NOPC    DEC A:RET Z
        PUSH AF
        LD HL,(LTHL),DE,(LTDE)
        LD BC,1:ADD HL,BC
        JR NC,$+3:INC DE
        CALL XPOZI

NOPCA   LD HL,0,A,1:CALL SDDSE
        POP AF
        JR NOPC

NOPING  XOR A:LD (HL),A:INC HL:DJNZ $-2
        RET
;---------------------------------------
GARY    DS 2;see MKSG

DABC    DS 2;see CHTOSE
DAHL    DS 2;see HDD proc.
DADE    DS 2; /
ZES     NOP ;/

DR1     INCB "DOSpNEMO"
DR2     INCB "DOSpSDZC"
DR3     INCB "DOSpSDGS"
DR4     INCB "DOSpSMUC"
DEHR    INCL "DEHR2"
END
