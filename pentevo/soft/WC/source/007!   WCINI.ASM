C000    EQU #C000
;---------------------------------------
F9STP   PUSH IX
        LD IX,F9WN2:CALL PRWOW
        LD IX,F9WND:CALL PRWOW
        LD HL,STP,DE,14,BC,6:CALL PRSRW
        LD A,%11110101:CALL PRIAT
_LD HL,STPL,DE,#030C,BC,11:CALL PRSRW
_LD HL,STPR,DE,#060B,BC,12:CALL PRSRW
_LD HL,SSAV,DE,#0B0A,BC,13:CALL PRSRW


STPM    EI:HALT
        LD DE,SBL1:XOR A:CALL PRCONF
        LD DE,SBL2,A,3:CALL PRCONF
        LD DE,SBL3,A,6:CALL PRCONF
        CALL CURSOR

        CALL ESC:JR NZ,STPE
        CALL UPPP,NZ,SCU
        CALL DWWW,NZ,SCD
        CALL ENKE,NZ,SEN:JR Z,STPM

STPE    CALL RRESB
        LD IX,F9WN2:CALL RRESB
        POP IX
        RET
;-------
SCU     CALL CURSER
        LD A,(IX+12)
        CP 4:JR Z,ScU
        CP 7:JR Z,ScU
        CP 11:JR Z,Sc2
Scu     CALL CURSOR
        JP CrUP
Sc2     DEC (IX+12)
ScU     DEC (IX+12):JR Scu

SCD     CALL CURSER
        LD A,(IX+12)
        CP 2:JR Z,ScD
        CP 5:JR Z,ScD
        CP 8:JR Z,Sc3
Scd     CALL CURSOR
        JP CrDN
Sc3     INC (IX+12)
ScD     INC (IX+12):JR Scd

SENE    LD BC,HL
        LD A,(HL):INC HL
        LD E,(HL):INC HL
        LD D,(HL)
        EX DE,HL
        INC A:CP (HL):JR C,$+3:XOR A
        LD (BC),A
        XOR A
        RET

SEN     LD A,(IX+12)
        LD HL,SBL1:CP 1:JR Z,SENE
        LD HL,SBL1A:CP 2:JR Z,SENE
        LD HL,SBL2:CP 4:JR Z,SENE
        LD HL,SBL2A:CP 5:JR Z,SENE
        LD HL,SBL3:CP 7:JR Z,SENE
        LD HL,SBL3A:CP 8:JR Z,SENE

        LD A,(PG0),(FEP),A
        CALL LINI,GINI
        OR A:JR Z,MINI
        DEC A:JR Z,FTLER
        DEC A:JR Z,FNI
        DEC A:JR Z,JI
        DEC A:JR Z,DICI
FTLER   LD HL,SERR
        LD DE,#0113,BC,26:CALL ERR0
        JR Sext
SEXT    PUSH IX
        LD IX,F9OK:CALL PRWOW
        LD HL,SOK,DE,#0104,BC,36
        CALL PRSRW

        CALL USPO
        CALL NUSP
        CALL RRESB
        POP IX

Sext    LD A,(FEP):CALL MNG0

        LD A,1:OR A
        RET
FNI     LD HL,WCDIR+1
        CALL MKdir:JR NZ,SEXT
        LD HL,WCDIR
        CALL FENTRY:JR Z,SEXT
        CALL GDIR

JI      LD HL,SFINI
        CALL MKfile:JR NZ,SEXT
        LD HL,INIB
        LD A,(SFIS+1):SRL A
        OR A:JR NZ,$+3:INC A
        LD B,A:CALL SAVE512
        JR SEXT
MINI
DICI    LD HL,WCINI
        CALL FNDELFL:JR Z,SEXT
        JR JI

GINI    PUSH AF
        PUSH AF
_LD A,(SBL1):ADD A,#30:LD (CPFRQ),A
_LD A,(SBL1A):ADD A,#30:LD (SPIR),A
_LD A,(SBL2):ADD A,#30:LD (SDRV1),A
_LD A,(SBL2A):ADD A,#30:LD (SNFO1),A
_LD A,(SBL3):ADD A,#30:LD (SDRV2),A
_LD A,(SBL3A):ADD A,#30:LD (SNFO2),A
        POP AF:OR A

        LD DE,INIB
        PUSH DE
        LD HL,IDNT3,BC,38:LDIR
        LD A,13
        LD (DE),A:INC DE
        LD (DE),A:INC DE
        LD HL,SPTRN,BC,SPP1-SPTRN:LDIR
        CALL Z,MII
        LD HL,SPTR2,BC,SPP2-SPTR2:LDIR
        POP HL
        EX DE,HL
        OR A:SBC HL,DE
        LD (SFIS),HL
        POP AF
        RET

MII     PUSH DE
        LD DE,INIA,HL,SPP2
        CALL SRHSQ
        POP DE:RET Z

        PUSH HL
        LD HL,SPP2,BC,9:LDIR
        POP HL

MIIM    LD A,D:CP #20:RET NC
        LD A,(HL)
        OR A:RET Z
        CP "[":RET Z
        LD (DE),A:INC HL,DE
        JR MIIM

SRHSQ   LD A,(DE):OR A:RET Z
        CP (HL):INC DE:JR NZ,SRHSQ
        LD BC,HL
SSQM    INC HL:LD A,(HL):INC A:JR Z,SSQ
        LD A,(DE):OR A:RET Z
        CP (HL):INC DE:JR Z,SSQM
        LD HL,BC
        JR SRHSQ
SSQ     EX DE,HL
        LD A,1:OR A
        RET
;-------
PRCONF  LD (YYY),A
PRCON   CALL GENBUF:RET Z
        PUSH DE:LD D,A,E,6:CALL PRSRW
        LD A,%01011100:CALL PRIAT
        POP DE
        JR PRCON

GENBUF  LD A,(DE):INC A:RET Z:DEC A

        EX DE,HL
        INC HL
        LD E,(HL):INC HL
        LD D,(HL):INC HL
        PUSH AF,DE
        LD DE,TXTBU:CALL LDIRT:INC HL
        POP BC,AF

        PUSH HL:LD HL,BC
        INC HL:LD C,(HL):INC HL
        LD B,A:INC B
        XOR A:SUB C:ADD A,C:DJNZ $-1
        PUSH BC:LD C,A:ADD HL,BC
        POP BC
        LDIR
        LD A,32
        LD B,6,(DE),A:INC DE:DJNZ $-2

        POP HL
        EX DE,HL

        LD HL,YYY:INC (HL):LD A,(HL)
        LD HL,TXTBU,BC,22
        OR A
        RET
LDIRT   LD A,(HL):OR A:RET Z
        LD (DE),A:INC HL,DE
        JR LDIRT

;---------------------------------------
PATH    LD A,(LFLT):OR A:JR NZ,LPATH

        LD IX,WINDOW:CALL DRACT,ORIGA
        LD IX,WINDO2:CALL DRACT,ORIGA
        RET

LPATH   LD IX,WINDOW
        LD HL,RLPNL+C000:CALL SIMUL

        LD IX,WINDO2
        LD HL,RRPNL+C000:CALL SIMUL
        RET
;-------
FI      CALL DRACT,ORIGA:RET
SIMUL   LD A,RPPG:CALL MNGC
        LD C,(HL):INC HL
        LD A,(HL):INC HL:CP ":":JR NZ,FI
        LD A,(HL):INC HL:CP "\":JR NZ,FI
        LD A,C:SUB #30:CP 3:JR NC,FI
        LD (IX+29),A,(IX+28),0

        LD (IX+34),1
        PUSH AF
        PUSH HL:CALL DRACT,ORIGA2,PANELI
        POP HL
        POP AF
        LD (IX+34),0
        CP (IX+29):JR NZ,FAIL

SIMZ    LD A,RPPG:CALL MNGC

        LD A,(HL):CP #FF:JR Z,EXCE
        LD B,9,DE,TXTBU+1
SIMC    LD A,(HL):INC HL
        CP "\":JR Z,SIME
        LD (DE),A:INC DE
        DJNZ SIMC:JR FAIL

SIME    XOR A:LD (DE),A
        PUSH HL
        LD HL,TXTBU,(HL),#10
        CALL SRHDRN
        LD (BRRR),HL,(BRRR+2),DE
        POP HL:JR Z,FAIL

        PUSH HL:LD HL,BRRR:CALL GLSTCAT
        POP HL

        PUSH HL
        LD A,(IX+22):CALL MNGC
        LD L,(IX+23)
        LD H,(IX+24)
        LD DE,CURO,BC,0,A,1:CALL Lup
        POP HL
        JP SIMZ

EXCE    LD DE,0-C000:ADD HL,DE
        LD (IX+32),L
        LD (IX+33),H
        JP FOLD
FAIL    LD (IX+28),0
        CALL DRACT,ORIGA
        RET
;-------
MPATH   LD A,RPPG:CALL MNG0
        EX DE,HL
        LD E,(IX+32)
        LD D,(IX+33)
        LD A,(HL):CP ".":JR Z,SPATH
APATH   LD B,8
ApA     LD A,(HL):INC HL
        CP " ":JR Z,ASK
        CP ".":JR Z,AZK
        LD (DE),A:INC DE
ASK     DJNZ ApA
        LD A,(HL):CP " ":JR Z,EDPA
AZK     LD (DE),A:INC DE
        LD B,3
APG     LD A,(HL)
        CP " ":JR Z,EDPA
        LD (DE),A:INC HL,DE
        DJNZ APG
EDPA    LD A,"\",(DE),A:INC DE

EPATH   LD A,#FF,(DE),A
        LD (IX+32),E
        LD (IX+33),D
ZIP     JP FRST
SPATH   LD B,15
        DEC DE
SiP     DEC DE:LD A,(DE)
        CP "\":JR Z,SIP
        CP ":":JR Z,ZIP
        DJNZ SiP
SIP     INC DE
        JR EPATH
;-------
RPATH   LD A,(IX+34):OR A:RET NZ
        LD A,RPPG:CALL MNG0

        LD L,(IX+30)
        LD H,(IX+31)
        LD A,(IX+29)
        ADD A,#30
        LD (HL),A:INC HL
        LD (HL),":":INC HL
        LD (HL),"\":INC HL
        LD (HL),#FF
        LD (IX+32),L
        LD (IX+33),H
        JP FRST
;-------
PPATH   LD A,RPPG:CALL MNG0

        LD L,(IX+30)
        LD H,(IX+31)

        LD DE,HL
        LD B,40-4
AG      LD A,(DE):INC DE:CP #FF:JR Z,$+4
        DJNZ AG
        LD A,40-4
        SUB B
        LD C,A
        PUSH BC
        LD B,0,C,A
        LD DE,#0002:CALL PRSRW
        LD A,(IX+6)
.4      RLCA
        CALL PRIAT
        POP BC
        LD A,C:ADD A,2:LD E,A
        LD HL,TXTBU
        LD C,B
        LD A,B:OR A:JR Z,PPO
        LD A,#CD,(HL),A:INC HL:DJNZ $-2
        LD B,0
        LD HL,TXTBU,D,0:CALL PRSRW
        LD A,(IX+6):CALL PRIAT
PPO     JP FRST
;---------------------------------------
INIA    EQU #0000
INIB    EQU #1000

FINI    CALL LINI
;-------
        CALL PARSING
;-------
        LD HL,ENTRY,B,32:CALL NOPING

;CALL USPO
;CALL NUSP
        JP F7F

LINI    LD A,INIPG:CALL MNG0
        LD BC,#DFF7,A,#B2:OUT A
        LD B,#BF:IN A

        CALL TSBC:LD A,1:RET NZ
;-------
_LD HL,WCDIR:CALL SRHDRN:LD A,2:RET Z
        LD (BRRR),HL,(BRRR+2),DE
        LD HL,BRRR:CALL GLSTCAT

_LD HL,WCINI:CALL SRHDRN:LD A,3:RET Z

        LD (BRRR),HL,(BRRR+2),DE
        LD HL,BRRR:CALL GIPAG
;-------
        CALL INILOAD:LD A,4:RET NZ
        XOR A
        RET
;---------------------------------------
INILOAD CALL INXSe

        LD DE,IDNT3,B,38
        CALL RAZ:RET NZ:INC HL

        LD DE,INIA,C,0
INIF    LD A,D:CP INIB[:JR NC,INILE
        LD A,H:AND 1:OR L
        CALL Z,INXSE:JR Z,INILE
        LD A,(HL)
        CP #0A:JR C,INILE,Z,INiF
        CP #0D:CALL Z,SKIPE
        CP ";":CALL Z,SKIPS

        INC C:DEC C:JR NZ,INiF
        LD (DE),A
        INC DE
INiF    INC HL
        JR INIF

INILE   XOR A:LD (DE),A:RET
;-------
SKIPS   LD C,1:RET
SKIPE   LD C,0:RET
;-------
INXSE   PUSH BC,DE:CALL INXSe
        POP DE,BC:CP #0F
        RET

INXSe   LD HL,INIB,B,1
        PUSH HL:CALL LOAD512
        POP HL
        RET
;---------------------------------------
PARSING LD HL,INIA
PARS    LD A,(HL)
        CP "[":CALL Z,SUEXE:JR Z,PARS
        CALL SER13D
        LD A,(HL)
        OR A:RET Z
        LD A,H:CP INIB[:RET NC
        JR PARS

SUEXE   LD DE,STARTU:INC HL
SUfnd   LD A,(DE):INC A:RET Z
        CALL SUU:JR Z,SUexe
        JR SUfnd

SUU     PUSH HL:CALL RAZ0:INC DE
        POP HL:RET Z
        XOR A
        EX DE,HL:LD BC,16:CPIR:INC HL,HL
        EX DE,HL
        INC A
        RET

SUexe   LD A,(DE),(SUmod+1),A:INC DE
        LD A,(DE),(SUmod+2),A
SUmod   CALL 0
        XOR A
        RET
;-------
SUPL    PUSH HL:LD IX,INIWND:CALL PRWOW
        POP HL

        LD DE,#0101
RSI     CALL SER13D,ICE:RET Z

        PUSH HL
        PUSH DE:CALL SERNLOD
        POP DE
        CALL NZ,PLPRNAM
        POP HL
        JR RSI
;-------
SUPAL   LD A,0:EXA:JR SUPA
SUPAR   LD A,1:EXA

SUPA    CALL SER13D,ICE:RET Z

        LD DE,PANN:CALL SUpa
        JR SUPA

SUpa    LD A,(DE):INC A:RET Z
        CALL SUU:JR Z,SUexe
        JR SUpa

CPCL    LD A,(HL):INC HL
        CP " ":JR Z,CPC
        CP "=":JR Z,CPC
        CP #0D:JR NZ,CPCL:DEC HL
        XOR A:JR $+3
CPC     LD A,(HL)

        LD HL,WINDOW
        EXA:OR A:JR Z,$+5:LD HL,WINDO2
        EXA
        RET
;-------
SUPAD   PUSH HL:CALL CPCL
        LD DE,29:ADD HL,DE
        SUB #30:CP 3:JR C,$+3:XOR A
        LD (HL),A
        POP HL
        RET
SUPAI   PUSH HL:CALL CPCL
        LD DE,10:ADD HL,DE
        SUB #30:AND 1:ADD A,A
        LD (HL),A
        POP HL
        RET

ICE     LD A,(HL)
        OR A:RET Z
        CP #0D:RET Z
        CP "["
        RET
;-------
SUL     CALL SER13D,ICE:RET Z

        LD DE,SETUP:CALL SUpa
        JR SUL
SUL1    PUSH HL:CALL CPCL
        SUB #30:AND %00000011
        LD (DFRQ),A
        POP HL
        RET
SUL2    PUSH HL:CALL CPCL
        SUB #30:AND %00000001
        LD (LFLT),A
        POP HL
        RET
;-------
SERNLOD CALL GENNAM,SRHDRN:RET Z
        LD (BRRR),HL,(BRRR+2),DE
        LD HL,BRRR:CALL GIPAG

        LD A,1:CALL LDPL2
        LD A,1:OR A
        RET
;-------
GENNAM  LD DE,LOBU+1,BC,12:LDIR
        XOR A:LD (DE),A
        LD HL,LOBU,(HL),#00
        RET
;-------
PLPRNAM PUSH DE
        LD IX,INIWND
        LD HL,LOBU+165,BC,32:CALL PRSRW
        LD A,%01110000:CALL PRIAT
        POP DE
        INC D
        RET
;---------------------------------------
DINT    EI:HALT:DI
        LD HL,INTM+2,(INTM),HL
        RET
;-------
RAZ     LD A,(DE):CP (HL):RET NZ
        INC HL,DE
        DJNZ RAZ
        RET
;-------
RAZ0    LD A,(DE):CP (HL):RET NZ
        INC HL,DE
        LD A,(DE):OR A:RET Z
        JR RAZ0
;-------
F7F     XOR A:IN (#FE)
        AND %00011111:CP %00011111
        JR NZ,F7F
        RET
;---------------------------------------
YYY     NOP
;---------------------------------------
F9WND   DB 0,%00000111
        DB 23,8;     X,Y
        DB 32+2,8+2; W,H
        DB %01011111;PAPER+INK
        DB 0
        DW #0000;    BUFFER
        DB 3,6;      LINES
        DB 1,11
        DB %11110000,%01011100
F9WN2   DB 0,0
        DB 23,18;    X,Y
        DB 32+2,1+2; W,H
        DB %01011111;PAPER+INK
        DB 0
        DW #0000;    BUFFER
        DB 0,0;      LINES
F9OK    DB 0,0
        DB 18,13;    X,Y
        DB 42+2,1+2; W,H
        DB %01001111;PAPER+INK
        DB 0
        DW #0000;    BUFFER
        DB 0,0;      LINES
;---------------------------------------
SFINI   DB #00
SFIS    DW 0,0
        DB "WC.INI",0

SPTRN   DB "[SETUP]",13
        DB "CPU_FREQ=2",13
CPFRQ   EQU $-2
        DB "SPIR=1",13
SPIR    EQU $-2
        DB 13
SPP1
SPTR2   DB "[LPANEL]",13
        DB "DRV=1",13
SDRV1   EQU $-2
        DB "INFO=1",13
SNFO1   EQU $-2
        DB 13
        DB "[RPANEL]",13
        DB "DRV=1",13
SDRV2   EQU $-2
        DB "INFO=1",13
SNFO2   EQU $-2
        DB 0
SPP2    DB "[PLUGINS]",#FF

STP     DB "SETUP:"
STPL    DB "Left Panel:"
STPR    DB "Right Panel:"
SSAV    DB "Save INI file"
SERR    DB "Device or FAT32 NOT FOUND!"
SOK     DB "INI file SAVED/MERGED "
        DB "SUCCESSFULLY!!!"

SBL1    DB 2:DW SFRQ
        DB "    CPU Speed: ",0
SBL1A   DB 1:DW SDRS
        DB "Remember dirs: ",0
        DB #FF
SBL2    DB 1:DW SDRV:DB "   Driver: ",0
SBL2A   DB 1:DW SINF:DB "File Info: ",0
        DB #FF
SBL3    DB 1:DW SDRV:DB "   Driver: ",0
SBL3A   DB 1:DW SINF:DB "File Info: ",0
        DB #FF

SFRQ    DB 3,7
        DB "3.5 MHz"
        DB "7 MHz  "
        DB "14 MHz "
SDRS    DB 2,3
        DB "NO "
        DB "YES"

SDRV    DB 3,7
        DB "IDEnemo"
        DB "SD(ZC) "
        DB "SD(NGS)"
SINF    DB 2,8
        DB "Disabled"
        DB "Enabled "

STARTU  DB "SETUP",0:DW SUL
        DB "PLUGINS",0:DW SUPL
        DB "LPANEL",0:DW SUPAL
        DB "RPANEL",0:DW SUPAR
        DB #FF
PANN    DB "DRV",0:DW SUPAD
        DB "INFO",0:DW SUPAI
        DB #FF
SETUP   DB "CPU_FREQ",0:DW SUL1
        DB "SPIR",0:DW SUL2
        DB #FF

IDNT    DB "SpectrumProg"
IDNT2   DB "WildCommanderMDL"
IDNT3   DB "Wild Commander "
        DB "configuration file v0.2"
;---------------------------------------
