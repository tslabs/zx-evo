;---------------------------------------
;i: HL - адрес начала текста,
;   BC - длина (>0).
;
;o: A=0 - ALT,
;     1 - WIN,
;     2 - KOI.
DEF_COD EXX

;Заполняем BUF_1-BUF_3:

        LD HL,BUF_1
        LD DE,BUF_1+1
        LD BC,0+(128*3)-1
        LD (HL),#FF
        LDIR

; В альтернативных регистрах хранятся:
; H - BAD_1', L - ALL_1
; D - BAD_2'
; B - BAD_3', C - ALL_3
; E - константа #FF, она пригодится в
;     дальнейшем, при коррекции данных.
;
;ALL_2 не подсчитывается, т.к.
;ALL_2=ALL_3.

;Сейчас BC=0 после LDIR!

        DEC B;BC=#FF00
        LD H,B
        LD L,C;HL=#FF00
        LD D,B;D=#FF
        LD E,B;E=#FF

        EXX

;HL - адрес начала текста, BC - длина.

        DEC BC
        LD A,B:OR C:RET Z;A=0

;Главный цикл:

DC_1    PUSH BC;счетчик

;Обрабатываем текущее сочетание для
;каждого из трех вариантов:

        LD DE,RET_
        LD BC,BUF_1
        CALL WORK_2S
        EXX
        JR Z,DC_2
        DEC H
DC_2    ADD A,L
        LD L,A
        EXX

        LD DE,WIN2ALT
        LD BC,BUF_2
        CALL WORK_2S
        JR Z,DC_3
        EXX
        DEC D
        EXX

DC_3    LD DE,KOI2ALT
        LD BC,BUF_3
        CALL WORK_2S

        POP BC

        EXX
        JR Z,DC_4
        DEC B
DC_4    ADD A,C
        LD C,A

;Проверка: может быть, в одном из
;вариантов уже набралось 128 сочетаний?

        OR L;A=C!
        RLA
        JR C,DC_9

;Иначе - проходим по тексту дальше, пока
;он не кончится:

        EXX
        INC HL
        DEC BC
        LD A,B
        OR C
        JR NZ,DC_1

;Данные собраны. Теперь, если
;в каком-либо из вариантов
;недопустимых сочетаний меньше 1/32
;от общего их числа, то считаем, что
;их и не было:

        EXX

DC_9    LD A,L
        RLCA
        RLCA
        RLCA
        AND 7;ALL/32
        INC A;ALL/32+1
        CPL ;-ALL/32-1
        CP H;-ALL/32-1 CP -BAD
        JR NC,DC_5
        LD H,E;ALL/32+1>BAD
;(т.е.ALL/32>=BAD)
DC_5    LD A,C
        RLCA
        RLCA
        RLCA
        AND 7
        INC A
        CPL
        CP B
        JR NC,DC_6
        LD B,E

DC_6    CP D
        JR NC,DC_7
        LD D,E

;По таблице определяем кодировку:
DC_7    LD E,C;ALL_2=ALL_3

        XOR A;A:=0, res CY
        SBC HL,DE
        RLA ;CY сбрасывается
        ADD HL,DE
        SBC HL,BC
        RLA ;CY сбрасывается
        EX DE,HL
        SBC HL,BC
        RLA

        LD HL,COD_TAB
        LD D,0
        LD E,A
        ADD HL,DE
        LD A,(HL)

        RET

COD_TAB DB 0,0,#FF,2,1,#FF,1,2
;---------------------------------------
;Процедура WORK_2S - обработка одного
;сочетания.
;
;Вход: HL - адрес сочетания,
;      DE - адрес п/п перекодировки.
;      BC - адрес буфера для соотв.
;           варианта.
;
;Выход: A=0 - это не сочетание русских
;             букв, или это сочетание
;             уже встречалось раньше.
;       A=1 - это сочетание русских букв
;
;Флаг Z сброшен, если сочетание является
;недопустимым, иначе установлен.
;
;HL не меняется.

WORK_2S PUSH HL
        LD (ADR_SUB),DE
        LD (ADR_BUF),BC

        CALL GET_WRK;первый символ
        JR C,NO_L;не буква!
        LD B,A

        INC HL

        CALL GET_WRK;второй символ
        JR C,NO_L;не буква!
        LD C,A

;Оба символа - буквы.

        LD D,0
        LD A,B
        ADD A,A
        ADD A,A
        LD E,A
        LD A,C
        RRA
        RRA
        RRA
        AND 3
        ADD A,E
        LD E,A

        LD A,C
        CPL
        AND 7
        ADD A,A
        ADD A,A
        ADD A,A
        OR #46
        LD (C_BIT_1),A
        LD (C_BIT_2),A
        ADD A,#40
        LD (C_RES),A

;DE - смещение в таблице BUF.

;Проверяем: если соответствующий бит в
;таблице равен 0, значит, это сочетание
;уже встречалось раньше. Тогда выходим,
;игнорируя его (как если бы это были не
;буквы).

        LD HL,0;адрес буфера
ADR_BUF EQU $-2
        ADD HL,DE
        BIT 0,(HL)
C_BIT_1 EQU $-1
        RES 0,(HL);сразу обнуляем
C_RES   EQU $-1
        JR Z,NO_L

;Такое сочетание еще не встречалось.
;Проверяем, допустимо оно или нет:

        LD HL,TABL_2S
        ADD HL,DE

        BIT 0,(HL)
C_BIT_2 EQU $-1

        LD A,1
        POP HL
        RET

;Выход, если в сочетании - не буквы, или
;если такое сочетание уже встречалось.

NO_L    XOR A;A=0, Z=1.
        POP HL
RET_    RET

;---------------------------------------
;i: HL - адрес символа.
;o: если это буква, в A - ее поряд-
;   ковый номер (0..31), и флаг C
;   сброшен. Иначе флаг C=1.

GET_WRK LD A,(HL)
        CP #80
        CALL 0;перекодировали
ADR_SUB EQU $-2
        RET C;не буква

;Получаем порядковый номер, если буква:

        CP #A0:JR NC,GET_W1

        SUB #80
        RET

GET_W1  CP #B0:JR NC,GET_W2

        SUB #A0
        RET

GET_W2  CP #E0:RET C;не буква
        CP #F0:CCF:RET C;не буква

        SUB #D0
        RET

;---------------------------------------
;Процедура WIN2ALT перекодирует символ
;текста, код которого #80..#FF, из
;кодировки WIN в ALT, если этот символ
;является русской буквой. Тогда флаг C
;сброшен, иначе установлен.

WIN2ALT CP #C0
        RET C;не буква

        SUB #10
        CP #E0
        RET NC

        SUB #30
        RET
;---------------------------------------
;Процедура KOI2ALT перекодирует символ
;текста, код которого #80..#FF, из
;кодировки KOI в ALT, если этот символ
;является русской буквой. Тогда флаг C
;сброшен, иначе установлен.

KOI2ALT CP #C0:RET C

        PUSH HL
        SUB #C0
        LD H,TAB_K_A[
        ADD A,TAB_K_A]
        LD L,A

        LD A,(HL)
        POP HL
        RET

TAB_K_A DB "юабцдефгхийклмно"
        DB "пярстужвьызшэщчъ"
        DB "ЮАБЦДЕФГХИЙКЛМНО"
        DB "ПЯРСТУЖВЬЫЗШЭЩЧЪ"
;---------------------------------------
TABL_2S
_DB #00,#00,#00,#38,#01,#41,#08,#04
_DB #02,#40,#08,#06,#03,#41,#0E,#7F
_DB #00,#00,#08,#44,#00,#00,#00,#30
_DB #21,#40,#2E,#F7,#00,#40,#0E,#40
_DB #00,#00,#00,#38,#E2,#C0,#80,#7E
_DB #58,#49,#0D,#7D,#00,#00,#8A,#24
_DB #03,#40,#28,#62,#00,#51,#04,#20
_DB #00,#00,#00,#38,#7B,#48,#0C,#60
_DB #00,#00,#00,#24,#00,#40,#00,#00
_DB #02,#40,#00,#00,#00,#00,#18,#38
_DB #7B,#61,#0F,#ED,#43,#40,#0F,#7B
_DB #5B,#45,#EF,#EF,#5B,#41,#47,#77
_DB #53,#40,#08,#F5,#7B,#79,#6F,#F7
_DB #FB,#FF,#FF,#FC,#80,#02,#08,#3E
_DB #82,#51,#90,#34,#EA,#C2,#03,#FF
_DB #80,#82,#18,#3D,#80,#02,#08,#3C
;---------------------------------------
BUF_1   DS 128
BUF_2   DS 128
BUF_3   DS 128
